#include "../../../../../../../hardware/nvidia/platform/t18x/quill/kernel-dts/tegra186-quill-p3310-1000-a00-00-base.dts"
#include "tegra186-quill-p3310-override.dtsi"

/ {
	tegra-cache {
		compatible = "nvidia,t18x-cache";
		status = "okay";
	};
};
