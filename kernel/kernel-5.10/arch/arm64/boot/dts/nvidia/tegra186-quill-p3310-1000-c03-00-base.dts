#include "../../../../../../../hardware/nvidia/platform/t18x/quill/kernel-dts/tegra186-quill-p3310-1000-c03-00-base.dts"
#include "tegra186-quill-p3310-override.dtsi"
/ {
	gpio-keys {
		status = "disabled";
	};

	tegra-cache {
		compatible = "nvidia,t18x-cache";
		status = "okay";
	};
};
