## kernel/nvidia/Documentation/devicetree/bindings/media/i2c/imx274.txt
```
Sony IMX274 CMOS Image Sensor, NVIDIA TCF driver bindings

The Sony IMX274 is an 8.51 MP CMOS colour image sensor; the following Device
Tree bindings are for the NVIDIA Tegra Camera Framework (TCF) driver, for use on
embedded NVIDIA Tegra SOC platforms.

Camera-board specific overlays are applied by the NVIDIA Tegra plugin-manager
pre-boot, they define the physical regulator and GPIO connections which differ
by the Jetson board and chip generation, and the camera daughter board revision.

Required properties:
	- compatible: Should be "sony,imx274".
	- sensor_model: Name of sensor, should be "imx274".
	- reg: Sensor I2C bus address, default is 0x1a.
	- modeXY: Please see tegra-camera-framework.txt for DT bindings.

	- avdd-reg: Name of analog power regulator.
	- vana-supply: Analog power source (2.80 V).
	- iovdd-reg: Name of interface power regulator.
	- vif-supply: Interface power source (1.80 V).
	- dvdd-reg: Name of digital power regulator.
	- vdig-supply: Digital power source (1.20 V).

	- clocks: All clocks from the Tegra SoC used to drive sensor.
	- clock-names: Names of the above clocks.
	- mclk: Name of the MIPI clock (aka. INCK) driven from the Tegra SOC.
	- clock-frequency: Frequency of the mclk source [Hz].
	- reset-gpios: GPIO(s) used to ouput reset/enable signal.
	- pwdn-gpios: GPIO(s) used to enable/disable sensor power.

Optional properties:
	- physical_w: Horizontal width of active surface [mm].
	- physical_h: Vertical height of active surface [mm].

	- has_eeprom: Property is present if there is a sensor-external EEPROM.
	- fuse_id_start_addr: Sensor-internal fuse base I2C address.

	- use_sensor_mode_id: Whether to enable use of the V4L2
		CID_SENSOR_MODE_ID control, which enables explicit sensor mode
		enumeration and selection. (Default: false)

	- delayed_gain: Whether gain settings should be offset by one frame to
		be in sync w/ exposure settings (takes effect on n+2 frame).
		 (Default: false)
	- use_decibel_gain: Whether to convert gain to dB units before passing
		to driver. (Default: false)
	- post_crop_frame_drop: Number of frames to silently discard following
		application of crop settings, as the initial ones may be
		corrupted. (Default: 0)
	- limit_analog_gain: Enable as a WAR to prevent banding for the IMX185
		sensor. (Default: false)

	- nvidia,gmsl-ser-device: MIPI CSI-2 serializer device node.
	- nvidia,gmsl-dser-device: MIPI CSI-2 deserializer device node.

Deprecated properties:
	- devnode: Name of V4L2 character device in filesystem, this property is
		now deprecated, the Tegra Camera Framework enumerates them
		automatically.
	- dovdd-supply: Digital I/O power source (1.80 V), should use vif-supply
		for new drivers.

Example:

	imx274_a@1a {
		compatible = "sony,imx274";
		/* I2C device address */
		reg = <0x1a>;

		/* V4L2 device node location */
		devnode = "video0";

		/* Physical dimensions of sensor */
		physical_w = "3.674";
		physical_h = "2.738";

		sensor_model = "imx274";

		/* Define any required hw resources needed by driver */
		/* ie. clocks, io pins, power sources */
		avdd-reg = "vana";
		iovdd-reg = "vif";

		/* Defines number of frames to be dropped by driver internally after applying */
		/* sensor crop settings. Some sensors send corrupt frames after applying */
		/* crop co-ordinates */
		/*post_crop_frame_drop = "0";*/

		/* if true, delay gain setting by one frame to be in sync with exposure */
		delayed_gain = "true";

		has-eeprom;
		fuse_id_start_addr = <91>;

		mode<0..N-1> {
			...
		};
	};

	/* Camera board-specific config overlay */
	imx274_a@1a {
		/* Define any required hw resources needed by driver */
		/* ie. clocks, io pins, power sources */
		clocks = <&bpmp_clks TEGRA194_CLK_EXTPERIPH1>,
				<&bpmp_clks TEGRA194_CLK_EXTPERIPH1>;
		clock-names = "extperiph1", "pllp_grtba";
		mclk = "extperiph1";
		reset-gpios = <&tegra_main_gpio CAM0_RST_L GPIO_ACTIVE_HIGH>;
		vana-supply = <&p2822_avdd_cam_2v8>;
		vif-supply = <&p2822_vdd_1v8_cvb>;
	};
```

## kernel/nvidia/Documentation/devicetree/bindings/media/i2c/imx318.txt
```
Sony IMX318 CMOS Image Sensor, NVIDIA TCF driver bindings

The Sony IMX318 is an 22.5 MP CMOS colour image sensor; the following Device
Tree bindings are for the NVIDIA Tegra Camera Framework (TCF) driver, for use on
embedded NVIDIA Tegra SOC platforms.

Camera-board specific overlays are applied by the NVIDIA Tegra plugin-manager
pre-boot, they define the physical regulator and GPIO connections which differ
by the Jetson board and chip generation, and the camera daughter board revision.

Required properties:
	- compatible: Should be "sony,imx318".
	- sensor_model: Name of sensor, should be "imx318".
	- reg: Sensor I2C bus address, default is 0x10.
	- modeXY: Please see tegra-camera-framework.txt for DT bindings.

	- avdd-reg: Name of analog power regulator.
	- vana-supply: Analog power source (2.80 V).
	- iovdd-reg: Name of interface power regulator.
	- vif-supply: Interface power source (1.80 V).
	- dvdd-reg: Name of digital power regulator.
	- vdig-supply: Digital power source (1.20 V).

	- clocks: All clocks from the Tegra SoC used to drive sensor.
	- clock-names: Names of the above clocks.
	- mclk: Name of the MIPI clock (aka. INCK) driven from the Tegra SOC.
	- clock-frequency: Frequency of the mclk source [Hz].
	- reset-gpios: GPIO(s) used to ouput reset/enable signal.
	- pwdn-gpios: GPIO(s) used to enable/disable sensor power.

Optional properties:
	- physical_w: Horizontal width of active surface [mm].
	- physical_h: Vertical height of active surface [mm].

	- has_eeprom: Property is present if there is a sensor-external EEPROM.
	- fuse_id_start_addr: Sensor-internal fuse base I2C address.

	- use_sensor_mode_id: Whether to enable use of the V4L2
		CID_SENSOR_MODE_ID control, which enables explicit sensor mode
		enumeration and selection. (Default: false)

	- delayed_gain: Whether gain settings should be offset by one frame to
		be in sync w/ exposure settings (takes effect on n+2 frame).
		 (Default: false)
	- use_decibel_gain: Whether to convert gain to dB units before passing
		to driver. (Default: false)
	- post_crop_frame_drop: Number of frames to silently discard following
		application of crop settings, as the initial ones may be
		corrupted. (Default: 0)
	- limit_analog_gain: Enable as a WAR to prevent banding for the IMX185
		sensor. (Default: false)

	- nvidia,gmsl-ser-device: MIPI CSI-2 serializer device node.
	- nvidia,gmsl-dser-device: MIPI CSI-2 deserializer device node.

Deprecated properties:
	- devnode: Name of V4L2 character device in filesystem, this property is
		now deprecated, the Tegra Camera Framework enumerates them
		automatically.
	- dovdd-supply: Digital I/O power source (1.80 V), should use vif-supply
		for new drivers.

Example:

	imx318_a@10 {
		compatible = "nvidia,imx318";
		reg = <0x10>;

		/* Physical dimensions of sensor */
		physical_w = "6.811";
		physical_h = "5.254";

		sensor_model = "imx318";
		/* Define any required hw resources needed by driver */
		/* ie. clocks, io pins, power sources */
		avdd-reg = "vana";
		iovdd-reg = "vif";
		dvdd-reg = "vdig";

		has-eeprom;

		mode<0..N-1> {
			...
		};
	};

	/* Camera board-specific config overlay */
	imx318_a@10 {
		clocks = <&tegra_car TEGRA186_CLK_EXTPERIPH1>,
			<&tegra_car TEGRA186_CLK_PLLP_OUT0>;
		clock-names = "extperiph1", "pllp_grtba";
		mclk = "extperiph1";
		clock-frequency = <24000000>;
		reset-gpios = <&tegra_main_gpio CAM0_RST_L GPIO_ACTIVE_HIGH>;
		vana-supply = <&en_vdd_cam_hv_2v8>;
		vif-supply = <&en_vdd_cam>;
		vdig-supply = <&en_vdd_sys>;
	};
```

## kernel/nvidia/Documentation/devicetree/bindings/media/i2c/imx390.txt
```
Sony IMX390 CMOS Image Sensor, NVIDIA TCF driver bindings

The Sony IMX390 is a 2.45 MP CMOS colour image sensor; the following Device Tree
bindings are for the NVIDIA Tegra Camera Framework (TCF) driver, for use on
embedded NVIDIA Tegra SOC platforms.

Camera-board specific overlays are applied by the NVIDIA Tegra plugin-manager
pre-boot, they define the physical regulator and GPIO connections which differ
by the Jetson board and chip generation, and the camera daughter board revision.

Required properties:
	- compatible: Should be "sony,imx390".
	- sensor_model: Name of sensor, should be "imx390".
	- reg: Sensor I2C bus address, default is 0x1b.
	- modeXY: Please see tegra-camera-framework.txt for DT bindings.

	- avdd-reg: Name of analog power regulator.
	- vana-supply: Analog power source (2.80 V).
	- iovdd-reg: Name of interface power regulator.
	- vif-supply: Interface power source (1.80 V).
	- dvdd-reg: Name of digital power regulator.
	- vdig-supply: Digital power source (1.20 V).

	- clocks: All clocks from the Tegra SoC used to drive sensor.
	- clock-names: Names of the above clocks.
	- mclk: Name of the MIPI clock (aka. INCK) driven from the Tegra SOC.
	- clock-frequency: Frequency of the mclk source [Hz].
	- reset-gpios: GPIO(s) used to ouput reset/enable signal.
	- pwdn-gpios: GPIO(s) used to enable/disable sensor power.

Optional properties:
	- physical_w: Horizontal width of active surface [mm].
	- physical_h: Vertical height of active surface [mm].

	- has_eeprom: Property is present if there is a sensor-external EEPROM.
	- fuse_id_start_addr: Sensor-internal fuse base I2C address.

	- use_sensor_mode_id: Whether to enable use of the V4L2
		CID_SENSOR_MODE_ID control, which enables explicit sensor mode
		enumeration and selection. (Default: false)

	- delayed_gain: Whether gain settings should be offset by one frame to
		be in sync w/ exposure settings (takes effect on n+2 frame).
		 (Default: false)
	- use_decibel_gain: Whether to convert gain to dB units before passing
		to driver. (Default: false)
	- post_crop_frame_drop: Number of frames to silently discard following
		application of crop settings, as the initial ones may be
		corrupted. (Default: 0)
	- limit_analog_gain: Enable as a WAR to prevent banding for the IMX185
		sensor. (Default: false)

	- nvidia,gmsl-ser-device: MIPI CSI-2 serializer device node.
	- nvidia,gmsl-dser-device: MIPI CSI-2 deserializer device node.

Deprecated properties:
	- devnode: Name of V4L2 character device in filesystem, this property is
		now deprecated, the Tegra Camera Framework enumerates them
		automatically.
	- dovdd-supply: Digital I/O power source (1.80 V), should use vif-supply
		for new drivers.

Example:

	imx390_a@1b {
		compatible = "nvidia,imx390";

		reg = <0x1b>;

		/* Physical dimensions of sensor */
		physical_w = "15.0";
		physical_h = "12.5";

		sensor_model = "imx390";

		/* Defines number of frames to be dropped by driver internally after applying */
		/* sensor crop settings. Some sensors send corrupt frames after applying */
		/* crop co-ordinates */
		post_crop_frame_drop = "0";

		/* Convert Gain to unit of dB (decibel) befor passing to kernel driver */
		use_decibel_gain = "true";

		/* enable CID_SENSOR_MODE_ID for sensor modes selection */
		use_sensor_mode_id = "true";

		mode<0..N-1> {
			...
		};
	};

	/* Camera board-specific config overlay */
	imx390_a@1b {
		def-addr = <0x1a>;
		/* Define any required hw resources needed by driver */
		/* ie. clocks, io pins, power sources */
		clocks = <&tegra_car TEGRA186_CLK_EXTPERIPH1>,
			<&tegra_car TEGRA186_CLK_PLLP_OUT0>;
		clock-names = "extperiph1", "pllp_grtba";
		mclk = "extperiph1";
		nvidia,gmsl-ser-device = <&ser_a>;
		nvidia,gmsl-dser-device = <&dser>;
	};
```
