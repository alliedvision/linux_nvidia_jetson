## kernel/kernel-5.10/drivers/net/ethernet/mellanox/mft/Kconfig
```kconfig
#
# Mellanox flash tool configuration
#

config MLX_MFT
	tristate "Mellanox Flash Tool Module "
	help
	  This driver supports Mellanox Technologies Firmware
	  flashing tool.

	  To compile this driver as a module, choose M here: the
	  module will be called mst_pci, mst_pciconf, mst_ppc_pci_reset.
```

## kernel/nvidia/Documentation/devicetree/bindings/arm/arm64_ras.txt
```
* ARMv8.2 RAS Driver
==============================

RAS are three aspects of the dependability of a system:
Reliability: continuity of correct service
Availability: readiness for correct service
Serviceability: ability to undergo modifications and repairs

ARMv8.2 provides RAS extensions to achieve the above features in a system.

arm64_ras driver allows you to handle Correctable errors using per core
Fault Handling Interrupt (or FHI). Un-correactable errors are handled by
raising SError exception to kernel or Trusted Firmware(EL3) on CCLEX.


The driver provides an API for CPU specific RAS drivers to
register callbacks in case of FHI. When FHI occurs, the FHI
ISR goes through the list of registered callbacks and executes
them. Similarly, the driver allows registering SError callbacks
for Un-correctable errors within Core, Core-Cluster & CCPLEX.
When SError is reported, then those callbacks are scanned to
find and report error in a Core, Cluster or CCPLEX

Required Properties:

- compatible : Should be "arm,armv8.2-ras"
- interrupts : Represents per core Fault Handling Interrupt

Example:
=========

	arm64_ras: arm64_ras {
		compatible = "arm,armv8.2-ras";
		interrupts = <0 392 0x04>,
			<0 393 0x04>,
			<0 394 0x04>,
			<0 395 0x04>,
			<0 396 0x04>,
			<0 397 0x04>,
			<0 398 0x04>,
			<0 399 0x04>;
		status = "disabled";
	};


Required properties for carmel-ras driver:
- compatible: Should be "nvidia,carmel-ras"

Example:
========

	carmel_ras {
		compatible = "nvidia,carmel-ras";
		status = "disabled";
	};
```

## kernel/nvidia/Documentation/devicetree/bindings/ata/nvidia,tegra186-ahci-sata.txt
```
Tegra186 SoC SATA AHCI controller.

Required Properties:
- compatible : For Tegra186, must contain "nvidia,tegra186-ahci-sata".
    For Tegra194, must contain "nvidia,tegra194-ahci-sata".
- reg : Must contain an entry for each entry in reg-names.
- reg-names : Must include the following entries:
  - sata-ahci.
  - sata-config.
  - sata-ipfs.
  - sata-aux.
- interrupts : Defines the interrupt used by SATA.
- iommus : A reference to the IOMMU.
    See Documentation/devicetree/bindings/iommu/iommu.txt.
- power-domains : A phandle and PM domain specifier as defined by bindings of
    the power controller specified by phandle.
    See Documentation/devicetree/bindings/power/power_domains.txt.
- clocks : Must contain an entry for each entry in clock-names.
- clock-names : Must include the following entries:
  - sata.
  - sata-oob.
  - pllp
  - pllp-uphy.
- resets : Must contain an entry for each entry in reset-names.
- reset-names : Must include the following entries:
  - sata.
  - sata-cold.
- pinctrl-names: Define pinctrls for devslp pin.
- pinctrl-0 : The pincontrol settings to configure devslp pin.
- pinctrl-1 : The pincontrol settings to place devslp pin in pull up state.
- nvidia,disable-features : Defines features to be disabled. Must be one of the
  following entries:
    - devslp.
    - hipm.
    - dipm.
    - slumber.
    - partial.
    - ncq.
- nvidia,link-flags : Defines link flags. Must be one of the following entries:
    - max_power.
    - min_power.
    - med_power.

Example:

	tegra_sata: ahci-sata@3507000 {
		compatible = "nvidia,tegra186-ahci-sata";
		reg = <0x0 0x03507000 0x0 0x00002000>,
		      <0x0 0x03501000 0x0 0x00006000>,
		      <0x0 0x03500000 0x0 0x00001000>,
		      <0x0 0x03A90000 0x0 0x00010000>;
		reg-names = "sata-ahci", "sata-config", "sata-ipfs", "sata-aux";
		interrupts = <0 TEGRA186_IRQ_SATA 0x04>;
		iommus = <&smmu TEGRA_SID_SATA2>;
		iommu_sodev_map;
		power-domains = <&bpmp TEGRA186_POWER_DOMAIN_SAX>;
		clocks = <&tegra_car TEGRA186_CLK_SATA>,
			 <&tegra_car TEGRA186_CLK_SATA_OOB>,
			 <&tegra_car TEGRA186_CLK_PLLP>,
			 <&tegra_car TEGRA186_CLK_PLLP_OUT0>;
		clock-names = "sata", "sata-oob", "pllp", "pllp-uphy";
		resets = <&tegra_car TEGRA186_RESET_SATA>,
			 <&tegra_car TEGRA186_RESET_SATACOLD>;
		reset-names = "sata", "sata-cold";
		pinctrl-names = "devslp_active", "devslp_pullup";
		pinctrl-0 = <&devslp_active_state>;
		pinctrl-1 = <&devslp_pullup_state>;
		nvidia,disable-features = "devslp", "dipm";
		nvidia,link-flags = "min_power";
	};
```

## kernel/nvidia/Documentation/devicetree/bindings/block/tegra_oops_virt_storage/tegra-hv-oops-storage.txt
```
Tegra Virtual Storage driver for OOPS partition

Virtual Storage Driver is the front end driver that interfaces with
-  the Storage Virtualization System for Tegra SOC OOPS partition and
-  the pstore system for storing OOPS/panic logs

Required Properties:
- compatible: should be "nvidia,tegra-hv-oops-storage"
- instance:   to identify a specific instance of the device
- ivc:        ivc channel to used for communication with Virtualization System
- mempool:    mempool used for data transfers with Virtualization System
- pstore_max_reason: one of KMSG_DUMP_* values from kmsg_dump.h. Driver only
	supports KMSG_DUMP_OOPS (value = 2) which allows PANIC and OOPS logs
	to be stored.  KMSG logs above this reason level will be ignored.
- pstore_kmsg_size: record size (should be block size aligned) for KMSG logs.
	Default is 64KB.

Example:
	tegra_virt_storage31 {
		compatible = "nvidia,tegra-hv-oops-storage";
		status = "okay";
		pstore_max_reason = <2>;
		pstore_kmsg_size = <0x10000>;
		instance = <31>;
		ivc = <&tegra_hv 230>;
		mempool = <69>;
	};
```

## kernel/nvidia/Documentation/devicetree/bindings/block/tegra_virt_storage/tegra-hv-storage.txt
```
Tegra Virtual Storage driver

Virtual Storage Driver is the front end driver that interfaces with the
Storage Virtualization System for Tegra SOC and provides a block device
interface

Required Properties:
- compatible: should be "nvidia,tegra-hv-storage"
- instance:   to identify a specific instance of the device
- ivc:        ivc channel to used for communication with Virtualization System
- mempool:    mempool used for data transfers with Virtualization System

Example:
	tegra_virt_storage0 {
		compatible = "nvidia,tegra-hv-storage";
		instance = <0>;
		ivc = <&tegra_hv 63>;
		mempool = <10>;
		status = "okay";
	};
```

## kernel/nvidia/Documentation/devicetree/bindings/clk/nvidia,tegra-bpmp-clks.txt
```
BPMP Clocks

Binding for the BPMP clock driver.

Required properties:
- compatible: Must be "nvidia,tegra-bpmp-clks"
- reg: Should be 0
- #clock-cells: Should be 1

Example:

        bpmp_clks: clock@0 {
                compatible = "nvidia,tegra-bpmp-clks";
                reg = <0x0 0x0 0x0 0x0>;
                #clock-cells = <1>;
        };
```

## kernel/nvidia/Documentation/devicetree/bindings/clocksource/nvidia,tegra186-timer.txt
```
NVIDIA Tegra timers

This device node specifies the properties of Nvidia designed timer hardware.

Unlike ARM architectured timers, these Tegra timers are not part of CPU,
instead, they are part of SoC.

Required Properties:
 - compatible: should be set to "nvidia,tegra186-timer"
 - interrupts: interrupt mapping for supported timers.
 - clock-frequency: timer frequency, an 32b integer.
 - reg: address range for configuration registers
 - tmr-count: the maximum number of supported timer units
 - wdt-count: the maximum number of supported watchdog timer units

Not all timers in the node need to be used.

Example:

	timer@3020000 {
		compatible = "nvidia,tegra186-timer";
		interrupts = <0 0 4>,
			     <0 1 4>,
			     <0 2 4>,
			     <0 3 4>,
			     <0 4 4>,
			     <0 5 4>,
		clock-frequency = <19200000>;
		reg = <0x0 0x03010000 0x0 0x000e0000>;
		tmr-count = <10>;
		wdt-count = <3>;
		status = "disabled";
	};
```

## kernel/nvidia/Documentation/devicetree/bindings/cpufreq/tegra_cpufreq_t194.txt
```
* Device tree binding for Nvidia Tegra194 cpufreq driver
--------------------------------------------

This document defines the device-specific binding for the Tegra194 cpufreq
driver. It does not contain bindings for generic tegra cpufreq driver
which are common across all the tegra cpufreq platform driver.

The Tegra194 cpufreq driver makes frequency request by writing frequency hints
to per-core system register. It calculates per core cpufreq by reading per core
cycle counters. Cycles are measured by reading from system register twice, with
sufficient delay in between, then dividing the number of CPU clock cycles by
reference clock cycles, and scaling the result with reference clock frequency.

Behind the scene CPU interacts with AVFS and BPMP-FW to adjust CPU rail voltage
for the desired frequency.

Required properties:
- compatible: should be "nvidia,tegra194-cpufreq".

- cpu_emc_map: an array of pairs of 32-bit unsigned integers.

               the first entry in each pair is the CPU frequency in khz
               the second entry in each pair is the EMC frequency in khz

               essentially, this is a table mapping the requested CPU
               frequency to the corresponding EMC frequency floor:

                     floor(requested_cpu_frequency) --> emc frequency

               the purpose is to maintain a good level of external memory
               bandwidth with the given CPU rate.

- status: "okay" or "disabled" to enable/disable the node.

Optional properties:
- cpufreq_single_policy
  If this property exists, all 8 CPUs in tegra194 share the same cpufreq policy
  If this property doesn't exist, one cpufreq policy is created for each cluster

- freq_table_step_size:
  A property of 16-bit unsigned integer.  Cpu frequency table step size.
  If not provided, frequency step is set to the 50MHz by default. The table step
  size is rounded to AVFS update frequency multiple when applied to CPU
  frequency table construction.

- nvidia,autocc3-freq: autocc3 cluster freq.
  This property is a list of 32-bit unsigned integers.
  If a cluster goes in idle, cc3 freq will be requested for that cluster.
  This property will be ignored if auto-cc3 is disabled in BPMP-FW.

  The 1st entry is the cc3 freq for the 1st cluster, the 2nd entry is the
  cc3 freq for the 2nd cluster, the 3rd entry is the cc3 freq for the 3rd
  cluster, the 4th entry is the cc3 freq for the 4th cluster.

  If auto-cc3 is enabled, but this property does not exist, or less than
  4 entries are in the list, the autocc3-freq will be calculated with
  parameters returned in BPMP-FW query response for the clusters without
  auto-cc3 frequency in the device tree.

Example 1: everything
----------
	cpufreq {
		compatible = "nvidia,tegra194-cpufreq";
		status = "okay";
                cpu_freq_single_policy;
                freq_table_step_size = /bits/ 16 <0x6>;
                nvidia,autocc3-freq = <0 0 0 0>;
		cpu_emc_map = <2112000  2133000>,
				<1881600 800000>,
				<1574400 665000>,
				<1267200 408000>;
	};

Example 2: policy per cluster, default step size, no autocc3-freq
----------
	cpufreq {
		compatible = "nvidia,tegra194-cpufreq";
		status = "okay";
		cpu_emc_map = <2112000  2133000>,
				<1881600 800000>,
				<1574400 665000>,
				<1267200 408000>;
	};
```

## kernel/nvidia/Documentation/devicetree/bindings/cpuidle/nvidia,cpuidle-tegra.txt
```
NVIDIA TEGRA cpuidle driver and Idle states

ARM provides cpu-idle-state node to define the cpuidle states, as defined in
Documentation/devicetree/bindings/arm/idle-states.txt
cpuidle-tegra19x is the cpuidle driver for Tegra T19X SoCs and uses these idle
states. Idle states have different enter/exit latency and residency values.
The idle states supported by the TEGRA SoC are defined as -

    * Core Clock Gating(C1)
    * Core Virtual Power Gating(C6)
    * Core Power Gating(C7)
    * Cluster Clock Gating(CC1)
    * Cluster Power Gating(CC6)

Required properties for cpuidle driver:

- compatible: Must be "nvidia,tegra19x-cpuidle"
- status: Must be "okay" or "disabled"

Optional properties for Idle states:

- compatible: "nvidia,tegra194-cpuidle-core"
		"nvidia,tegra194-cpuidle-cluster"
		"nvidia,tegra194-cpuidle-thresholds"

Other required and optional properties are specified in
Documentation/devicetree/bindings/arm/idle-states.txt

Tegra specific Idle state properties:

- power: Average in-state power consumed by core/cluster idle state.
- pmstate: Numeric identification of the power states.
		Higher the number deeper the power saving.
- crossover_c1_c6: Idle time in micro seconds when C6 power state starts
			to get more efficient than C1. Below this threshold C1 is more optimal.
- crossover_cc1_cc6: Idle time in micro seconds when CC6 power state starts
			to get more efficient than CC1. Below this threshold CC1 is more optimal.

Example:

	cpus {
		CPU_CORE_POWER_STATES: cpu_core_power_states {
			compatible = "nvidia,tegra194-cpuidle-core";

			C1: c1 {
				compatible = "nvidia,tegra194-cpuidle-core";
				state-name = "Clock gated";
				wakeup-latency-us = <1>;
				min-residency-us = <1>;
				power = <70>;
				pmstate = <0x1>;
				status = "okay";
			};
			C6: c6 {
				compatible = "nvidia,tegra194-cpuidle-core";
				state-name = "Virtual core powergate";
				wakeup-latency-us = <2000>;
				min-residency-us = <0xffffffff>;
				power = <60>;
				pmstate = <0x6>;
				arm,psci-suspend-param= <0x6>;
				status = "okay";
			};
			C7: c7 {
				compatible = "nvidia,tegra194-cpuidle-core";
				state-name = "Core powergate";
				wakeup-latency-us = <560>;
				min-residency-us = <0xffffffff>;
				power = <60>;
				pmstate = <0x7>;
				arm,psci-suspend-param= <0x40000007>;
				status = "disabled";
			};
		};

		cpu_cluster_power_states {
			compatible = "nvidia,tegra194-cpuidle-cluster";
			cc6 {
				state-name = "Cluster powergate";
				wakeup-latency-us = <5000>;
				min-residency-us = <0xffffffff>;
				power = <19>;
				pmstate = <0x6>;
				status = "okay";
			};
		};

		cpu_crossover_thresholds {
			compatible = "nvidia,tegra194-cpuidle-thresholds";

			thresholds {
				crossover_c1_c6         = <30000>;
				crossover_cc1_cc6       = <80000>;
			};
		};
	};
```

## kernel/nvidia/Documentation/devicetree/bindings/crypto/nvidia,tegra186-hv-vse.txt
```
TEGRA Virtual SE CRYPTO Interface Module

Required properties :
 - compatible : Must contain "nvidia,tegra186-hv-vse".
 - se-engine-id : SE engine ID.
 - ivc : Id number of the IVC queue to use.
 - iommus : Reference to the IOMMU.
     See Documentation/devicetree/bindings/iommu/iommu.txt for details.

Example:
	vse@15810000 {
		compatible = "nvidia,tegra186-hv-vse";
		se-engine-id = <0>;
		iommus = <&smmu TEGRA_SID_SE_VM0>;
		ivc = <76>;
	};
```

## kernel/nvidia/Documentation/devicetree/bindings/crypto/tegra-se-elp.txt
```
TEGRA SE ELLIPTIC PKA1/RNG1 Crypto Module

This module enables support for PKA1 features that include RSA/ECC internally
and RNG1.

Required properties:

- compatible : Should be one of :
  - For T210, use "nvidia,tegra210b01-se-elp".
  - For T186, use "nvidia,tegra186-se-elp".
  - For T194, use "nvidia,tegra194-se-elp".
- reg : Offset and length of the register set for the module.
- interrupts: Interrupt numbers.

Optional properties:

- pka1-rsa-priority : cra_priority of the algorithm.

Example:
	se: se_pka1@3ad0000 {
		compatible = "nvidia,tegra186-se-elp";
		reg = <0x0 0x03ad0000 0x0 0x10000>,
		      <0x0 0x03ae0000 0x0 0x10000>;
		interrupts = <0 283 0x04>;
		pka1-rsa-priority = <300>;
	};
```
