## kernel/nvidia/Documentation/devicetree/bindings/crypto/tegra-se-nvrng.txt
```
TEGRA SE NVRNG Error Handling Module

Required properties :
 - compatible : Must contain "nvidia,tegra234-se-nvrng".
 - interrupts : Exactly one interrupt specifier.

Example:
	se: se_ahb@3ae0000 {
		compatible = "nvidia,tegra234-se-nvrng";
		reg = <0x0 0x03ae0000 0x0 0x10000>;
		interrupts = <0 284 0x04>;
		clocks = <&bpmp_clks TEGRA234_CLK_SE>;
		clock-names = "se";
		status = "disabled";
	};
```

## kernel/nvidia/Documentation/devicetree/bindings/dma/nvidia,tegra186-gpcdma.txt
```
Tegra GPCDMA controller.

Tegra GPCDMA controller is a general purpose dma used by multiple slave
devices for faster transfers. It can support mem to mem, mem to io and
io to mem transfers.

Required properties :
- compatible :
  For Tegra186, must contain "nvidia,tegra186-gpcdma".
  For Tegra194, must contain "nvidia,tegra194-gpcdma" and supports pause mode.
- reg : Should contain gpcdma reg offset location and length.
- interrupts : Should contain list of interrupts for all channels.
- resets : Must contain handle for each entry in reset-names.
  See ../reset/reset.txt for details.
- reset-names : Must include "gpcdma".

Optional properties:
- nvidia,preallocated-descs : number of preallocated dma descs to avoid
  allocating at runtime.
- nvidia,preallocate-sg : number of preallocated scatter gather buffers to
  avoid allocating at runtime.
- nvidia,stream-id : smmu stream id for gpcdma.
- nvidia,bypass-smmu : skip using smmu and change stream id to bypass id.
- nvidia,start-dma-channel-index : starting index of dma channels, defaults to
  zero.
- dma-channels : number of channels available. when not updated, data is
  collected from chip data.

Example :
gpcdma: dma@2600000 {
	compatible = "nvidia,tegra186-gpcdma";
	reg = <0x0 0x2600000 0x0 0x210000>;
	resets = <&tegra_car TEGRA186_RESET_GPCDMA>;
	reset-names = "gpcdma";
	interrupts = <0 75 0x04
		      0 76 0x04
		      0 77 0x04
		      0 78 0x04
		      0 79 0x04
		      0 80 0x04
		      0 81 0x04
		      0 82 0x04
		      0 83 0x04
		      0 84 0x04
		      0 85 0x04
		      0 86 0x04
		      0 87 0x04
		      0 88 0x04
		      0 89 0x04
		      0 90 0x04
		      0 91 0x04
		      0 92 0x04
		      0 93 0x04
		      0 94 0x04
		      0 95 0x04
		      0 96 0x04
		      0 97 0x04
		      0 98 0x04
		      0 99 0x04
		      0 100 0x04
		      0 101 0x04
		      0 102 0x04
		      0 103 0x04
		      0 104 0x04
		      0 105 0x04
		      0 106 0x04
		      0 107 0x04>;
	#dma-cells = <1>;
	iommus = <&smmu TEGRA_SID_GPCDMA_0>;
	nvidia,preallocated-descs = <32>;
	nvidia,preallocate-sg = <32>;
	status = "disabled";
};
```

## kernel/nvidia/Documentation/devicetree/bindings/drm/nvidia,tegra-udrm.txt
```
NVIDIA UDRM driver to support userspace drm-nvdc driver

Tegra UDRM driver adds Kernel DRM support for user mode DRM driver on Tegra.
OSS DRM clients expect DRM driver node like "/dev/dri/card0" to be present and
this driver exposes this node. These clients do do open()/close() on this node
and pass the obtained fd to UMD  DRM driver (libdrm_nvdc.so). These clients
also tend to do poll()/read() and mmap().

To support such clients, tegra udrm driver registers with DRM framework and
provides following ioctls:
- DRM_IOCTL_TEGRA_UDRM_DMABUF_MMAP
- DRM_IOCTL_TEGRA_UDRM_DMABUF_DESTROY_MAPPINGS
- DRM_IOCTL_TEGRA_UDRM_CLOSE_NOTIFY
- DRM_IOCTL_TEGRA_UDRM_SEND_VBLANK_EVENT
- DRM_TEGRA_UDRM_DROP_MASTER_NOTIFY
- DRM_TEGRA_UDRM_SET_MASTER_NOTIFY
- DRM_TEGRA_UDRM_SEND_CONNECTOR_STATUS_EVENT

Required properties:

   - compatible = "nvidia,tegra-udrm";

Example:

	tegra_udrm: tegra_udrm {
		compatible = "nvidia,tegra-udrm";
	};
```

## kernel/nvidia/Documentation/devicetree/bindings/extcon/extcon-disp-state.txt
```
Device tree bindings for NVIDIA extcon-disp-state driver.

Extcon driver for display accessory detection compatible with switch-mid.

Required properties :
 - compatible : Should be "extcon-disp-state".
 - #extcon-cells : Should be 1.

Example :

	external-connection {
		disp-state {
			compatible = "extcon-disp-state";
			#extcon-cells = <1>;
		};
	};
```

## kernel/nvidia/Documentation/devicetree/bindings/firmware/nvidia,tegra186-bpmp-thermal.txt
```
BPMP THERMAL

Binding for the BPMP thermal driver.

Required properties:
- compatible: Must be "nvidia,tegra186-bpmp-thermal"
- #thermal-sensor-cells: Should be 1

Example:

	bpmpthermal {
		compatible = "nvidia,tegra186-bpmp-thermal";
		#thermal-sensor-cells = <1>;
	};
```

## kernel/nvidia/Documentation/devicetree/bindings/firmware/nvidia,tegra186-bpmp.txt
```
NVIDIA Tegra Boot and Power Management Processor (BPMP)

The BPMP is a specific processor in Tegra chip, which is designed for
booting process handling and offloading the power management, clock
management, and reset control tasks from the CPU. The binding document
defines the resources that would be used by the BPMP firmware driver,
which can create the interprocessor communication (IPC) between the CPU
and BPMP.

Required properties:
- name : Should be bpmp
- compatible:
    Array of strings
    One of:
    - "nvidia,tegra186-bpmp"
    - "nvidia,tegra186-bpmp-hv"
    - "nvidia,tegra194-safe-bpmp-hv"
    Compatible string with "-hv" at the end means the the driver runs on a
    Virtualized System and the one without "-hv" means the driver runs on a
    Native system(without Hypervisor).
    The only difference between them is the communication channel.
    In native case,the sysram memory and doorbell are used for communication
    with bpmp firmware but in virtualization, ivc/mempool is used for
    communication with the Virtualized System that in turn interacts with the
    BPMP firmware
- dma-coherent: Must be present
- #power-domain-cells : Should be 1.
- #strap-cells: Should be 1
- #nvidia,controller-id-cells: Should be 1
- iommus: Phandle to the SMMU specifier
- reg: Three { base-address, size } pairs where first pair contains the
  bpmp register space, the second containing IPC TX shared memory and
  the third containing IPC RX shared memory.

Optional properties:
  The following properties are required only in the Virtualized driver
- ivc_queue: ivc channel used for communication with Virtualization System
- mempool: mempool used for data transfers with Virtualization System

Example:

	bpmp: bpmp {
		compatible = "nvidia,tegra186-bpmp";
		iommus = <&smmu TEGRA_SID_BPMP>;
		dma-coherent;
		reg = <0x0 0x0d000000 0x0 0x00800000>,
			<0x0 0x4004e000 0x0 0x00001000>,
			<0x0 0x4004f000 0x0 0x00001000>;
		status = "disabled";
		#power-domain-cells = <1>;
		#strap-cells = <1>;
		#nvidia,controller-id-cells = <1>;

		bpmpthermal {
			...
		};
	};
```

## kernel/nvidia/Documentation/devicetree/bindings/i2c/nvidia,tegra186-bpmp-i2c.txt
```
NVIDIA Tegra186/Tegra194 BPMP I2C controller

In Tegra186/Tegra194, the BPMP (Boot and Power Management Processor) owns
certain HW devices, such as the I2C controller for the power management I2C
bus. Software running on other CPUs must perform IPC to the BPMP in order
to execute transactions on that I2C bus. This binding describes an I2C bus
that is accessed in such a fashion.

This node represents an I2C controller. See ../i2c/i2c.txt for details of the
core I2C binding.

Required properties:
- compatible:
    Array of strings.
    One of:
    - "nvidia,tegra186-bpmp-i2c".
- #address-cells: Address cells for I2C device address.
    Single-cell integer.
    Must be <1>.
- #size-cells:
    Single-cell integer.
    Must be <0>.
- adapter:
    Single-cell integer.
    Indicates the I2C bus number this DT node represent, as defined by the
    BPMP firmware.

Example:

bpmp_i2c {
	compatible = "nvidia,tegra186-bpmp-i2c";
	#address-cells = <1>;
	#size-cells = <0>;
	adapter = <5>;
};
```

## kernel/nvidia/Documentation/devicetree/bindings/i2c/tegra-i2c-hv.txt
```
Tegra Virtual I2C driver

Virtual I2C Driver is the front end driver that interfaces with the
I2C Virtualization System for Tegra SOC

Required Properties:
- compatible: Must be one of the the following based on the SOC:
		nvidia,tegra124-i2c-hv
		nvidia,tegra210-i2c-hv
		nvidia,tegra186-i2c-hv
		nvidia,tegra194-i2c-hv
- ivc_queue: ivc queue that is used by the driver to communicate with the
             server
- clock-frequency: frequency of bus clock in Hz


Example:
	i2c@3160000 {
		compatible = "nvidia,tegra194-i2c-hv";
		status = "okay";
		clock-frequency = <100000>;
		ivc_queue = <&tegra_hv 0x38>;
	};
```

## kernel/nvidia/Documentation/devicetree/bindings/interrupt-controller/nvidia,tegra186-pm-irq.txt
```
Tegra PM interrupt Controller

Interrupts from power management unit.

Required properties:
- compatible :
  for Tegra186, "nvidia,tegra186-pm-irq",
  for Tegra194, "nvidia,tegra194-pm-irq".
- interrupt-controller : Identifies the node as an interrupt controller.
- #interrupt-cells : Specifies the number of cells needed to encode an
  interrupt source. The value must be 3.
- interrupt-parent : a phandle to the GIC these interrupts are routed
  to.

Example:

	pm_irq: tegra186-pm-irq {
		compatible = "nvidia,tegra186-pm-irq";
		interrupt-controller;
		#interrupt-cells = <3>;
		interrupt-parent = <&intc>;
		status = "disabled";
	};
```

## kernel/nvidia/Documentation/devicetree/bindings/media/i2c/imx219.txt
```
Sony IMX219 CMOS Image Sensor, NVIDIA TCF driver bindings

The Sony IMX219 is an 8.08 MP CMOS colour image sensor; the following Device
Tree bindings are for the NVIDIA Tegra Camera Framework (TCF) driver, for use on
embedded NVIDIA Tegra SOC platforms.

Camera-board specific overlays are applied by the NVIDIA Tegra plugin-manager
pre-boot, they define the physical regulator and GPIO connections which differ
by the Jetson board and chip generation, and the camera daughter board revision.

Required properties:
	- compatible: Should be "sony,imx219".
	- sensor_model: Name of sensor, should be "imx219".
	- reg: Sensor I2C bus address, default is 0x10.
	- modeXY: Please see tegra-camera-framework.txt for DT bindings.

	- avdd-reg: Name of analog power regulator.
	- vana-supply: Analog power source (2.80 V).
	- iovdd-reg: Name of interface power regulator.
	- vif-supply: Interface power source (1.80 V).
	- dvdd-reg: Name of digital power regulator.
	- vdig-supply: Digital power source (1.20 V).

	- clocks: All clocks from the Tegra SoC used to drive sensor.
	- clock-names: Names of the above clocks.
	- mclk: Name of the MIPI clock (aka. INCK) driven from the Tegra SOC.
	- clock-frequency: Frequency of the mclk source [Hz].
	- reset-gpios: GPIO(s) used to ouput reset/enable signal.
	- pwdn-gpios: GPIO(s) used to enable/disable sensor power.

Optional properties:
	- physical_w: Horizontal width of active surface [mm].
	- physical_h: Vertical height of active surface [mm].

	- has_eeprom: Property is present if there is a sensor-external EEPROM.
	- fuse_id_start_addr: Sensor-internal fuse base I2C address.

	- use_sensor_mode_id: Whether to enable use of the V4L2
		CID_SENSOR_MODE_ID control, which enables explicit sensor mode
		enumeration and selection. (Default: false)

	- delayed_gain: Whether gain settings should be offset by one frame to
		be in sync w/ exposure settings (takes effect on n+2 frame).
		 (Default: false)
	- use_decibel_gain: Whether to convert gain to dB units before passing
		to driver. (Default: false)
	- post_crop_frame_drop: Number of frames to silently discard following
		application of crop settings, as the initial ones may be
		corrupted. (Default: 0)
	- limit_analog_gain: Enable as a WAR to prevent banding for the IMX185
		sensor. (Default: false)

	- nvidia,gmsl-ser-device: MIPI CSI-2 serializer device node.
	- nvidia,gmsl-dser-device: MIPI CSI-2 deserializer device node.

Deprecated properties:
	- devnode: Name of V4L2 character device in filesystem, this property is
		now deprecated, the Tegra Camera Framework enumerates them
		automatically.
	- dovdd-supply: Digital I/O power source (1.80 V), should use vif-supply
		for new drivers.

Example:

	imx219_a@10 {
		devnode = "video0";
		compatible = "nvidia,imx219";
		reg = <0x10>;

		physical_w = "5.095";
		physical_h = "4.930";

		sensor_model ="imx219";
		dovdd-supply = <&en_vdd_cam>;
		avdd-reg = "vana";
		dvdd-reg = "vdig";
		iovdd-reg = "dovdd";

		mode<0..N-1> {
			...
		};
	};

	/* Camera board-specific config overlay */
	imx219_a@10 {
		clocks = <&tegra_car TEGRA186_CLK_EXTPERIPH1>;
		clock-names = "extperiph1";
		mclk = "extperiph1";
		reset-gpios = <&tca6408_21 0 GPIO_ACTIVE_HIGH>;
		vana-supply = <&en_vdd_cam_hv_2v8>;
		vdig-supply = <&en_vdd_sys>;
		dovdd-supply = <&en_vdd_cam>;
	};
```

## kernel/nvidia/Documentation/devicetree/bindings/media/i2c/imx268.txt
```
Sony IMX268 CMOS Image Sensor, NVIDIA TCF driver bindings

The Sony IMX268 is an 8.29 MP CMOS colour image sensor; the following Device
Tree bindings are for the NVIDIA Tegra Camera Framework (TCF) driver, for use on
embedded NVIDIA Tegra SOC platforms.

Camera-board specific overlays are applied by the NVIDIA Tegra plugin-manager
pre-boot, they define the physical regulator and GPIO connections which differ
by the Jetson board and chip generation, and the camera daughter board revision.

Required properties:
	- compatible: Should be "sony,imx268".
	- sensor_model: Name of sensor, should be "imx268".
	- reg: Sensor I2C bus address, default is 0x1a.
	- modeXY: Please see tegra-camera-framework.txt for DT bindings.

	- avdd-reg: Name of analog power regulator.
	- vana-supply: Analog power source (2.80 V).
	- iovdd-reg: Name of interface power regulator.
	- vif-supply: Interface power source (1.80 V).
	- dvdd-reg: Name of digital power regulator.
	- vdig-supply: Digital power source (1.20 V).

	- clocks: All clocks from the Tegra SoC used to drive sensor.
	- clock-names: Names of the above clocks.
	- mclk: Name of the MIPI clock (aka. INCK) driven from the Tegra SOC.
	- clock-frequency: Frequency of the mclk source [Hz].
	- reset-gpios: GPIO(s) used to ouput reset/enable signal.
	- pwdn-gpios: GPIO(s) used to enable/disable sensor power.

Optional properties:
	- physical_w: Horizontal width of active surface [mm].
	- physical_h: Vertical height of active surface [mm].

	- has_eeprom: Property is present if there is a sensor-external EEPROM.
	- fuse_id_start_addr: Sensor-internal fuse base I2C address.

	- use_sensor_mode_id: Whether to enable use of the V4L2
		CID_SENSOR_MODE_ID control, which enables explicit sensor mode
		enumeration and selection. (Default: false)

	- delayed_gain: Whether gain settings should be offset by one frame to
		be in sync w/ exposure settings (takes effect on n+2 frame).
		 (Default: false)
	- use_decibel_gain: Whether to convert gain to dB units before passing
		to driver. (Default: false)
	- post_crop_frame_drop: Number of frames to silently discard following
		application of crop settings, as the initial ones may be
		corrupted. (Default: 0)
	- limit_analog_gain: Enable as a WAR to prevent banding for the IMX185
		sensor. (Default: false)

	- nvidia,gmsl-ser-device: MIPI CSI-2 serializer device node.
	- nvidia,gmsl-dser-device: MIPI CSI-2 deserializer device node.

Deprecated properties:
	- devnode: Name of V4L2 character device in filesystem, this property is
		now deprecated, the Tegra Camera Framework enumerates them
		automatically.
	- dovdd-supply: Digital I/O power source (1.80 V), should use vif-supply
		for new drivers.

Example:

	imx268_a@1a {
		compatible = "sony,imx268";
		/* I2C device address */
		reg = <0x1a>;

		/* V4L2 device node location */
		devnode = "video0";

		/* Physical dimensions of sensor */
		physical_w = "4.337";
		physical_h = "2.455";

		sensor_model = "imx268";

		/* Define any required hw resources needed by driver */
		/* ie. clocks, io pins, power sources */
		avdd-reg = "vana";
		iovdd-reg = "vif";
		dvdd-reg = "vdig";

		mode<0..N-1> {
			...
		};
	};
```
