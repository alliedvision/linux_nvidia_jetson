## kernel/nvidia/drivers/pci/dwc/Kconfig
```kconfig
config PCIE_TEGRA
	tristate

config PCIE_TEGRA_HOST
	tristate "Tegra194 PCIe Host Mode"
	depends on ARCH_TEGRA
	depends on PCI
	depends on PCI_MSI_IRQ_DOMAIN
	select PCIE_DW_HOST
	select PCIE_TEGRA
	help
	 Say Y here if you want to enable root port mode functionality of the
	 PCIe controllers found in Tegra T19x SoC. Selecting this alone doesn't
	 enable the DMA functionality built into the root port

config PCIE_TEGRA_EP
	tristate "Tegra194 PCIe Endpoint Mode"
	depends on ARCH_TEGRA
	depends on PCI_ENDPOINT
	select PCIE_DW_EP
	select PCIE_TEGRA
	help
	 Enables support for the PCIe controller in the Tegra (T19x) SoC
	 to work in endpoint mode.

if PCIE_TEGRA

config PCIE_TEGRA_DW_DMA_TEST
	bool "DMA test framework"
	depends on PCIE_TEGRA_HOST
	help
	 Say Y here if you want to enable test framework for the DMA which is
	 integrated into root port. Please note that this framework should be
	 used only for testing purposes and enabling it would have security
	 implications. If you are not sure, select NO.

config PCIE_TEGRA_DW_LANE_MARGIN
	bool "PCIe Gen4 lane margining test"
	help
	 Say Y here if you want to enable test framework for the PCIe Gen4
	 lane margining. Please note that this framework should be used only
	 for testing purposes. If you are not sure, select NO.

config PCIE_TEGRA_DW_TWO_SIDE_LANE_MARGIN
	bool "PCIe two side lane margining"
	depends on PCIE_TEGRA_DW_LANE_MARGIN
	help
	 Say Y here if you want to execute PCIe Gen4 lane margining on both sides.
	 Please note that this framework should be used only for testing purposes.
	 If you are not sure, select NO.
endif
```

## kernel/nvidia/drivers/pci/endpoint/functions/Kconfig
```kconfig
#
# Tegra PCIe Endpoint Test Function
#

config PCIE_EPF_NV_TEST
	tristate "Tegra PCIe Endpoint Test driver"
	depends on PCI_ENDPOINT
	help
	   Enable this configuration option to enable the test driver
	   for Tegra PCIe Endpoint.

	   If in doubt, say "N" to disable Tegra PCIe Endpoint test driver.

config PCIE_EPF_TEGRA_VNET
	tristate "Tegra PCIe Endpoint virtual network driver"
	depends on PCI_ENDPOINT
	help
	   Enable this configuration option to enable the virtual network
	   driver for Tegra PCIe Endpoint.

	   If in doubt, say "N" to disable Tegra PCIe Endpoint virtual
	   network driver.

config PCIE_EPF_DMA_TEST
	tristate "Tegra PCIe DMA test driver"
	depends on PCI_ENDPOINT
	help
	   Enable this configuration option to enable the DMA test framework
	   for Tegra PCIe Endpoint.

	   If in doubt, say "N" to disable Tegra PCIe DMA test driver.
```

## kernel/nvidia/drivers/pci/host/Kconfig
```kconfig
config PCIE_TEGRA_DW
	tristate "NVIDIA Tegra DesignWare Core based PCIe controller"
	depends on ARCH_TEGRA
	select PCIEPORTBUS
	select PCIE_DW
	help
	 Say Y here if you want support for the next gen PCIe host controller
	 which is based on Synopsys DesignWare IP suite found on next gen
	 NVIDIA Tegra SoCs.

config PCIE_TEGRA_DW_DMA_TEST
	bool "DMA test framework"
	depends on PCIE_TEGRA_DW
	help
	 Say Y here if you want to enable test framework for the DMA which is
	 integrated into root port. Please note that this framework should be
	 used only for testing purposes and enabling it would have security
	 implications. If you are not sure, select NO.

config PCIE_TEGRA_DW_LANE_MARGIN
	bool "PCIe Gen4 lane margining test"
	depends on PCIE_TEGRA_DW
	help
	 Say Y here if you want to enable test framework for the PCIe Gen4
	 lane margining. Please note that this framework should be used only
	 for testing purposes. If you are not sure, select NO.

config PCIE_TEGRA_DW_TWO_SIDE_LANE_MARGIN
	bool "PCIe two side lane margining"
	depends on PCIE_TEGRA_DW_LANE_MARGIN
	help
	 Say Y here if you want to execute PCIe Gen4 lane margining on both sides.
	 Please note that this framework should be used only for testing purposes.
	 If you are not sure, select NO.
```

## kernel/nvidia/drivers/pinctrl/Kconfig
```kconfig
# SPDX-License-Identifier: GPL-2.0
append_menu "Pin controllers"

config PINCTRL_TEGRA186
	bool "NVIDIA Tegra186 Pinmux support"
	select PINCTRL_TEGRA
	default y if ARCH_TEGRA_18x_SOC
	help
	Support for the NVIDIA Tegra186 PINCTRL controller driver.

config PINCTRL_TEGRA186_PADCTL
	bool "NVIDIA Tegra186 XUSB PADCTL Driver"
	depends on ARCH_TEGRA_18x_SOC
	depends on MAILBOX
	select GENERIC_PHY
	select PINCONF
	select PINMUX

config PINCTRL_TEGRA186_DPAUX
	bool "NVIDIA Tegra186 DP AUX Pinctrl Driver"
        depends on ARCH_TEGRA_18x_SOC || ARCH_TEGRA_186_SOC || ARCH_TEGRA_194_SOC
        select PINCONF
        select PINMUX

config PINCTRL_TEGRA194
	bool "NVIDIA Tegra194 Pinmux support"
	select PINCTRL_TEGRA
	default y if ARCH_TEGRA_19x_SOC
	help
	Support for the NVIDIA Tegra194 PINCTRL controller driver.

config PINCTRL_TEGRA194_PEXCLK_PADCTL
	bool "NVIDIA Tegra194 PCIE PEXCLK PADCTL Driver"
	depends on ARCH_TEGRA_19x_SOC
	select PINCONF
	select PINMUX
	help
	  Support for the NVIDIA Tegra194 PCIE PEXCLK Padcontrol
	  configurations. This will provide the mechanism to dynamically
	  select the functionality between camera and PCIE.

config PINCTRL_TEGRA234_DPAUX
        bool "NVIDIA Tegra234 DP AUX Pinctrl Driver"
        depends on ARCH_TEGRA_23x_SOC || ARCH_TEGRA_234_SOC
        select PINCONF
        select PINMUX

config PINCTRL_TEGRA234
	bool "NVIDIA Tegra234 Pinmux support"
	select PINCTRL_TEGRA
	default y if ARCH_TEGRA_23x_SOC
	help
	Support for the NVIDIA Tegra234 PINCTRL controller driver.

endmenu
```

## kernel/nvidia/drivers/pinctrl/tegra/Kconfig
```kconfig
# SPDX-License-Identifier: GPL-2.0-only
config PINCTRL_TEGRA234
	bool
	select PINCTRL_TEGRA
```
