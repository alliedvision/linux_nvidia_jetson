## kernel/nvidia/drivers/tty/serial/Kconfig
```kconfig
if TTY

source "drivers/tty/serial/wch_35x/Kconfig"

config TEGRA_COMBINED_UART
	bool "Tegra combined UART"
	depends on ARCH_TEGRA_18x_SOC
	default n
	help
	  Tegra combined UART is a client-server model which allows a server
	  running on SPE to multiplex a single UART controller amongst multiple
	  UART clients.

	  This config enables the Linux client driver. Instead of
	  directly bit banging the UART controller, the client driver
	  communicates with the SPE server using mailbox registers. The SPE
	  server multiplexes the UART controller amongst the various clients.
	  This allows all the clients to send output and receive input through a
	  single UART controller.

	  Combined-uart uses 'ctrl /' as break-signal for SysRq, for example:
	  'ctrl / + h' for sysrq-help.

config TEGRA_COMBINED_UART_EARLY
	bool "Tegra combined UART early printk driver"
	depends on ARCH_TEGRA_18x_SOC || ARCH_TEGRA_186_SOC
	default n
	help
	  Tegra combined UART is a client-server model which allows a server
	  running on SPE to multiplex a single UART controller amongst multiple
	  UART clients.

	  This config enables the Linux client driver. With
	  this driver we are adding support for early printk
	  so that we can get early boot logs of kernel even before
	  initialization of serial driver itself.

config TEGRA_HV_COMM
	tristate "Tegra Hypervisor Communication"
	depends on TEGRA_HV_MANAGER
	help
	  Add support for emulating a TTY device over the Tegra Hypervisor interface.

	  To compile this driver as a module, choose M here: the
	  module will be called tegra_hv_comm.

config SERIAL_TEGRA_NOHW
	tristate "NVIDIA Tegra186 High Speed serial controller without HW flow ontrol"
	depends on ARCH_TEGRA && TEGRA20_APB_DMA || TEGRA186_GPC_DMA
	default n
	select SERIAL_CORE
	help
	  Similar driver as SERIAL_TEGRA, but without HW flow control support

endif
```

## kernel/nvidia/drivers/tty/serial/wch_35x/Kconfig
```kconfig
if TTY

config PCI_SERIAL_CH384
	tristate "CH384 PCI  comp port VCP driver"
	depends on PCI
	default n
	help
	  PCIE to Quad Serial Ports and Printer Port Chip CH384 driver, CH384
	  is a PCI-Express bus converter chip, which converts PCIE bus to Quad
	  serial ports and printer port, including four asynchronous serial
	  ports compatible with 16C550 or 16C750.

	  If you are using multi-ports card such as CH384 + CH438 * n to achieve
	  12/16/20 serial ports etc. You can modify the uart amount variable
	  "PCIE_UART_MAX" defined in wch_devtable.c at about line 3, modify
	  the number 28 to the actual amount of serial ports
endif
```

## kernel/nvidia/drivers/video/tegra/host/Kconfig
```kconfig
if ARCH_TEGRA

config TEGRA_T23X_GRHOST
	bool "Tegra 23x graphics host driver"
	depends on TEGRA_GRHOST && ARCH_TEGRA_23x_SOC
	default y
	help
	  Driver for the Tegra graphics host hardware.

config TEGRA_T239_GRHOST
	bool "Tegra 239 graphics host driver"
	depends on TEGRA_GRHOST && ARCH_TEGRA_239_SOC
	default y
	help
	  Driver for the Tegra graphics host hardware.

config TEGRA_T23X_GRHOST_PVA
        bool "Tegra 23x PVA support"
        depends on TEGRA_GRHOST && ARCH_TEGRA_23x_SOC
        default y
        help
          Enables Programmable Vision Accelerator engine support under nvhost
          Say Y here if not sure.

config TEGRA_GRHOST_NVDLA
	bool "Tegra NVDLA support"
	depends on TEGRA_GRHOST && (ARCH_TEGRA_19x_SOC || ARCH_TEGRA_194_SOC)
	default y
	help
	  Enables Deep Learning Accelerator engine support under nvhost
	  Say N here if not sure.

config TEGRA_T19x_GRHOST_PVA
	bool "Tegra PVA support"
	depends on TEGRA_GRHOST && (ARCH_TEGRA_19x_SOC || ARCH_TEGRA_194_SOC)
	default y
	help
	  Enables Programmable Vision Accelerator engine support under nvhost
	  Say Y here if not sure.

config TEGRA_GRHOST_PVA
        bool "Tegra PVA support"
        depends on (TEGRA_T19x_GRHOST_PVA || TEGRA_T23X_GRHOST_PVA)
        default y
        help
          Enables Programmable Vision Accelerator engine support under nvhost
          Say Y here if not sure.

config TEGRA_GRHOST_SLVSEC
	bool "Tegra SLVS-EC support"
	depends on TEGRA_GRHOST && ( ARCH_TEGRA_19x_SOC || ARCH_TEGRA_194_SOC )
	default y if ARCH_TEGRA_19x_SOC
	help
	  Enables SLVS-EC Camera interface support under nvhost
	  Say Y here if not sure.

config TEGRA_GRHOST_CAPTURE_SUPPORT
	bool "Tegra camera capture support module"
	depends on VIDEO_TEGRA_VI && TEGRA_GRHOST_ISP
	default y
	help
	  Enables support module for camera capture using VI and ISP
	  Say Y here if not sure.

config TEGRA_NVDLA_TRACE_PRINTK
	bool "Enable trace_printk debugging in NVDLA driver"
	depends on FTRACE_PRINTK && TEGRA_GRHOST_NVDLA

config TEGRA_GRHOST_LEGACY_PD
	bool "Tegra legacy power domain API support"
	depends on TEGRA_GRHOST
	default TEGRA_POWERGATE
	help
	  Enables support for Tegra legacy power domain API
	  Say Y if using kernel version 4.9 or earlier

source "drivers/video/tegra/host/pva/Kconfig"

endif
```

## kernel/nvidia/drivers/video/tegra/host/pva/Kconfig
```kconfig
if ARCH_TEGRA

config PVA_CO_DISABLED
        bool "Tegra PVA FW CO disabled"
        depends on TEGRA_GRHOST
        default y
        help
          Allow PVA FW to be booted from file
          Say n here if not sure.
endif
```

## kernel/nvidia/drivers/virt/ptp/Kconfig
```kconfig
config TEGRA_HV_PTP
	tristate "Tegra Hypervisor PTP"
	depends on TEGRA_HV_MANAGER
	help
	  Say Y here to include support for the virtual PTP
	  in NVIDIA Tegra Hypervisor systems.

	  To compile this driver as a module, choose M here: the
	  module will be called tegra_hv_ptp.
```

## kernel/nvidia/sound/soc/Kconfig
```kconfig
if SND_SOC && (("$(VERSION)" < "6") && ("$(VERSION)" > "4"))
source "sound/soc/tegra-virt-alt/Kconfig"
endif

if SND_SOC && ("$(VERSION)" < "5")
source "sound/soc/tegra-alt/Kconfig"
endif
```

## kernel/nvidia/sound/soc/tegra-virt-alt/Kconfig
```kconfig
if SND_SOC

config SND_SOC_TEGRA210_ADSP_VIRT_ALT
	tristate "Tegra ADSP driver for virt"
	depends on SND_SOC_TEGRA_VIRT_T210REF_PCM && TEGRA_NVADSP

config SND_SOC_TEGRA_VIRT_T210REF_PCM
	tristate "Tegra210 virt PCM driver"
	depends on TEGRA_HV_MANAGER
	select SND_SOC_TEGRA_VIRT_IVC_COMM_DEFS
	help
	  Say Y or M if you want to add support for Tegra210 para-virtualized PCM audio.
	  The pcm driver exposes a number of playback and capture pcm interfaces. It uses
	  the native pcm driver for dma interface and ivc communication module for ivc.
	  The number of interfaces exposed is configurable via device tree.

endif
```

## kernel/nvidia/sound/tegra-safety-audio/Kconfig
```kconfig
config SND_T23X_SAFETY_I2S
	tristate "Nvidia T23x Safety I2S driver"
	depends on SND
	default m
	help
	  Standalone sound card driver for T234 Safety I2S module
```

## kerneltree/kernel/kernel-4.9/Documentation/devicetree/bindings/media/i2c/alliedvision,avt_csi2.txt
```
* Allied Vision 1 Camera

Allied Vision 1 is a line of cameras based on ALVIUM chip which serves as a
layer of abstraction between host device and image sensor providing unified
interface to supported sensors.

Required Properties:
- compatible: Must be "alliedvision,avt_csi2"

Optional Properties:
- csi_clk_freq: Desired CSI clock frequency
```

## kerneltree/kernel/kernel-4.9/drivers/net/wireless/rtl8822be/Kconfig
```kconfig
config RTL8822BE
	tristate "Realtek 8822B PCIE WiFi"
	depends on PCI
	---help---
	  This module adds supports for Realtek RTL8822BE wireless
	  chipset.

	  The driver module will be called wlan. Use M if unsure.
```

## kerneltree/kernel/kernel-4.9/drivers/virt/tegra/Kconfig
```kconfig
config	TEGRA_VIRTUALIZATION
	bool "Tegra Virtualization support"
	depends on ARCH_TEGRA_12x_SOC || ARCH_TEGRA_21x_SOC || ARCH_TEGRA_18x_SOC
	select VIRTUALIZATION
	default n
	help
	  Enable Tegra Virtualization support; turning this option on
	  enables features like the tegra virtualization manager and
	  all others than depend on it.

	  Select y to enable virtualization features on the tegra platforms
	  that support it.

config TEGRA_HV_MANAGER
	bool "Nvidia Tegra hypervisor management & IVC"
	depends on TEGRA_VIRTUALIZATION
	select NV_TEGRA_IVC
	help
	  The NVIDIA hypervisor management driver provides IVC channels
	  configured by the hypervisor.

	  Select Y to enable
```
