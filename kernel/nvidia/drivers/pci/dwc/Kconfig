## kernel/nvidia/drivers/platform/tegra/Kconfig
```kconfig
config DENVER_CPU
	bool "Denver CPU"
	help
	  Support for NVIDIA Denver CPU

config DENVER_MCA
	tristate "Denver Machine Check Handler"
	depends on DENVER_CPU
	select SERROR_HANDLER
	help
	  The Denver Machine Check handler. It collects and reports errors from
	  the Denver CPUs.

config TEGRA_AON
	bool "Tegra AON driver"
	depends on (ARCH_TEGRA_18x_SOC || ARCH_TEGRA_186_SOC)
	select NV_TEGRA_IVC

config TEGRA_ARI_MCA
	tristate "Tegra Abstract Request Interface (ARI) Machine Check"
	select SERROR_HANDLER
	help
	  The Tegra Abstract Request Interface (ARI) Machine Check handler. This
	  handles the Machine Check registers that are accessible via ARI.

config TEGRA_BRIDGE_MCA
	tristate "AXI/APB Bridge Machine Check"
	select SERROR_HANDLER
	help
	  The Tegra AXI/APB Bridge Machine Check handler. This
	  handes the SERRs from failed AXI/APB transactions.

config TEGRA_A57_SERR
        tristate "A57 SError Handler"
	select SERROR_HANDLER
	help
	  The A57 SError Handler.  This handles the SERRs from A57 cores,
	  specifically L1 ECC errors.

config TEGRA_18X_SERROR
        tristate "Tegra18 SError handler"
        depends on ARCH_TEGRA_18x_SOC
        select DENVER_MCA
	select TEGRA_ARI_MCA
	select TEGRA_BRIDGE_MCA
	select TEGRA_A57_SERR
        help
          The Tegra18 SError handler. This handles Denver SErrors, A57 SErrors,
	  CCPLEX errors, and fabric slave errors.

config TEGRA_BWMGR
        bool "Enable EMC Bandwidth Manager"
        depends on COMMON_CLK
        default n
        help
          Enables Bandwidth manager support for EMC clock. Required when using Common Clock Framework

config TEGRA_CAMERA_RTCPU
	bool "Enable Tegra Camera RTCPU Driver"
	depends on (ARCH_TEGRA_18x_SOC || ARCH_TEGRA_186_SOC)
	select NV_TEGRA_IVC

config TEGRA_CAMERA_HSP_MBOX_CLIENT
	bool "Enable Mailbox Client Implementation of HSP Protocol for Camera"
	depends on TEGRA_CAMERA_RTCPU && ARCH_TEGRA_186_SOC && MAILBOX
	default n

config TEGRA_FSICOM
	bool "Enable Tegra FSICOM client driver"
	depends on ARCH_TEGRA_23x_SOC && MAILBOX
	default n

config TEGRA_EPL
	bool "Enable Tegra EPL client driver"
	depends on ARCH_TEGRA_23x_SOC && MAILBOX
	default n

config TEGRA_DCE
	bool "Tegra DCE driver"
	depends on ARCH_TEGRA_23x_SOC

config TEGRA_ISOMGR
        bool "Isochronous Bandwidth Manager "
        help
          When enabled, drivers for ISO units can obtain ISO BW.
          The memory controller (MC) for each Tegra platform can supply
          a limited amount of isochronous (real-time) bandwidth.  When
          enabled, isomgr will manage a pool of ISO BW.

config TEGRA_ISOMGR_POOL_KB_PER_SEC
        int "Size of isomgr pool "
        default 0
        help
          Set this maximum ISO BW (in Kbytes/sec) that platform supports.
          The memory controller (MC) for each Tegra platform can supply
          a limited amount of isochronous (real-time) bandwidth.  Each
          platform must specify the maximum amount of ISO BW that isomgr
          should manage.

config TEGRA_ISOMGR_SYSFS
        bool "Visibility into Isochronous Bandwidth Manager state "
        depends on TEGRA_ISOMGR
        help
          When enabled, sysfs can be used to query isomgr state.
          This is used for visibility into isomgr state.  It could
          be useful in debug or in understanding performance on a
          running system.

config TEGRA_ISOMGR_MAX_ISO_BW_QUIRK
        bool "Relax Max ISO Bw limit"
        depends on TEGRA_ISOMGR
        default n
        help
          When enabled, allows system with less ISO bw continue to
          work. This is necessary for systems running at lower
          EMC clock freq or on FPGA.

config NV_TEGRA_MC
	bool "Tegra MC (Downstream version)"
	default ARCH_TEGRA_21x_SOC || ARCH_TEGRA_18x_SOC || ARCH_TEGRA_19x_SOC || ARCH_TEGRA_194_SOC || ARCH_TEGRA_186_SOC
	help
	  Enable Downstream version of Tegra MC driver.

config TEGRA_MC_TRACE_PRINTK
	bool "Enable trace_printk debugging for MC"
	depends on FTRACE_PRINTK

config TEGRA_VPR
	bool "Enable Tegra VPR Driver"
	default n
	help
	  Enable Tegra VPR driver to enable calls that allow resizing VPR area
	  at run time

config TEGRA_MCE
	bool "Enable Tegra MCE Driver"
	default y if (ARCH_TEGRA_21x_SOC || ARCH_TEGRA_18x_SOC || ARCH_TEGRA_19x_SOC || ARCH_TEGRA_210_SOC || ARCH_TEGRA_186_SOC || ARCH_TEGRA_194_SOC)
	help
	  Enable Tegra MCE driver for various power state and cache
	  management support operations.

config TEGRA_CACHE
	bool "Enable Tegra Cache Driver"
	default y if (ARCH_TEGRA_18x_SOC || ARCH_TEGRA_19x_SOC || ARCH_TEGRA_23x_SOC || ARCH_TEGRA_186_SOC || ARCH_TEGRA_194_SOC)
	help
	  Enable Tegra Cache driver for Various cache operations.

config TEGRA_OF_MCERR
        bool "Tegra MCERR OF"
        default y
        help
          Enable Tegra MC ERR OF.

config TEGRA_PM_IRQ
	bool "Enable PM IRQ"
	default y if ARCH_TEGRA_18x_SOC || ARCH_TEGRA_19x_SOC

config TEGRA_PMC_AO_WAKE
	bool "Enable AO WAKE from PMC"
	default y if ARCH_TEGRA_18x_SOC || ARCH_TEGRA_19x_SOC

config TEGRA_WAKEUP
	bool "Enable WAKEUP"
	depends on PM_SLEEP
	default y if ARCH_TEGRA_18x_SOC || ARCH_TEGRA_19x_SOC

config TEGRA_PTP_NOTIFIER
	tristate "Enable PTP Notifier"
	depends on ARCH_TEGRA_18x_SOC || ARCH_TEGRA_186_SOC
	default y if EQOS || NVETHERNET

config TEGRA_SAFETY_SCE
	tristate "Enable CCPLEX-SCE communication Driver for Safety"
	depends on ARCH_TEGRA_18x_SOC
	select NV_TEGRA_IVC
	select TEGRA_HSP
	help
	  This enables communication between CCPLEX and SCE over IVC channel.
	  This also provides a userspace command response interface as
	  character device which will be used by other safety modules.

config TEGRA_SOC_HWPM
	bool "Tegra SOC HWPM driver"
	depends on ARCH_TEGRA_23x_SOC
	default y
	help
	  The SOC HWPM driver enables performance monitoring for various Tegra
	  IPs.

config TEGRA_SPE
	bool "Tegra SPE driver"
	depends on ARCH_TEGRA_23x_SOC
	select NV_TEGRA_IVC
	help
	  This enables communication between CCPLEX and SPE over IVC channel.

config TEGRA_SPE_HSP_MBOX_CLIENT
	bool "Enable Mailbox Client Implementation of HSP Protocol for Camera"
	depends on TEGRA_SPE && ARCH_TEGRA_23x_SOC && MAILBOX
	default n

config TEGRA_19X_RAS
	tristate "Tegra19 RAS Handler"
	depends on ARCH_TEGRA_19x_SOC && RAS && ARM64_RAS
	default y
	select SERROR_HANDLER
	help
	  This driver adds RAS handlers for Carmel Correctable Errors,
	  Uncorrectable Errors per core, per core cluster and per CCPLEX

config TEGRA_CBB_NOC
	tristate "Tegar19x CBB NOC Bridge Error handler"
	depends on ARCH_TEGRA_19x_SOC || ARCH_TEGRA_194_SOC
	default n
	select SERROR_HANDLER if ARCH_TEGRA_19x_SOC
	help
	  The Tegra Control Backbone(CBB)/Network-on-chip(NOC) error handler.
	  This drivers handles SError from bridges due to failed transactions.

config POWERGATE_TEGRA_BPMP
        def_bool NV_TEGRA_BPMP

config TEGRA_HV_XHCI_DEBUG
	bool "Enable Tegra Hypervisor XHCI Server Debug"
	depends on TEGRA_HV_MANAGER
	default n
	help
	  Enable Tegra XHCI Server debugging when runs in virtualization.

config TEGRA_HSP
	bool "Enable Tegra Hardware Synchronization Primitives driver"
	depends on ARCH_TEGRA_18x_SOC
	default y

config TEGRA_NVDUMPER
	bool "Enable nvdumper"
	depends on ARCH_TEGRA
	default n
	help
	  This is debug feature to dump whole memory when system crashes.

config TEGRA_CENTRAL_ACTMON
	bool "Tegra Activity Monitor"
	depends on ARCH_TEGRA
	default n
	help
	  Actmon is a hardware block that can be used to track the activity of
	  certain hardware units. It can boost EMC clock depending
	  on the memory trafic among various client. It is called central actmon
	  as it monitors central activity for example MC activity. HW fabric of
	  central and unit actmon is different. If unsure, say Y here.

config TEGRA_FIRMWARES_CLASS
	bool
	default n

config TEGRA_FIRMWARES_INVENTORY
	tristate "Tegra firmwares inventory"
	select TEGRA_FIRMWARES_CLASS
	default y
	help
	  Register version readers for firmwares

config TEGRA_FIQ_DEBUGGER
	bool "Enable the FIQ serial debugger on Tegra"
	default n
	select FIQ_DEBUGGER
	select FIQ_GLUE
	help
	  Enables the FIQ serial debugger on Tegra

config TEGRA_BOOTLOADER_DEBUG
	tristate "Creates sys-fs interface dumping registers read by bootloader"
	default n
	select TEGRA_BOOTLOADER_DEBUG_INIT
	help
	  When enabled, tegra_bootloader_verify_regs sys-fs is created.

config TEGRA_BOOTLOADER_DEBUG_INIT
	bool
	depends on TEGRA_BOOTLOADER_DEBUG

config TEGRA_BOOTLOADER_BOOT_CFG
	tristate "Creates sysfs interface for BCP data"
	depends on TEGRA_BOOTLOADER_DEBUG_INIT
	default n
	help
	  When enabled, boot_cfg sys-fs is created.

config NV_TEGRA_IVC
	bool "Tegra IVC protocol support (Downstream version)"
	default n
	help
	  Enable the Tegra IVC library, which implements a lockless, shared-
	  memory queue.

config TEGRA_PM_DEBUG
	bool "Additional Tegra PM debug functionality"
	depends on PM
	default n
	help
	  Enable additional Tegra PM debug functionality (extra prints
	  during suspend entry and some debugfs functionality).

config TEGRA_CLOCKS_CONFIGURE
	bool "Configure initial state of clocks"
	default y if ARCH_TEGRA_18x_SOC || ARCH_TEGRA_19x_SOC
	help
	  Enable or disable clocks during kernel initialization.
	  This helps in optimizing power by disabling some always on clocks.

config TEGRA_USS_IO_PROXY
	tristate "Tegra Ultrasonic Sensor IO-PROXY"
	depends on GPIOLIB
	default n
	help
	 Enable the USS IO-PROXY driver which allows userspace to control
         clock and GPIO pins to the Ultrasonic Sensor subsystem.
         The Ultrasnoic Sensor subsystem consists of an USS ASIC and two groups
         of sensors. The USS ASIC requires a reset signal and a clock input.
         Each of the sensor groups has 8 GPIO inputs: 6 for demux states, 1 for
         power control and 1 for diagnostic function select.

config TEGRA_CVNAS
	tristate "Tegra CVNAS support"
	default y
	help
	 Tegra CVNAS driver for managing CVSRAM memory region.

config TEGRA_SAFETY
        tristate "Tegra safety ivc driver"
        default n
        help
          When enabled, establish the IVC channel with SCE FW and support ivc
          frame transfers.

config TEGRA_SAFETY_IVC_DEBUG
        tristate "Use ivc stubs for safety ivc driver testing"
        depends on TEGRA_SAFETY
        help
          When enabled, stub the IVC responses from SCE FW.

config TEGRA_HSIERRRPTINJ
	bool "Enable Tegra HSI Error Report Injection client driver"
	depends on ARCH_TEGRA_23x_SOC && MAILBOX && TEGRA_EPL && DEBUG_FS
	default n

source "drivers/platform/tegra/hwpm/Kconfig"
source "drivers/platform/tegra/nvadsp/Kconfig"
source "drivers/platform/tegra/nvaudio_ivc/Kconfig"
```

## kernel/nvidia/drivers/platform/tegra/hwpm/Kconfig
```kconfig
config TEGRA_T234_HWPM
	bool "Tegra T23x HWPM driver"
	depends on TEGRA_SOC_HWPM && ARCH_TEGRA_23x_SOC
	default y if (TEGRA_SOC_HWPM && ARCH_TEGRA_23x_SOC)
	help
	  T23x performance monitoring driver.
```

## kernel/nvidia/drivers/platform/tegra/nvaudio_ivc/Kconfig
```kconfig
config TEGRA_VIRT_AUDIO_IVC
	tristate "IVC client for Tegra virt audio"
	depends on TEGRA_HV_MANAGER
	help
	  Say Y or M here if you want to add support for tegra virtual ivc communication
	  for audio client. This ivc communication module is common for all virtualized
	  tegra platforms. This is used by both pcm and control interfaces. This module
	  uses hypervisor IVC APIs for communication with audio server.
```

## kernel/nvidia/drivers/pwm/Kconfig
```kconfig
if PWM
config PWM_TEGRA_TACHOMETER
	tristate "NVIDIA Tegra Tachometer PWM driver "
	depends on ARCH_TEGRA
	help
	  NVIDIA Tegra Tachometer reads the PWM signal and reports the PWM
	  signal periods. This helps in measuign the fan speed where Fan
	  output for speed is PWM signal.

	  This driver support the Tachometer driver in PWM framework.

config PWM_TEGRA_DFLL
	tristate "NVIDIA Tegra DFLL PWM support"
	depends on ARCH_TEGRA
	help
	  PWM driver support for the Tegra DFLL module found on NVIDIA
	  Tegra SoCs.

	  To compile this driver as a module, choose M here: the module
	  will be called pwm-tegra-dfll.
endif
```

## kernel/nvidia/drivers/regulator/Kconfig
```kconfig
if REGULATOR

config REGULATOR_PMIC_OTP
	bool "Provide a regulator with PMIC OTP without PMIC registration"
	help
	  This driver able to provide all regulator interface to client
	  without any actual implementation. This should be used if it
	  is required to use the PMCI OTP configuration and do not want
	  to register PMIC.

config REGULATOR_NCP81599
	tristate "NCP81599 Regulator"
	depends on I2C=y
	help
	  Enable this driver to toggle EN pin of NCP81599 device to
	  enable/disable regulator.
endif
```

## kernel/nvidia/drivers/rtc/Kconfig
```kconfig
# SPDX-License-Identifier: GPL-2.0-only
#
# RTC class/drivers configuration
#

if RTC_CLASS
config NVVRS_PSEQ_RTC
	bool "Nvidia's VRS Power Sequencer RTC Driver"
	default y if MFD_NVVRS_PSEQ
	help
		Say yes here to add support for RTC provided by Nvidia
		based Voltage Regulator Specification Power Sequencer.
endif
```

## kernel/nvidia/drivers/soc/tegra/Kconfig
```kconfig
config TEGRA_KFUSE
	bool "Tegra kfuse support"
	default n
	depends on ARCH_TEGRA
	help
	  Enable Tegra kfuse support. The kfuse block stores downstream and
	  upstream HDCP keys for use by the HDMI module.

config TEGRA_FUSE_DOWNSTREAM
	bool "Downstream Tegra Fuse Support"
	depends on ARCH_TEGRA
	help
	  This option enables support for downstream TEGRA efuse and platform
	  level helper code.

config TEGRA_FUSE_BURN
	bool "Downstream Tegra Fuse Burn Support"
	depends on ARCH_TEGRA_2x_SOC || ARCH_TEGRA_3x_SOC || ARCH_TEGRA_114_SOC || \
		   ARCH_TEGRA_124_SOC || ARCH_TEGRA_132_SOC || ARCH_TEGRA_210_SOC || \
		   SOC_TEGRA_PMC
	help
	  This option enables support for downstream TEGRA fuse-burn feature.

config TEGRA_PROC_POWER_MODEL
	bool "Tegra process power model support"
	depends on ARCH_TEGRA
	help
	  Used to create a simple processor power model (PPM) by
	  collating various chip specific data including voltage,
	  frequency, and number of cores. This driver is used by
	  various other drivers including EDP.

config TEGRA_DVFS
	bool
	depends on ARCH_TEGRA
	select PM_OPP
	help
	  This adds Tegra DVFS support. There could be several power
	  rails involved and there might be rails dependency based
	  on different SoCs, this config enable the generic DVFS
	  library needed by each SoCs DVFS files.

	  If in doubt, say N.

config TEGRA_210_DVFS
	bool "Tegra210 DVFS support"
	depends on ARCH_TEGRA_210_SOC
	select TEGRA_DVFS
	help
	  This enable Tegra210 DVFS functionality, it implements SoC
	  specific initialization code to be invoked by probe function
	  defined in generic Tegra DVFS driver, so while enabled it
	  needs the config TEGRA_DVFS to be enabled as well.
```

## kernel/nvidia/drivers/staging/Kconfig
```kconfig
if STAGING

source "drivers/staging/ozwpan/Kconfig"
source "drivers/staging/platform/tegra/gte/Kconfig"
source "drivers/staging/platform/tegra/gte_test/Kconfig"

endif # STAGING
```
