## kernel/nvidia/Documentation/devicetree/bindings/platform/tegra/camera/tegra194-slvs-ec.txt
```
NVIDIA Tegra Xavier (T19x) SLVS-EC bindings

Tegra SLVS-EC is a Sony SLVS-EC v1.2 receiver, it outputs packetized data
directly to the VI unit.

A Test Pattern Generator (TPG) unit is present for system bandwidth and image
signal processing testing.

Pre-boot hardware auto-detection is peformed by the NVIDIA Tegra plugin-manager
for supported devices; if present, the attached camera board's Device Tree
configuration overlays additional fields for assembling a complete system
stream/channel graph for all camera sensor(s).

Required properties:
	- compatible: Should be "nvidia,tegra-slvs-ec".
	- reg: Register address space (MMIO).
	- resets: All ISP resets.
	- reset-names: Names of the above resets.
	- clocks: All ISP clocks.
	- clock-names: Names of the above clocks.
	- power-domains: Power domain group, should be
		"TEGRA194_POWER_DOMAIN_VE".
	- interrupts: All SLVS-EC interrupts.
	- interrupt-names: Names of the above interrupts.
	- nvidia,vi-device: VI5 Falcon/THI interface device.

	-- Camera Board Configuration --
	-- Stream (streams) --
	-- Streams (stream@{0,1}) --
	- reg: Main (<0>) or sub (<1>) stream.
	- lanes: List of lane indexes in use.

	-- Port (ports) --
	- #address-cells: Number of address cells in each subnode, set to <1>.
	#size-cells: Number of size cells in each subnode, set to <0>.

	-- Ports (port@{0,1}) --
	- reg: Sensor-link (<0>) or VI-link (<1>).

	-- Endpoint (endpoint@{0,1}) --
	- port-index: Sensor-link only, SLVS-EC port index; {0,1}.
	- bus-width: Sensor-link only, number of SLVS-EC lanes.
	- remote-endpoint: Label to sensor or VI node.

Example:

	slvs_ec: slvs-ec@15ac0000 {
		compatible = "nvidia,tegra-slvs-ec";
		reg = <0x0 0x15ac0000 0x0 0x00040000>,
			<0x0 0x15c00000 0x0 0x00010000>,
			<0x0 0x15e40000 0x0 0x00010000>;
		resets = <&bpmp_resets TEGRA194_RESET_SLVSEC>;
		reset-names = "slvs-ec";
		clocks = <&bpmp_clks TEGRA194_CLK_SLVSEC>,
			<&bpmp_clks TEGRA194_CLK_SLVSEC_PADCTRL>,
			<&bpmp_clks TEGRA194_CLK_PLLP_OUT0>;
		clock-names = "slvs-ec", "slvs-ec-lp", "slvs-ec-parent";
		power-domains = <&bpmp TEGRA194_POWER_DOMAIN_VE>;
		interrupts = <0 74 0x04>,
			<0 255 0x04>;
		interrupt-names = "slvs-ec", "syncgen";
		nvidia,vi-device = <&vi_thi>;
	};

	/* Camera board-specific config overlay */
	slvs-ec@15ac0000 {
		streams {
			#address-cells = <1>;
			#size-cells = <0>;
			stream@0 {
				reg = <0>;
				lanes = <0 1 2 3 4 5 6 7>;
				ports {
					#address-cells = <1>;
					#size-cells = <0>;
					port@0 {
						reg = <0>;
						e3377_slvs_ec_in0: endpoint@0 {
							port-index = <0>;
							bus-width = <8>;
							remote-endpoint = <&e3377_imx204_out0>;
						};
					};
					port@1 {
						reg = <1>;
						e3377_slvs_ec_out0: endpoint@1 {
							remote-endpoint = <&e3377_vi_in0>;
						};
					};
				};
			};
		};
	};
```

## kernel/nvidia/Documentation/devicetree/bindings/platform/tegra/camera/tegra194-vi5.txt
```
NVIDIA Tegra Xavier (T19x) VI5 bindings

Tegra VI5 (Video Input, version 5) is a pixel pipeline that receives packetized
data from the Tegra NVCSI and SLVS-EC units, and outputs to frame buffers in
memory for ISP5 and other clients. Functional implementation of the APIs is
located in the Camera RTCPU firmware.

Pre-boot hardware auto-detection is peformed by the NVIDIA Tegra plugin-manager
for supported devices; if present, the attached camera board's Device Tree
configuration overlays additional fields for assembling a complete system
stream/channel graph for all camera sensor(s).

Required properties:
	- compatible: Should be "nvidia,tegra194-vi".
	- reg: Register address space (MMIO).
	- resets: All VI and MIPICAL resets.
	- reset-names: Names of the above resets.
	- clocks: All VI, NVCSI and MIPICAL clocks.
	- clock-names: Names of the above clocks.
	- power-domains: Power domain group, should be
		"TEGRA194_POWER_DOMAIN_VE".
	- nvidia,vi-falcon-device: VI5 Falcon device, should be "vi_thi".
	- iommus: VI5 Stream ID, should be "TEGRA_SID_VI".
	- iso-smmu: Isochronous SMMU, should be set.
	- non-coherent: Non-coherent DMA, should be set.

	-- Camera Board Overlay --
	- num-channels: Total number of VI channels, usually equal to number of
		sensors (incl. SERDES-attached ones). Certain sensors supporting WDR/DOL
		modes may simultaneously utilize more than one VI channel.

	-- Port (ports) --
	- #address-cells: Number of address cells in each subnode, set to <1>.
	- #size-cells: Number of size cells in each subnode, set to <0>.

	-- Ports (port@PQ) --
	- reg: Channel/stream index, same as <PQ>.

	-- Endpoint (endpoint) --
	- vc-id: Virtual channel ID; {0-15}, omit or set to 0 if not using SERDES
		setup.
	- port-index: NVCSI port index; {0-7}.
	- bus-width: Number of D-Phy or C-Phy lanes.
	- remote-endpoint: Label to NVCSI node.

Example:

	vi: vi@15c10000 {
		compatible = "nvidia,tegra194-vi";

		reg = <0x0 0x15c10000 0x0 0x00230000>,
			<0x0 0x15f00000 0x0 0x00100000>;
		resets = <&bpmp_resets TEGRA194_RESET_VI>,
			<&bpmp_resets TEGRA194_RESET_TSCTNVI>,
			<&bpmp_resets TEGRA194_RESET_MIPI_CAL>;
		reset-names = "vi", "tsctnvi", "mipi_cal";
		clocks = <&bpmp_clks TEGRA194_CLK_VI>,
			<&bpmp_clks TEGRA194_CLK_VI_CONST>,
			<&bpmp_clks TEGRA194_CLK_NVCSI>,
			<&bpmp_clks TEGRA194_CLK_NVCSILP>,
			<&bpmp_clks TEGRA194_CLK_MIPI_CAL>,
			<&bpmp_clks TEGRA194_CLK_UART_FST_MIPI_CAL>;
		clock-names = "vi", "vi-const", "nvcsi", "nvcsilp",
			"mipi_cal", "uart_fs_mipi_cal";
		power-domains = <&bpmp TEGRA194_POWER_DOMAIN_VE>;

		nvidia,vi-falcon-device = <&vi_thi>;

		iommus = <&smmu TEGRA_SID_VI>;
		iso-smmu;
		non-coherent;
	};

	/* Camera board-specific config overlay */
	vi@15c10000 {
		num-channels = <2>;
		ports {
			#address-cells = <1>;
			#size-cells = <0>;
			port@0 {
				reg = <0>;
				imx390_vi_in0: endpoint {
					vc-id = <0>;
					port-index = <0>;
					bus-width = <2>;
					remote-endpoint = <&imx390_csi_out0>;
				};
			};
			port@1 {
				reg = <1>;
				imx390_vi_in1: endpoint {
					vc-id = <1>;
					port-index = <0>;
					bus-width = <2>;
					remote-endpoint = <&imx390_csi_out1>;
				};
			};
		};
	};

== VI5 Falcon unit ==

The VI5 Falcon is a microcontroller for the VI5 unit. THI is the Tegra Host
Interface.

Required properties:
	- compatible: Should be "nvidia,nvidia,tegra194-vi-thi".
	- reg: Register address space (MMIO).

Optional properties:
	- clocks: All VI clocks.
	- clock-names: Names of the above clocks.
	- power-domains: Power domain group, should be "TEGRA194_POWER_DOMAIN_VE".

Example:

	vi_thi: vi-thi@15f00000 {
		compatible = "nvidia,tegra194-vi-thi";

		clocks = <&bpmp_clks TEGRA194_CLK_VI>,
				<&bpmp_clks TEGRA194_CLK_VI_CONST>;
		clock-names = "vi", "vi-const";
		power-domains = <&bpmp TEGRA194_POWER_DOMAIN_VE>;
	};
```

## kernel/nvidia/Documentation/devicetree/bindings/platform/tegra/camera/tegra210-isp2.txt
```
NVIDIA Tegra Erista (T21x) ISP2 bindings

Tegra ISP2 (Image Signal Processor, version 2), is a pixel processing unit
operating on optical sensor data from VI2. It is subdivided into ISPA and ISPB,
which can simultaneously process images independently. Functional control is
implemented in NVDIA user-space driver libraries.

Required properties:
	- compatible: Should be "nvidia,tegra210-isp".
	- reg: Register address space (MMIO).
	- power-domains: Power domain group, should be "&ve_pd", label to
		TEGRA210_POWER_DOMAIN_VENC.
	- resets: All ISPA or ISPB resets.
	- clocks: All ISPA or ISPB clocks.
	- clock-names: Names of the above clocks.
	- interrupts: All ISPA or ISPB interrupts.
	- iommus: ISP2 Stream ID, should be "TEGRA_SWGROUP_ISP" (ISPA) or
		"TEGRA_SWGROUP_ISP2B" (ISPB).
	- iommu-group-id: IOMMU group, should be "TEGRA_IOMMU_GROUP_HOST1X".

Example:

	isp@54600000 {
		compatible = "nvidia,tegra210-isp";
		power-domains = <&ve_pd>;
		reg = <0x0 0x54600000 0x0 0x00040000>;
		interrupts = <0 71 0x04>;
		iommus = <&smmu TEGRA_SWGROUP_ISP>;
		status = "disabled";
		clocks = <&tegra_car TEGRA210_CLK_ISPA_ISP_CBUS>;
		clock-names = "ispa";
		resets = <&tegra_car TEGRA210_CLK_ISPA>;
	};

	isp@54680000 {
		compatible = "nvidia,tegra210-isp";
		power-domains = <&pd_ve2>;
		reg = <0x0 0x54680000 0x0 0x00040000>;
		interrupts = <0 70 0x04>;
		iommus = <&smmu TEGRA_SWGROUP_ISP2B>;
		status = "disabled";
		clocks = <&tegra_car TEGRA210_CLK_ISPB_ISP_CBUS>;
		clock-names = "ispb";
		resets = <&tegra_car TEGRA210_CLK_ISPB>;
	};
```

## kernel/nvidia/Documentation/devicetree/bindings/platform/tegra/camera/tegra210-mipical.txt
```
NVIDIA Tegra Erista (T21x) MIPICAL bindings

The MIPICAL unit performs calibration at start of capture or transmission to
condition the impedance of MIPI D-Phy CSI-2 and DSI lanes.

PROD settings

Required properties:
	- compatible: Should be "nvidia,tegra210-mipical".
	- reg: Register address space (MMIO).
	- clocks: All MIPICAL clocks.
	- clock-names: Names of the above clocks.
	- assigned-clocks: MIPICAL clock, should be "TEGRA210_CLK_CLK72MHZ".
	- assigned-clock-parents: Parent clock, should be "TEGRA210_CLK_PLL_P".
	- assigned-clock-rates: Supported clock rate(s).

	-- PROD value groups (prod-settings) --
	- #prod-cells: Number of PROD settings per config tuple (default: 3).

	-- D-Phy DSI values (prod_c_dphy_dsi) --
	-- PROD values (prod) --
	- prod: List of tuples (each size #prod-cells) corresponding to a PROD
		config.

Example:

	mipical {
		compatible = "nvidia,tegra210-mipical";
		reg = <0x0 0x700e3000 0x0 0x00000100>;
		clocks = <&tegra_car TEGRA210_CLK_MIPI_CAL>,
			<&tegra_car TEGRA210_CLK_CLK72MHZ>;
		clock-names = "mipi_cal", "uart_mipi_cal";

		assigned-clocks = <&tegra_car TEGRA210_CLK_CLK72MHZ>;
		assigned-clock-parents = <&tegra_car TEGRA210_CLK_PLL_P>;
		assigned-clock-rates = <68000000>;
	};

	/* PROD settings */
	mipical {
		prod-settings {
			#prod-cells = <3>;
			prod_c_dphy_dsi {
				prod = <
					0x00000038 0x00001f00 0x00000200 //MIPI_CAL_DSIA_MIPI_CAL_CONFIG_0	12:8=MIPI_CAL_HSPUOSDSIA	0x2
					0x0000003c 0x00001f00 0x00000200 //MIPI_CAL_DSIB_MIPI_CAL_CONFIG_0	12:8=MIPI_CAL_HSPUOSDSIB	0x2
					0x00000040 0x00001f00 0x00000200 //MIPI_CAL_DSIC_MIPI_CAL_CONFIG_0	12:8=MIPI_CAL_HSPUOSDSIC	0x2
					0x00000044 0x00001f00 0x00000200 //MIPI_CAL_DSID_MIPI_CAL_CONFIG_0	12:8=MIPI_CAL_HSPUOSDSID	0x2

					0x0000005c 0x00000f00 0x00000300 //MIPI_CAL_MIPI_BIAS_PAD_CFG1_0	11:8=PAD_DRIV_UP_REF	0x3
					0x00000060 0x000f00f0 0x00010010 //MIPI_CAL_MIPI_BIAS_PAD_CFG2_0	07:04=PAD_VAUXP_LEVEL	0x1
									 //					19:16=PAD_VCLAMP_LEVEL	0x1
					0x00000064 0x0000001f 0x00000002 //MIPI_CAL_DSIA_MIPI_CAL_CONFIG_2_0	04:00=MIPI_CAL_HSCLKPUOSDSIA 0x2
					0x00000068 0x0000001f 0x00000002 //MIPI_CAL_DSIB_MIPI_CAL_CONFIG_2_0	04:00=MIPI_CAL_HSCLKPUOSDSIB 0x2
					0x00000070 0x0000001f 0x00000002 //MIPI_CAL_DSIC_MIPI_CAL_CONFIG_2_0	04:00=MIPI_CAL_HSCLKPUOSDSIC 0x2
					0x00000074 0x0000001f 0x00000002 //MIPI_CAL_DSID_MIPI_CAL_CONFIG_2_0	04:00=MIPI_CAL_HSCLKPUOSDSID 0x2
					>;
			};
		};
	};
```

## kernel/nvidia/Documentation/devicetree/bindings/platform/tegra/camera/tegra210-vi2.txt
```
NVIDIA Tegra Erista (T21x) VI2 bindings

Tegra VI2 (Video Input, version 2) is a pixel pipeline that ingresses data from
its MIPI CSI-2 D-Phy 1.1 receiver (from CIL pads). Image frame data is outputted
directly to the ISP2 (A or B).

The MIPICAL unit performs calibration at start of capture to condition the
impedance of CSI-2 D-Phy lanes.

VII2C is an I2C bus driver intended for the control of external camera sensors
and peripherals such as onboard EEPROMs and focusers; it is separate from other
I2C units in the Tegra SOC.

An internal Pattern Generator (PG) unit is present for system bandwidth and
image signal processing testing.

Pre-boot hardware auto-detection is peformed by the NVIDIA Tegra plugin-manager
for supported devices; if present, the attached camera board's Device Tree
configuration overlays additional fields for assembling a complete system
stream/channel graph for all camera sensor(s).

Required properties:
	- compatible: Should be "nvidia,tegra210-vi", "simple-bus".
	- reg: Register address space (MMIO).
	- power-domains: Power domain group, should be "&ve_pd", label to
		TEGRA210_POWER_DOMAIN_VENC.
	- resets: All VI resets.
	- reset-names: Names of the above resets.
	- clocks: All VI, CSI-2 CIL, VII2C and DSI clocks.
	- clock-names: Names of the above clocks.
	- interrupts: All VI2 interrupts.
	- iommus: VI2 Stream ID, should be "TEGRA_SWGROUP_VI".

	- #address-cells: Number of address cells in each subnode, set to <1>.
	- #size-cells: Number of size cells in each subnode, set to <0>.

	-- Camera Board Overlay --
	- num-channels: Total number of VI channels, equal to the number of
		connected sensors.

	-- Port (ports) --
	- #address-cells: Number of address cells in each subnode, set to <1>.
	- #size-cells: Number of size cells in each subnode, set to <0>.

	-- Ports (port@PQ) --
	- reg: Channel/stream index, same as <PQ>.

	-- Endpoint (endpoint) --
	- port-index: NVCSI port index; {0-5} (A-F).
	- bus-width: Number of D-Phy lanes used in SCIL; {1-4}.
	- remote-endpoint: Label to sensor node.

Example:

	host1x {
		vi {
			compatible = "nvidia,tegra210-vi", "simple-bus";
			power-domains = <&ve_pd>;
			reg = <0x0 0x54080000 0x0 0x40000>;
			interrupts = <GIC_SPI 69 IRQ_TYPE_LEVEL_HIGH>;
			iommus = <&smmu TEGRA_SWGROUP_VI>;
			clocks = <&tegra_car TEGRA210_CLK_VI_V4L2_CBUS>,
				<&tegra_car TEGRA210_CLK_CSI>,
				<&tegra_car TEGRA210_CLK_CILAB>,
				<&tegra_car TEGRA210_CLK_CILCD>,
				<&tegra_car TEGRA210_CLK_CILE>,
				<&tegra_car TEGRA210_CLK_VI_I2C>,
				<&tegra_car TEGRA210_CLK_I2CSLOW>,
				<&tegra_car TEGRA210_CLK_PLL_D>,
				<&tegra_car TEGRA210_CLK_PLL_D_DSI_OUT>;
			clock-names = "vi", "csi", "cilab", "cilcd",
				"cile", "vii2c", "i2cslow",
				"pll_d", "pll_d_dsi_out";
			resets = <&tegra_car 20>;
			reset-names = "vi";
			#address-cells = <1>;
			#size-cells = <0>;
		};


	};

	/* Camera board-specific config overlay */
	host1x {
		vi {
			num-channels = <1>;
			ports {
				#address-cells = <1>;
				#size-cells = <0>;
				port@0 {
					reg = <0>;
					e3326_vi_in0: endpoint {
						port-index = <2>;
						bus-width = <2>;
						remote-endpoint = <&e3326_csi_out0>;
					};
				};
			};
		};
	};
```

## kernel/nvidia/Documentation/devicetree/bindings/platform/tegra/nvidia,carmel-pmu.txt
```
NVIDIA Carmel Uncore PMU
========================

This driver supports hardware perfmon event counting for the 4 L2 clusters
and for the L3. The supported events are standard ARM L2/L3 event numbering,
but shifted and masked with a unit number for the sake of granular unit
tracking. The event format is EEU, where 'EE' is the standard ARM event number
and U is the unit (0-3 for the L2s, 4 for the L3).

Required properties:
	- compatible : "nvidia,carmel-pmu"
	- interrupts : single hardware-specified interrupt
	- interrupt-affinity : this driver must be pinned to Carmel core 0 (cpu@0)
		in order to correctly field PMU interrupts from the L2/L3 units.

Example:
	carmel-pmu {
		compatible = "nvidia,carmel-pmu";
		interrupts = <0 365 0x4>;
		interrupt-affinity = <&{/cpus/cpu@0}>;
	};
```

## kernel/nvidia/Documentation/devicetree/bindings/platform/tegra/nvidia,denver-hardwood.txt
```
NVIDIA Denver hardwood debug driver
===================================

This driver is used for the Nvidia-internal Denver CPU debug tool.
It reserves a single interrupt.

Required properties:
	- compatible : "nvidia,denver-hardwood"
	- interrupts : Must contain a single interrupt in sync with MTS

Example:
	hardwood {
		compatible = "nvidia,denver-hardwood";
		interrupts = <0 24 0x4>;
	};
```
