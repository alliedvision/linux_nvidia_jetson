## kernel/nvidia/Documentation/devicetree/bindings/platform/tegra/camera/tegra186-nvcsi.txt
```
NVIDIA Tegra Parker (T18x) NVCSI bindings

Tegra NVCSI is a MIPI CSI-2 receiver, supporting the D-Phy v1.2 and C-Phy v1.0
interfaces, it outputs packetized data directly to the VI4 unit.

The MIPICAL unit performs calibration at start of capture to condition the
impedance of CSI-2 D-Phy lanes. D-Phy initial and periodic DESKEW calibration
is performed when a sensor operates at or above 1.5 Gb/s.

An internal Test Pattern Generator (TPG) unit is present for system bandwidth
and image signal processing testing.

Pre-boot hardware auto-detection is peformed by the NVIDIA Tegra plugin-manager
for supported devices; if present, the attached camera board's Device Tree
configuration overlays additional fields for assembling a complete system
stream/channel graph for all camera sensor(s).

Required properties:
	- compatible: Should be "nvidia,tegra194-nvcsi".
	- reg: Register address space (MMIO).
	- power-domains: Power domain group, should be
		"TEGRA194_POWER_DOMAIN_VE".
	- resets: All NVCSI resets.
	- clocks: All NVCSI clocks.
	- clock-names: Names of the above clocks.
	- interrupts: All NVCSI interrupts.
	- iommus: NVCSI Stream ID, should be "TEGRA_SID_NVCSI".
	- iommu-group-id: IOMMU group, should be "TEGRA_IOMMU_GROUP_HOST1X".
	- num-ports: Number of physical D-Phy or C-Phy combo ports.

	-- Camera Board Configuration --
	- num-channels: Total number of NVCSI streams, usually equal to number of
		sensors and/or SERDES attached.
	- #address-cells: Number of address cells in each subnode, set to <1>.
	- #size-cells: Number of size cells in each subnode, set to <0>.

	-- Channels (channel@XY) --
	- reg: The NVCSI stream index, {0-7}.

	-- Port (ports) --
	- #address-cells: Number of address cells in each subnode, set to <1>.
	- #size-cells: Number of size cells in each subnode, set to <0>.

	-- Ports (port@{0,1}) --
	- reg: Sensor-link (<0>) or VI-link (<1>).

	-- Endpoint (endpoint@{0,1}) --
	- port-index: Sensor-link only, NVCSI port index; {0-5} (A-F).
	- bus-width: Sensor-link only, number of D-Phy lanes or C-Phy trios used
		in SCIL; {1-4}.
	- remote-endpoint: Label to sensor or VI node.

Example:

	nvcsi@150c0000 {
		compatible = "nvidia,tegra186-nvcsi";
		power-domains = <&bpmp TEGRA186_POWER_DOMAIN_VE>;
		reg = <0x0 0x150c0000 0x0 0x00040000>;
		resets = <&tegra_car TEGRA186_RESET_NVCSI>;
		clocks = <&tegra_car TEGRA186_CLK_NVCSI>,
			<&tegra_car TEGRA186_CLK_NVCSILP>,
			<&tegra_car TEGRA186_CLK_PLLNVCSI>,
			<&tegra_car TEGRA186_CLK_PLLP_OUT0>;
		clock-names = "nvcsi", "nvcsilp", "nvcsi_parent",
			"nvcsilp_parent";
		interrupts = <0 119 0x04>;
		iommus = <&smmu TEGRA_SID_NVCSI>;
		iommu-group-id = <TEGRA_IOMMU_GROUP_HOST1X>;
		num-ports = <6>;
	};

	/* Camera board-specific config overlay */
	nvcsi@150c0000 {
		num-channels = <2>;
		#address-cells = <1>;
		#size-cells = <0>;
		channel@0 {
			reg = <0>;
			ports {
				#address-cells = <1>;
				#size-cells = <0>;
				port@0 {
					reg = <0>;
					liimx274_csi_in0: endpoint@0 {
						port-index = <0>;
						bus-width = <4>;
						remote-endpoint = <&liimx274_imx274_out0>;
					};
				};
				port@1 {
					reg = <1>;
					liimx274_csi_out0: endpoint@1 {
						remote-endpoint = <&liimx274_vi_in0>;
					};
				};
			};
		};
		channel@1 {
			reg = <1>;
			ports {
				#address-cells = <1>;
				#size-cells = <0>;
				port@0 {
					reg = <0>;
					liimx274_csi_in1: endpoint@2 {
						port-index = <2>;
						bus-width = <4>;
						remote-endpoint = <&liimx274_imx274_out1>;
					};
				};
				port@1 {
					reg = <1>;
					liimx274_csi_out1: endpoint@3 {
						remote-endpoint = <&liimx274_vi_in1>;
					};
				};
			};
		};
	};
```

## kernel/nvidia/Documentation/devicetree/bindings/platform/tegra/camera/tegra186-vi4.txt
```
NVIDIA Tegra Parker (T18x) VI4 bindings

Tegra VI4 (Video Input, version 4) is a pixel pipeline that receives packetized
data from the Tegra NVCSI unit, and outputs directly to ISP4 or to frame buffers
in memory for ISP4 and other clients.

Pre-boot hardware auto-detection is peformed by the NVIDIA Tegra plugin-manager
for supported devices; if present, the attached camera board's Device Tree
configuration overlays additional fields for assembling a complete system
stream/channel graph for all camera sensor(s).

Required properties:
	- compatible: Should be "nvidia,tegra194-vi".
	- reg: Register address space (MMIO).
	- power-domains: Power domain group, should be
		"TEGRA186_POWER_DOMAIN_VE".
	- resets: All VI resets.
	- reset-names: Names of the above resets.
	- clocks: All VI and NVCSI clocks.
	- clock-names: Names of the above clocks.
	- interrupts: All VI interrupts.
	- iommus: VI4 Stream ID, should be "TEGRA_SID_VI".
	- iommu-group-id: IOMMU group, should be "TEGRA_IOMMU_GROUP_HOST1X".

	-- Camera Board Overlay --
	- num-channels: Total number of VI channels, usually equal to number of
		sensors (incl. SERDES-attached ones). Certain sensors supporting WDR/DOL
		modes may simultaneously utilize more than one VI channel.

	-- Port (ports) --
	- #address-cells: Number of address cells in each subnode, set to <1>.
	- #size-cells: Number of size cells in each subnode, set to <0>.

	-- Ports (port@PQ) --
	- reg: Channel/stream index, same as <PQ>.

	-- Endpoint (endpoint) --
	- port-index: NVCSI port index; {0-7}.
	- bus-width: Number of D-Phy or C-Phy lanes.
	- remote-endpoint: Label to NVCSI node.

Example:

	tegra_vi: vi@15700000 {
		compatible = "nvidia,tegra186-vi";
		reg = <0x0 0x15700000 0x0 0x00100000>;
		power-domains = <&bpmp TEGRA186_POWER_DOMAIN_VE>;
		resets = <&tegra_car TEGRA186_RESET_VI>,
			<&tegra_car TEGRA186_RESET_TSCTNVI>;
		reset-names = "vi", "tsctnvi";
		clocks = <&tegra_car TEGRA186_CLK_VI>,
			<&tegra_car TEGRA186_CLK_NVCSI>,
			<&tegra_car TEGRA186_CLK_NVCSILP>;
		clock-names = "vi", "nvcsi", "nvcsilp";
		interrupts = <0 201 0x04
			0 202 0x04
			0 203 0x04>;
		iommus = <&smmu TEGRA_SID_VI>;
		iommu-group-id = <TEGRA_IOMMU_GROUP_HOST1X>;
	};

	/* Camera board-specific config overlay */
	vi@15700000 {
		num-channels = <2>;
		ports {
			#address-cells = <1>;
			#size-cells = <0>;
			port@0 {
				reg = <0>;
				liimx274_vi_in0: endpoint {
					port-index = <0>;
					bus-width = <4>;
					remote-endpoint = <&liimx274_csi_out0>;
				};
			};
			port@1 {
				reg = <1>;
				liimx274_vi_in1: endpoint {
					port-index = <2>;
					bus-width = <4>;
					remote-endpoint = <&liimx274_csi_out1>;
				};
			};
		};
	};
```

## kernel/nvidia/Documentation/devicetree/bindings/platform/tegra/camera/tegra194-isp5.txt
```
NVIDIA Tegra Xavier (T19x) ISP5 bindings

Tegra ISP5 (Image Signal Processor, version 5), is a pixel processing unit
operating on optical sensor data in memory (such as from VI). Functional
implementation of the APIs is located in the Camera RTCPU firmware.

Required properties:
	- compatible: Should be "nvidia,tegra194-isp".
	- reg: Register address space (MMIO).
	- resets: All ISP resets.
	- reset-names: Names of the above resets.
	- clocks: All ISP clocks.
	- clock-names: Names of the above clocks.
	- power-domains: Power domain group, should be
		"TEGRA194_POWER_DOMAIN_ISPA".
	- nvidia,vi-falcon-device: ISP5 Falcon device, should be "isp_thi".
	- iommus: ISP5 Stream ID, should be "TEGRA_SID_ISP".
	- non-coherent: Coherent DMA, should be set.

Example:

	isp: isp@14800000 {
		compatible = "nvidia,tegra194-isp";
		reg = <0x0 0x14800000 0x0 0x00010000>;

		resets = <&bpmp_resets TEGRA194_RESET_ISP>;
		reset-names = "isp";
		clocks = <&bpmp_clks TEGRA194_CLK_ISP>;
		clock-names = "isp";
		power-domains = <&bpmp TEGRA194_POWER_DOMAIN_ISPA>;

		nvidia,isp-falcon-device = <&isp_thi>;

		iommus = <&smmu TEGRA_SID_ISP>;
		dma-coherent;
	};

== ISP5 Falcon unit ==

The ISP5 Falcon is a microcontroller for the ISP5 unit. THI is the Tegra Host
Interface.

Required properties:
	- compatible: Should be "nvidia,tegra194-isp-thi".
	- reg: Register address space (MMIO).

Optional properties:
	- clocks: All ISP clocks.
	- clock-names: Names of the above clocks.
	- power-domains: Power domain group, should be
		"TEGRA194_POWER_DOMAIN_ISPA".

Example:

	isp_thi: isp-thi@14b00000 {
		compatible = "nvidia,tegra194-isp-thi";
		reg = <0x0 0x14b00000 0x0 0x00100000>;
	};
```

## kernel/nvidia/Documentation/devicetree/bindings/platform/tegra/camera/tegra194-mipical.txt
```
NVIDIA Tegra Xavier (T19x) MIPICAL bindings

The MIPICAL unit performs calibration at start of capture or transmission to
condition the impedance of MIPI D-Phy CSI-2 and DSI lanes. DSI is not POR for
Xavier and is not used.

Required properties:
	- compatible: Should be "nvidia, tegra194-mipical".
	- reg: Register address space (MMIO).
	- clocks: All MIPICAL clocks.
	- clock-names: Names of the above clocks.
	- resets: All MIPICAL resets.
	- reset-names: Names of the above resets.
	- status: Can be "okay" to enable kernel probe or "disabled".

	- mipical prod settings for Xavier in kernel is not used.
	  Prod settings are packaged with the RCE FW (rtcpu dir).

Example:

	mipical@3990000 {
		compatible = "nvidia, tegra194-mipical";
		reg = <0x0 0x03990000 0x0 0x10000>;
		clocks = <&bpmp_clks TEGRA194_CLK_MIPI_CAL>,
			<&bpmp_clks TEGRA194_CLK_UART_FST_MIPI_CAL>;
		clock-names = "mipi_cal", "uart_fs_mipi_cal";
		resets = <&bpmp_resets TEGRA194_RESET_MIPI_CAL>;
		reset-names = "mipi_cal";
		status = "disabled";
	};
```

## kernel/nvidia/Documentation/devicetree/bindings/platform/tegra/camera/tegra194-nvcsi.txt
```
NVIDIA Tegra Xavier (T19x) NVCSI bindings

Tegra NVCSI is a MIPI CSI-2 receiver, supporting the D-Phy v1.2 and C-Phy v1.1
interfaces, it outputs packetized data directly to the VI5 unit. Functional
implementation of the APIs (incl. all calibration) is located in the Camera
RTCPU firmware.

The MIPICAL unit performs calibration at start of capture to condition the
impedance of CSI-2 D-Phy lanes. D-Phy initial DESKEW calibration is performed
when a sensor operates at or above 1.5 Gb/s. C-Phy edge delay trimmer
calibration is performed for sensors operating in that interface.

An internal Test Pattern Generator (TPG) module is present in this unit for
system bandwidth and image signal processing testing.

Pre-boot hardware auto-detection is peformed by the NVIDIA Tegra plugin-manager
for supported devices; if present, the attached camera board's Device Tree
configuration overlays additional fields for assembling a complete system
stream/channel graph for all camera sensor(s).

Required properties:
	- compatible: Should be "nvidia,tegra194-nvcsi".
	- reg: Register address space (MMIO).
	- resets: All NVCSI resets.
	- reset-names: Names of the above resets.
	- clocks: All NVCSI clocks.
	- clock-names: Names of the above clocks.
	- power-domains: Power domain group, should be
		"TEGRA194_POWER_DOMAIN_VE".
	- interrupts: All NVCSI interrupts.
	- num-ports: Total number of physical D-Phy or C-Phy combo ports on
		system.

	-- Camera Board Configuration --
	- num-channels: Total number of physically-connected NVCSI sources
		(streams), usually equal to the number of sensors and/or SERDES
		attached (note: the latter is counted as a single source).
	- #address-cells: Number of address cells in each subnode, set to <1>.
	- #size-cells: Number of size cells in each subnode, set to <0>.

	-- Channels (channel@XY) --
	- reg: The NVCSI stream index, {0-7}.

	-- Port (ports) --
	- #address-cells: Number of address cells in each subnode, set to <1>.
	- #size-cells: Number of size cells in each subnode, set to <0>.

	-- Ports (port@PQ) --
	- reg: Sensor-link (<0>) or VI-link (<1>).

	-- Endpoint (endpoint@{0,1}) --
	- port-index: Sensor-link only, NVCSI port index; {0-7} (A-H).
	- bus-width: Sensor-link only, number of D-Phy lanes or C-Phy trios used
		in SCIL; {1-4}.
	- remote-endpoint: Label to sensor or VI node.

Example:

	nvcsi: nvcsi@15a00000 {
		compatible = "nvidia,tegra194-nvcsi";
		reg = <0x0 0x15a00000 0x0 0x00050000>;
		resets = <&bpmp_resets TEGRA194_RESET_NVCSI>;
		clocks = <&bpmp_clks TEGRA194_CLK_NVCSI>,
			<&bpmp_clks TEGRA194_CLK_NVCSILP>;
		clock-names = "nvcsi", "nvcsilp";
		power-domains = <&bpmp TEGRA194_POWER_DOMAIN_VE>;
		interrupts = <0 119 0x04>;
		num-ports = <6>;
	};

	/* Camera board-specific config overlay */
	nvcsi@15a00000 {
		num-channels = <2>;
		#address-cells = <1>;
		#size-cells = <0>;
		channel@0 {
			reg = <0>;
			ports {
				#address-cells = <1>;
				#size-cells = <0>;
				port@0 {
					reg = <0>;
					liimx274_csi_in0: endpoint@0 {
						port-index = <0>;
						bus-width = <4>;
						remote-endpoint = <&liimx274_imx274_out0>;
					};
				};
				port@1 {
					reg = <1>;
					liimx274_csi_out0: endpoint@1 {
						remote-endpoint = <&liimx274_vi_in0>;
					};
				};
			};
		};
		channel@1 {
			reg = <1>;
			ports {
				#address-cells = <1>;
				#size-cells = <0>;
				port@0 {
					reg = <0>;
					liimx274_csi_in1: endpoint@2 {
						port-index = <2>;
						bus-width = <4>;
						remote-endpoint = <&liimx274_imx274_out1>;
					};
				};
				port@1 {
					reg = <1>;
					liimx274_csi_out1: endpoint@3 {
						remote-endpoint = <&liimx274_vi_in1>;
					};
				};
			};
		};
	};
```
