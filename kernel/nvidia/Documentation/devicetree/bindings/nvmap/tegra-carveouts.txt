## kernel/nvidia/Documentation/devicetree/bindings/platform/tegra/nvidia,denver15-pmu.txt
```
NVIDIA Denver PMU
=================

This driver supports hardware perfmon event counting for the Denver L2 cluster.
The supported events are standard ARM L2 event numbering, but with a
0xd00 mask to differentiate these events from the A57 L2 cluster.

Required properties:
	- compatible: "nvidia,denver15-pmu"
	- interrupts: single hardware-specified interrupt
	- interrupt-affinity : this driver must be pinned to Denver core 0 (cpu@0)
		in order to correctly field PMU interrupts from the L2.

Example:
	denver-pmu {
		compatible = "nvidia,denver15-pmu";
		interrupts = <0 290 0x4>;
		interrupt-affinity = <&{/cpus/cpu@0}>;
	};
```

## kernel/nvidia/Documentation/devicetree/bindings/platform/tegra/nvidia,tegra-bwmgr.txt
```
NVIDIA Tegra EMC BWMGR(External Memory Controller Bandwidth Manager)

Tegra EMC BWMGR controls the EMC clock rate by aggregating all the EMC client
requests and calculating the final clock rate.
EMC BWMGR also registers a cooling device with the thermal framework
(AO-therm zone) to track DRAM temperature which will impact efficiency tables.

Required properties:
	- compatible : "nvidia,bwmgr"
	- clocks : List of phandle and clock specifier pairs.
			This should be EMC clock for BWMGR.
	- status : Should be "disabled" or "okay"

Optional properties:
	- clock-names : List of clocks that control the memory subsystem
			managed by BWMGR. Input name strings sorted in the same
			order as the clocks property.  Consumers drivers
			will use clock-names to match clock input names
			with clocks specifiers.
	- cdev-type : Name of cooling device.
	- #cooling-cells : Provides cooling device specific information.
			Must be at least 2, to represent minimum followed
			by maximum cooling state.

	- cooling-min-level : The smallest cooling state.
	- cooling-max-level : The largest cooling state.

For more information on cooling device refer,
        Documentation/devicetree/bindings/thermal/thermal.txt

Example:
	bwmgr: bwmgr {
		compatible = "nvidia,bwmgr";
		clocks = <&bpmp_clks TEGRA194_CLK_EMC>;
		clock-names = "emc";
		cdev-type = "bwmgr-therm-handler";
		cooling-min-state = <0>;
		cooling-max-state = <1>;
		#cooling-cells = <2>;
		status = "okay";
	};

	AO-therm {
		status = "okay";

		thermal-zone-params {
			governor-name = "step_wise";
		};

		trips {
			trip_dram_refresh {
				temperature = <85000>;
				type = "active";
				hysteresis = <3000>;
				writable;
			};
		};
		cooling-maps {
			map0 {
				trip = <&{/thermal-zones/AO-therm/trips/trip_dram_refresh}>;
				cdev-type = "bwmgr-therm-handler";
				cooling-device = <&bwmgr THERMAL_NO_LIMIT THERMAL_NO_LIMIT>;
			};
		};
	};
```

## kernel/nvidia/Documentation/devicetree/bindings/platform/tegra/nvidia,tegra-hv-xhci-debug.txt
```
NVIDIA Hypervisor XHCI server debug driver
==========================================

This document defines the device-specific binding for NVIDIA Hypervisor XHCI server debug driver.
The NVIDIA Hypervisor XHCI server debug driver adds support of getting XHCI firmware log from XHCI Server in virtualization setup.

Required properties:

- compatible: Should be "nvidia,tegra-hv-xhci-debug"
- ivc: IVC channel number reserved between XHCI Server and the VM

Below is a sample Hypervisor XHCI server debug driver's DT entry with IVC channel number as 72.

tegra_hv_xhci_debug@0 {
                ivc = <&tegra_hv 72>;
                status = "okay";
};
```

## kernel/nvidia/Documentation/devicetree/bindings/platform/tegra/nvidia,tegra-mc-sid.txt
```
Nvidia, tegra-mc-sid:
==================

The device node describes arm mc-sid properties.
Each device(cpu, DMA capable engines) behind smmu, does memory Rd/Wr
transaction. These transactions go through MC SID, memory controller
stream id HW. The MC sid HW allowes adding/overriding StreamID to a transaction.

All these things defines by Nvidia, tegra-mc-sid dt node.

Required properties:
--------------------
- compatible = Must be one of the following
               "nvidia,tegra-mc-sid"
               or
               "nvidia,tegra186-mc-sid"
               or
               "nvidia,tegra194-mc-sid"
-reg = MC Sid registers ranges

Optional properties:
--------------------
- nvidia,host1x-ctx-streamid: Stream id for host1x context bank

Examples:
=========

mc_sid@2c00000 {
	compatible = "nvidia,tegra186-mc-sid";
	reg = <0x0 0x02c00000 0x0 0xb0000>;
	nvidia,host1x-ctx-streamid;
};
```

## kernel/nvidia/Documentation/devicetree/bindings/platform/tegra/nvidia,tegra-mc.txt
```
NVIDIA Tegra MC(Memory Controller)

Required properties:
	- compatible : Must be one of the following SoC-specific values:
			"nvidia,tegra-18x-mc"
			 or
			"nvidia,tegra-t19x-mc"
			or
			"nvidia,tegra-mc-none"
	- reg : Should contain 2 register ranges(address and length); see the
		example below. Note that the MC registers are interleaved with the
		GART registers, and hence must be represented as multiple ranges.
		For each MC there will be register space. 0th reg space for
		MC global channel. 1st reg space for MC channel 0, 2nd for MC channel
		1 and so on for <channels> value
	- reg-ranges : register range for a MC register space for a channel
	- interrupts : Must contain a list of interrupt specifiers for memory
		controller interrupts, if available.
	- int_mask : interrupt mask to detect type of mc err
	- ecc_int_mask : interrupt mask for ECC errors
	- channels : MC channels
	- status ; MC is disabled or okay


Optional properties:
	- ranges : used for parent to child address translation
	- mssnvlink : Optional child node telling number of channels from MSS
		      to gpu
		mssnvlink_hubs : Number of mss-gpu links
Example:
	mc {
		#address-cells = <2>;
		#size-cells = <2>;
		compatible = "nvidia,tegra-t19x-mc";
		reg-ranges = <1>;
		reg	   = <0x0 0x2c10000 0x0 0x10000   /* MCB */
			      0x0 0x2c20000 0x0 0x10000   /* MC0 */
			      0x0 0x2c30000 0x0 0x10000   /* MC1 */
			      0x0 0x2c40000 0x0 0x10000   /* MC2 */
			      0x0 0x2c50000 0x0 0x10000   /* MC3 */
			      0x0 0x2b80000 0x0 0x10000   /* MC4 */
			      0x0 0x2b90000 0x0 0x10000   /* MC5 */
			      0x0 0x2ba0000 0x0 0x10000   /* MC6 */
			      0x0 0x2bb0000 0x0 0x10000   /* MC7 */
			      0x0 0x1700000 0x0 0x10000   /* MC8 */
			      0x0 0x1710000 0x0 0x10000   /* MC9 */
			      0x0 0x1720000 0x0 0x10000   /* MC10 */
			      0x0 0x1730000 0x0 0x10000   /* MC11 */
			      0x0 0x1740000 0x0 0x10000   /* MC12 */
			      0x0 0x1750000 0x0 0x10000   /* MC13 */
			      0x0 0x1760000 0x0 0x10000   /* MC14 */
			      0x0 0x1770000 0x0 0x10000   /* MC15 */
			      0x0 0x2C60000 0x0 0x10000   /* EMCB */
			      0x0 0x2c70000 0x0 0x10000   /* EMC0 */
			      0x0 0x2c80000 0x0 0x10000   /* EMC1 */
			      0x0 0x2c90000 0x0 0x10000   /* EMC2 */
			      0x0 0x2ca0000 0x0 0x10000   /* EMC3 */
			      0x0 0x2cb0000 0x0 0x10000   /* EMC4 */
			      0x0 0x2cc0000 0x0 0x10000   /* EMC5 */
			      0x0 0x2cd0000 0x0 0x10000   /* EMC6 */
			      0x0 0x2ce0000 0x0 0x10000   /* EMC7 */
			      0x0 0x1780000 0x0 0x10000   /* EMC8 */
			      0x0 0x1790000 0x0 0x10000   /* EMC9 */
			      0x0 0x17a0000 0x0 0x10000   /* EMC10 */
			      0x0 0x17b0000 0x0 0x10000   /* EMC11 */
			      0x0 0x17c0000 0x0 0x10000   /* EMC12 */
			      0x0 0x17d0000 0x0 0x10000   /* EMC13 */
			      0x0 0x17e0000 0x0 0x10000   /* EMC14 */
			      0x0 0x17f0000 0x0 0x10000>; /* EMC15 */

		interrupts = <0 223 0x4>, <0 224 0x4>;
		int_mask   = <0x1b3140>;
		ecc_int_mask   = <0x1c00>;

		channels   = <16>;
		ranges;
		status = "disabled";

		mssnvlink@1f20000 {
			reg = <0x0 0x1f20000 0x0 0x20000   /* MSSNVLINK 1: igpu0 link */
			       0x0 0x1f40000 0x0 0x20000   /* MSSNVLINK 2: igpu1 link */
			       0x0 0x1f60000 0x0 0x20000   /* MSSNVLINK 3: igpu2 link */
			       0x0 0x1f80000 0x0 0x20000>; /* MSSNVLINK 4: igpu3 link */
			mssnvlink_hubs = <4>;
		};
	};
```
