## kernel/nvidia/Documentation/devicetree/bindings/pinctrl/nvidia,tegra194-pinmux.txt
```
NVIDIA Tegra194 pinmux controller.

Required properties:
- compatible : "nvidia,tegra194-pinmux".
- reg : Should contain the physical address and length of the pin.

Please refer to pinctrl-bindings.txt in this directory for details of the
common pinctrl bindings used by client devices, including the meaning of the
phrase "pin configuration node".

The name of each subnode is not important; all subnodes should be enumerated
and processed purely based on their content.

Each subnode only affects those parameters that are explicitly listed. In
other words, a subnode that lists a mux function but no pin configuration
parameters implies no information about any pin configuration parameters.
Similarly, a pin subnode that describes a pullup parameter implies no
information about e.g. the mux function or tristate parameter. For this
reason, even seemingly boolean values are actually tristates in this binding:
unspecified, off, or on. Unspecified is represented as an absent property,
and off/on are represented as integer values 0 and 1.

See the TRM to determine which properties and values apply to each pin/group.
Macro values for property values are defined in
include/dt-binding/pinctrl/pinctrl-tegra.h.

Required subnode-properties:
- nvidia,pins : An array of strings. Each string contains the name of a pin or
    group. Valid values for these names are listed below.

Optional subnode-properties:
- nvidia,function: A string containing the name of the function to mux to the
    pin or group.
- nvidia,pull: Integer, representing the pull-down/up to apply to the pin.
    0: none, 1: down, 2: up.
- nvidia,tristate: Integer.
    0: drive, 1: tristate.
- nvidia,enable-input: Integer. Enable the pin's input path.
    enable :TEGRA_PIN_ENABLE0 and
    disable or output only: TEGRA_PIN_DISABLE.
- nvidia,open-drain: Integer.
    enable: TEGRA_PIN_ENABLE.
    disable: TEGRA_PIN_DISABLE.
- nvidia,lock: Integer. Lock the pin configuration against further changes
    until reset.
    enable: TEGRA_PIN_ENABLE.
    disable: TEGRA_PIN_DISABLE.
- nvidia,io-hv: Integer. Select high-voltage receivers.
    normal: TEGRA_PIN_DISABLE
    high: TEGRA_PIN_ENABLE
- nvidia,high-speed-mode: Integer. Enable high speed mode the pins.
    normal: TEGRA_PIN_DISABLE
    high: TEGRA_PIN_ENABLE
- nvidia,schmitt: Integer. Enables Schmitt Trigger on the input.
    normal: TEGRA_PIN_DISABLE
    high: TEGRA_PIN_ENABLE
- nvidia,drive-type: Integer. Valid range 0...3.
- nvidia,pull-down-strength: Integer. Controls drive strength. 0 is weakest.
    The range of valid values depends on the pingroup. See "CAL_DRVDN" in the
    Tegra TRM.
- nvidia,pull-up-strength: Integer. Controls drive strength. 0 is weakest.
    The range of valid values depends on the pingroup. See "CAL_DRVUP" in the
    Tegra TRM.
- nvidia,slew-rate-rising: Integer. Controls rising signal slew rate. 0 is
    fastest. The range of valid values depends on the pingroup. See
    "DRVDN_SLWR" in the Tegra TRM.
- nvidia,slew-rate-falling: Integer. Controls falling signal slew rate. 0 is
    fastest. The range of valid values depends on the pingroup. See
    "DRVUP_SLWF" in the Tegra TRM.

Valid values for pin and group names (nvidia,pins) are:

  MUX groups:

    These correspond to Tegra PINMUX_AUX_* (pinmux) registers. Any property
    that exists in those registers may be set for the following pin names.

    ao_retention_n_pee2, aud_mclk_ps4, batt_oc_pee3, cam_i2c_scl_pp2,
    cam_i2c_sda_pp3, can0_din_paa3, can0_dout_paa2, can0_en_paa5, can0_err_paa7,
    can0_stb_paa4, can0_wake_paa6, can1_din_paa1, can1_dout_paa0, can1_en_pbb1,
    can1_err_pbb3, can1_stb_pbb0, can1_wake_pbb2, clk_32k_in, cpu_pwr_req_0_pb0,
    cpu_pwr_req_1_pb1, cv_pwr_req_px1, dap1_din_ps2, dap1_dout_ps1, dap1_fs_ps3,
    dap1_sclk_ps0, dap2_din_pi1, dap2_dout_pi0, dap2_fs_pi2, dap2_sclk_ph7,
    dap3_din_pt3, dap3_dout_pt2, dap3_fs_pt4, dap3_sclk_pt1, dap4_din_pa6,
    dap4_dout_pa5, dap4_fs_pa7, dap4_sclk_pa4, dap5_din_pt7, dap5_dout_pt6,
    dap5_fs_pu0, dap5_sclk_pt5, dap6_din_pa2, dap6_dout_pa1, dap6_fs_pa3,
    dap6_sclk_pa0, directdc1_clk_pv0, directdc1_in_pv1, directdc1_out0_pv2,
    directdc1_out1_pv3, directdc1_out2_pv4, directdc1_out3_pv5,
    directdc1_out4_pv6, directdc1_out5_pv7, directdc1_out6_pw0,
    directdc1_out7_pw1, directdc_comp, dp_aux_ch0_hpd_pm0, dp_aux_ch1_hpd_pm1,
    dp_aux_ch2_hpd_pm2, dp_aux_ch3_hpd_pm3, eqos_comp, eqos_rd0_pe6,
    eqos_rd1_pe7, eqos_rd2_pf0, eqos_rd3_pf1, eqos_rxc_pf3, eqos_rx_ctl_pf2,
    eqos_sma_mdc_pf5, eqos_sma_mdio_pf4, eqos_td0_pe1, eqos_td1_pe2,
    eqos_td2_pe3, eqos_td3_pe4, eqos_txc_pe0, eqos_tx_ctl_pe5,
    extperiph1_clk_pp0, extperiph2_clk_pp1, gen1_i2c_scl_pi3, gen1_i2c_sda_pi4,
    gen2_i2c_scl_pcc7, gen2_i2c_sda_pdd0, gen8_i2c_scl_pdd1, gen8_i2c_sda_pdd2,
    gp_pwm2_px2, gp_pwm3_px3, gpu_pwr_req_px0, hdmi_cec_pm4,
    pex_l0_clkreq_n_pk0, pex_l0_rst_n_pk1, pex_l1_clkreq_n_pk2,
    pex_l1_rst_n_pk3, pex_l2_clkreq_n_pk4, pex_l2_rst_n_pk5,
    pex_l3_clkreq_n_pk6, pex_l3_rst_n_pk7, pex_l4_clkreq_n_pl0,
    pex_l4_rst_n_pl1, pex_l5_clkreq_n_pgg0, pex_l5_rst_n_pgg1,
    pex_wake_n_pl2, pmu_int_n, power_on_pee4, pwr_i2c_scl_pee5,
    pwr_i2c_sda_pee6, qspi0_cs_n_pc1, qspi0_io0_pc2, qspi0_io1_pc3,
    qspi0_io2_pc4, qspi0_io3_pc5, qspi0_sck_pc0, qspi1_cs_n_pc7, qspi1_io0_pd0,
    qspi1_io1_pd1, qspi1_io2_pd2, qspi1_io3_pd3, qspi1_sck_pc6, qspi_comp,
    safe_state_pee0, sata_dev_slp_pl3, sdmmc1_clk_pj0, sdmmc1_cmd_pj1,
    sdmmc1_comp, sdmmc1_dat0_pj2, sdmmc1_dat1_pj3, sdmmc1_dat2_pj4,
    sdmmc1_dat3_pj5, sdmmc1_hv_trim, sdmmc3_clk_po0, sdmmc3_cmd_po1,
    sdmmc3_comp, sdmmc3_dat0_po2, sdmmc3_dat1_po3, sdmmc3_dat2_po4,
    sdmmc3_dat3_po5, sdmmc3_hv_trim, sdmmc4_clk, sdmmc4_cmd, sdmmc4_dat0,
    sdmmc4_dat1, sdmmc4_dat2, sdmmc4_dat3, sdmmc4_dat4, sdmmc4_dat5,
    sdmmc4_dat6, sdmmc4_dat7, sdmmc4_dqs, shutdown_n, soc_gpio00_pg0,
    soc_gpio01_pg1, soc_gpio02_pg2, soc_gpio03_pg3, soc_gpio04_pp4,
    soc_gpio05_pp5, soc_gpio06_pp6, soc_gpio07_pp7, soc_gpio08_pg4,
    soc_gpio09_pg5, soc_gpio10_pg6, soc_gpio11_pg7, soc_gpio12_ph0,
    soc_gpio13_ph1, soc_gpio14_ph2, soc_gpio20_pq0, soc_gpio21_pq1,
    soc_gpio22_pq2, soc_gpio23_pq3, soc_gpio30_ps5, soc_gpio31_ps6,
    soc_gpio32_ps7, soc_gpio33_pt0, soc_gpio40_pq4, soc_gpio41_pq5,
    soc_gpio42_pq6, soc_gpio43_pq7, soc_gpio44_pr0, soc_gpio45_pr1,
    soc_gpio50_pm5, soc_gpio51_pm6, soc_gpio52_pm7, soc_gpio53_pn0,
    soc_gpio54_pn1, soc_gpio55_pn2, soc_pwr_req, spi1_cs0_pz6, spi1_cs1_pz7,
    spi1_miso_pz4, spi1_mosi_pz5, spi1_sck_pz3, spi2_cs0_pcc3, spi2_miso_pcc1,
    spi2_mosi_pcc2, spi2_sck_pcc0, spi3_cs0_py3, spi3_cs1_py4, spi3_miso_py1,
    spi3_mosi_py2, spi3_sck_py0, sys_reset_n, touch_clk_pcc4, uart1_cts_pr5,
    uart1_rts_pr4, uart1_rx_pr3, uart1_tx_pr2, uart2_cts_px7, uart2_rts_px6,
    uart2_rx_px5, uart2_tx_px4, uart3_rx_pcc6, uart3_tx_pcc5, uart4_cts_ph6,
    uart4_rts_ph5, uart4_rx_ph4, uart4_tx_ph3, uart5_cts_pz0, uart5_rts_py7,
    uart5_rx_py6, uart5_tx_py5, ufs0_ref_clk_pff0, ufs0_rst_pff1,
    usb_vbus_en0_pz1, usb_vbus_en1_pz2, vcomp_alert_pee1.

Valid values for nvidia,functions are:

    aud, can0, can1, ccla, dca, dcb, dgpu, directdc, directdc1, displaya,
    displayb, dmic1, dmic2, dmic3, dmic4, dmic5, dp, dspk0, dspk1, eqos,
    extperiph1, extperiph2, extperiph3, extperiph4, gp, gpio, hdmi, i2c1,
    i2c2, i2c3, i2c5, i2c8, i2s1, i2s2, i2s3, i2s4, i2s5, i2s6, igpu, iqc1,
    iqc2, mipi, nv, pe0, pe1, pe2, pe3, pe4, pe5, qspi, qspi0, qspi1, rsvd0,
    rsvd1, rsvd2, rsvd3, sata, sce, sdmmc1, sdmmc3, sdmmc4, slvs, soc, spdif,
    spi1, spi2, spi3, touch, uarta, uartb, uartc, uartd, uarte, uartg, ufs0,
    usb, vgp1, vgp2, vgp3, vgp4, vgp5, vgp6, wdt.

Example:

	pinmux@2430000 {
		compatible = "nvidia,tegra194-pinmux";
		reg = <0x0 0x2430000 0x0 0x17000
		0x0 0xc300000 0x0 0x4000>;
		#gpio-range-cells = <3>;
		status = "disabled";

		vbus_en0_sfio_tristate_state: vbus_en0_oc_tristate {
			usb_vbus_en0_pz1 {
				nvidia,pins = "usb_vbus_en0_pz1";
				nvidia,function = "usb";
				nvidia,tristate = <TEGRA_PIN_ENABLE>;
				nvidia,io-high-voltage = <TEGRA_PIN_ENABLE>;
				nvidia,enable-input = <TEGRA_PIN_ENABLE>;
			};
		};
	};
```

## kernel/nvidia/Documentation/devicetree/bindings/platform/tegra/bridge-mca.txt
```
NVIDIA Tegra18x Bridge MCA driver
==================================

This document defines the device-specific binding for the Tegra18x bridge MCA
driver. The Bridge MCA driver adds support for machine check errors due to
errors from AXI/APB and AXI/P2P bridges within backbone hardware in T18x.
The driver reports relevant information like CPU, bus address, error status,
type of bridge, etc in case of a Bridge MCA.

Required properties:

- compatible: Should be "nvidia,tegra186-AXI2APB-bridge"
- reg: Physical base address and length of registers
- clocks: Specifies the needed clocks
- clock-names: Specifies the names of the needed clocks
- timeout: specify the bridge timeout in micro seconds (us)

Below is a sample bridge DT entry for configuring bridge timeout=500 usec
for axi2apb@2390000 bridge.

axi2apb@2390000 {
		compatible = "nvidia,tegra186-AXI2APB-bridge";
		reg = <0x0 0x02390000 0x0 0x1000>;
		clocks = <&tegra_car TEGRA186_CLK_AXI_CBB>;
		clock-names = "axi_cbb";
		timeout = <500>;
		status = "disabled";
};


Required properties:

- compatible: Should be "nvidia,tegra186-AXIP2P-bridge"
- reg: Physical base address and length of registers
- clocks: Specifies the needed clocks
- clock-names: Specifies the names of the needed clocks
- timeout: specify the bridge timeout in micro seconds (us)

Below is a sample bridge DT entry for configuring bridge timeout=97000 usec
for axip2p@2100000 bridge.

        axip2p@2100000 {
                compatible = "nvidia,tegra186-AXIP2P-bridge";
                reg = <0x0 0x02100000 0x0 0x1000>;
                clocks = <&tegra_car TEGRA186_CLK_AXI_CBB>;
                clock-names = "axi_cbb";
                timeout = <97000>;
                status = "disabled";
        };
```

## kernel/nvidia/Documentation/devicetree/bindings/platform/tegra/camera/tegra-mipical-hv.txt
```
NVIDIA Tegra Hypervisor (hv) MIPICAL bindings

The MIPICAL unit performs calibration at start of capture or transmission to
condition the impedance of MIPI D-Phy CSI-2 and DSI lanes. Hypervisor can
own the mipical driver, and receive/send messages to guest OS.

Required properties:
	- compatible: Should be "nvidia,tegra-mipical-hv".
	- ivc_queue: ivc queue to receive messages.
	- status: Can be "okay" to enable kernel probe or "disabled".

Example:

	mipical@3990000 {
		compatible = "nvidia,tegra-mipical-hv";
		ivc_queue = <&tegra_hv 101>
		status = "disabled";
	};
```

## kernel/nvidia/Documentation/devicetree/bindings/platform/tegra/camera/tegra186-isp4.txt
```
NVIDIA Tegra Parker (T18x) ISP4 bindings

Tegra ISP4 (Image Signal Processor, version 4), is a pixel processing unit
operating on optical sensor data from VI or memory. Functional control is
implemented in NVDIA user-space driver libraries.

Required properties:
	- compatible: Should be "nvidia,tegra186-isp".
	- reg: Register address space (MMIO).
	- power-domains: Power domain group, should be
		"TEGRA186_POWER_DOMAIN_ISPA".
	- resets: All ISP resets.
	- clocks: All ISP clocks.
	- clock-names: Names of the above clocks.
	- interrupts: All ISP interrupts.
	- iommus: ISP4 Stream ID, should be "TEGRA_SID_ISP".
	- iommu-group-id: IOMMU group, should be "TEGRA_IOMMU_GROUP_HOST1X".

Example:

	isp@15600000 {
		compatible = "nvidia,tegra186-isp";
		reg = <0x0 0x15600000 0x0 0x00040000>;
		power-domains = <&bpmp TEGRA186_POWER_DOMAIN_ISPA>;
		resets = <&tegra_car TEGRA186_RESET_ISP>;
		clocks = <&tegra_car TEGRA186_CLK_ISP>;
		clock-names = "isp";
		interrupts = <0 205 0x04>;
		iommus = <&smmu TEGRA_SID_ISP>;
		iommu-group-id = <TEGRA_IOMMU_GROUP_HOST1X>;
	};
```

## kernel/nvidia/Documentation/devicetree/bindings/platform/tegra/camera/tegra186-mipical.txt
```
NVIDIA Tegra Parker (T18x) MIPICAL bindings

The MIPICAL unit performs calibration at start of capture or transmission to
condition the impedance of MIPI D-Phy CSI-2 and DSI lanes.

Required properties:
	- compatible: Should be "nvidia, tegra186-mipical".
	- reg: Register address space (MMIO).
	- clocks: All MIPICAL clocks.
	- clock-names: Names of the above clocks.
	- resets: All MIPICAL resets.
	- reset-names: Names of the above resets.

	-- PROD value groups (prod-settings) --
	- #prod-cells: Number of PROD settings per config tuple (default: 3).

	-- PROD values (prod) in grouping --
	- prod: List of tuples (each size #prod-cells) corresponding to a PROD
		config.

Example:

	mipical {
		compatible = "nvidia, tegra186-mipical";
		reg = <0x0 0x03990000 0x0 0x00010000>;
		clocks = <&tegra_car TEGRA186_CLK_MIPI_CAL>,
			<&tegra_car TEGRA186_CLK_UART_FST_MIPI_CAL>;
		clock-names = "mipi_cal", "uart_fs_mipi_cal";
		resets = <&tegra_car TEGRA186_RESET_MIPI_CAL>;
		reset-names = "mipi_cal";
	};

	/* PROD settings */
	prod-settings {
		#prod-cells = <3>;

		prod {
			prod = <
				0x00000004 0x3f000012 0x2a000010
				0x00000018 0x40000000 0x00000000
				0x0000001c 0x40000000 0x00000000
				0x00000020 0x40000000 0x00000000
				0x00000024 0x40000000 0x00000000
				0x00000028 0x40000000 0x00000000
				0x0000002c 0x40000000 0x00000000
				0x0000003c 0x00001f00 0x00000200
				0x00000040 0x00001f00 0x00000200
				0x00000044 0x00001f00 0x00000200
				0x00000048 0x00001f00 0x00000200
				0x0000005c 0x00000001 0x00000000
				0x00000060 0x000f0f0f 0x00000000
				0x00000064 0x0f0ffff5 0x00010010
				0x00000068 0x4000001f 0x00000000
				0x0000006c 0x4000001f 0x00000000
				0x00000074 0x4000001f 0x00000000
				0x00000078 0x4000001f 0x00000000>;
		};

		prod_c_dphy_csi {
			prod = < ... >;

			mipical_prod_c_dphy_csi_soc_a01:soc_a01 {
				status = "disabled";
				prod = < ... >;
			};
		};

		prod_c_dphy_dsi {
			prod = < ... >;

			mipical_prod_c_dphy_dsi_soc_a01:soc_a01 {
				status = "disabled";
				prod = < ... >;
			};
		};
	};
```
