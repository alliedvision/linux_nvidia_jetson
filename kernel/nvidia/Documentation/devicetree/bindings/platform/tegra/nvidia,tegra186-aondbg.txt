## kernel/nvidia/Documentation/devicetree/bindings/sound/nvidia,tegra186-virt-pcm.txt
```
* NVIDIA Tegra Virtualized Audio Machine Driver

The Tegra Virtualized Audio Machine Driver is used to configure
sound card properties.

Required properties:
- compatible : Must be "nvidia,tegra186-virt-pcm".
- dmas : phandle to ADMA device and dma channel.
- dma-names : alias name for rx and tx dma channel.
- dma-buffer-size : max buffer size for pcm buffers.
- iommus : phandle for smmu and audio stream id.
- cardname : name of sound card.
- ivc_queue : phandle for tegra_hv and queue if.
- admaif_ch_num : Number of admaif channel assigned.
- admaif_ch_num : list of admaif channels assigned.
- adsp_enabled : need to have this property to enable adsp.
- power-domains : Must be empty.
- adsp-admaifX-channels : No. of channels for admaif X
- adsp-admaifX-bits : Bit format[16,32] for admaif X
- nvidia,adma_ch_page : adma page instance id

Example:

virt-alt-pcm {
	compatible = "nvidia,tegra186-virt-pcm";
	iommus = <&smmu TEGRA_SID_APE_1>;
	power-domains = <>;
	cardname = "tegra-virt-pcm-vm1";
	dmas = <&adma 1>, <&adma 1>, <&adma 2>, <&adma 2>,
		<&adma 3>, <&adma 3>, <&adma 4>, <&adma 4>;
	dma-names = "rx1", "tx1", "rx2", "tx2",
		"rx3", "tx3", "rx4", "tx4";
	dma-buffer-size = <65536>, <65536>, <65536>, <65536>,
		<65536>, <65536>, <65536>, <65536>;
	ivc_queue = <&tegra_hv 56>;
	admaif_ch_num = <4>;
	admaif_ch_list = <1>, <2>, <3>, <4>;
	adsp_enabled;
	adsp-admaif4-channels = <12>;
	adsp-admaif4-bits = <16>;
	nvidia,adma_ch_page = <0>;
};
```

## kernel/nvidia/Documentation/devicetree/bindings/sound/nvidia,tegra210-adsp-audio-hv.txt
```
* NVIDIA Tegra Virtualized  ADSP Audio Driver

The Tegra ADSP Audio Driver provide interface to userspace
to start adsp and configure plugins properties.

Required properties:
- compatible : Must be "nvidia,tegra210-adsp-audio-hv".
- nvidia,adma_ch_start : starting adma channel no. assigned to adsp.
- nvidia,adma_ch_cnt : total adma channels assigned to adsp.
- num-plugin : total number of adsp plugins.
- apmX-stack-size : stack size assigned to adsp plugin X.
- plugin-info-X : plugin X node.
- plugin-name : name of plugin.
- firmware-name : name of firmware embedded in adsp.
- widget-name : alsa exposed plugin control name.
- param-type : plugin input format decoding[1: byte 2: integer].

Example:

adsp_audio {
	compatible = "nvidia,tegra210-adsp-audio-hv";
	status = "okay";
	nvidia,adma_ch_start = <20>;
	nvidia,adma_ch_cnt = <12>;
	apm1-stack-size = <24576>;
	num-plugin = <1>;
	plugin-info-1 {
		plugin-name = "reverb";
		firmware-name = "libnvreverbfx.elf";
		widget-name = "REVERB";
		param-type = <2>; /* SNDRV_CTL_ELEM_TYPE_INTEGER */
	};
};
```

## kernel/nvidia/Documentation/devicetree/bindings/spi/aurix-tegra-spi.txt
```
SPI Protocol Driver for Aurix-Tegra communication

This is a SPI protocol driver that is used to provide protocol based
communicaton between Aurix and Tegra

Required properties :
- compatible : "aurix-tegra-spi"
- spi-max-frequency : Maximum SPI clocking speed to be used for communication


Example:

        spi@c260000 {
                compatible = "nvidia,tegra186-spi-slave";
                reg = <0x0 0xc260000 0x0 0x10000>;
                interrupts = <0x0 0x25 0x4>;
                #address-cells = <0x1>;
                #size-cells = <0x0>;
                iommus = <0x6 0x20>;
                dma-coherent;
                dmas = <0x11 0x10 0x11 0x10>;
                dma-names = "rx", "tx";
                spi-max-frequency = <65000000>;
                nvidia,clk-parents = "pll_p", "osc";
                clocks = <0x4 0x88 0x4 0x5e 0x4 0x5b>;
                clock-names = "spi", "pll_p", "osc";
                resets = <0x5 0x5c>;
                reset-names = "spi";
                status = "okay";
                linux,phandle = <0x8b>;
                phandle = <0x8b>;

                spi@0 {
                        compatible = "aurix-tegra-spi";
                        spi-max-frequency = <10000000>;
                };
        };
};
```

## kernel/nvidia/Documentation/devicetree/bindings/spi/nvidia,tegra186-aon-spi.txt
```
NVIDIA Tegra AON SPI controller.

This is a wrapper driver that makes call to AON cluster which control
AON SPI controller. Clock, reset and dma controls are handled by native
driver in AON.

Required properties :
- compatible : "nvidia,tegra186-aon-spi".
- bus-number : SPI bus/controller number.
- mboxes : Mailbox used to communicate with AON SPI native driver.

Recommended properties:
- spi-max-frequency : Definition as per
                     Documentation/devicetree/bindings/spi/spi-bus.txt

Optional properties :

spi-client device controller properties :
  Below properties should be defined under 'controller-data' child node.
  These values will be passed on to AON native driver.
- nvidia,cs-setup-clk-count : CS setup timing parameter.
- nvidia,cs-hold-clk-count : CS hold timing parameter.
- nvidia,cs-inactive-cycles : Cycles to be inactive between two packets.
  CS Inactive between packets is disabled if the value of this is zero.

Example:

aon_spi: aon_spi@c260000 {
	compatible = "nvidia,tegra186-aon-spi";
	bus-number = <1>;
	#address-cells = <1>;
	#size-cells = <0>;
	spi-max-frequency = <12000000>;
	mboxes = <&aon 2>;
};
```

## kernel/nvidia/Documentation/devicetree/bindings/tegra_hv/tegra_hv.txt
```
Tegra Hypervisor manager

Instantiates virtualization related resources such as ivc, mempool
ivc is used for inter-VM communication
mempool is used for data exchange between VMs

Required properties:
- compatible: Should be "nvidia,tegra-hv"


Example:
	tegra_hv: hyp {
		compatible = "nvidia,tegra-hv";
		status = "okay";
	};
```

## kernel/nvidia/Documentation/devicetree/bindings/thermal/tegra-pwm-fan.txt
```
Bindings for a fan connected to the PWM lines

Properties details:
- compatible		: "pwm-fan"
- pwms			: the PWM that is used to control the PWM fan

- shared_data
  - active_steps	: Entries for references in active_rpm[], active_pwm[], active_rru[], active_rrd[]
  - active_rru		: This value is kept on added to cur_pwm till it reaches at
			  next active step from the table. This is repeated until cur_pwm
			  value reaches target_pwm
  - active_rrd		: This value is kept on subtracted from cur_pwm till it reaches at
			  previous active step from the table. This is repeated until cur_pwm
			  value reaches target_pwm
  - state_cap_lookup 	: Index to refer in active_pwm[]
  - pwm_period		: To derive duty cycle
  - pwm_id		: Assigned PWM controller id to tegra fan
			  Same as mentioned id in pwms. In pwms, the id starts from 1
			  pwm_id in pfsd, the id starts from 0
  - step_time		: Time taken for each step during rru/rrd
  - state_cap		: Capping state value out of available active_steps
  - active_pwm_max	: Max pwm value (256)
  - pwm_gpio		: GPIO pin used for pwm

Example:

	pwm_fan_shared_data: pfsd {
		status = "okay";
		num_resources = <0>;
		active_steps = <10>;
		active_rpm = <0 1000 2000 3000 4000 5000 6000 7000 10000 11000>;
		active_rru = <40 2 1 1 1 1 1 1 1 1>;
		active_rrd = <40 2 1 1 1 1 1 1 1 1>;
		state_cap_lookup = <2 2 2 2 3 3 3 4 4 4>;
		pwm_period = <45334>;
		pwm_id = <3>;
		step_time = <100>; /* mesecs */
		state_cap = <7>;
		active_pwm_max = <256>;
		pwm_gpio = <&tegra_aon_gpio TEGRA_AON_GPIO(V, 6) GPIO_ACTIVE_LOW>; /* TEGRA_MAIN_GPIO_PV6 */
	};
	pwm-fan {
		status = "okay";
		compatible = "pwm-fan";
		#pwm-cells = <1>;
		pwms = <&tegra_pwm4 0 45334>;
		shared_data = <&pwm_fan_shared_data>;
		active_pwm = <0 80 120 160 255 255 255 255 255 255>;
	};
};
```

## kernel/nvidia/Documentation/devicetree/bindings/tty/serial/tegra-hv-comm.txt
```
Tegra Hypervisor Communication driver

This driver simulates a serial port over a Tegra IVC channel
The serial port works exactly like a normal serial port

Required Properties:
- compatible: should be "nvidia,tegra-hv-comm"
- ivc:        ivc channel number used for communication


Example:
	tegra_hv_comm {
		compatible = "nvidia,tegra-hv-comm";
		status = "okay";
		ivc = <&tegra_hv 80>;
	};
```

## kernel/nvidia/Documentation/devicetree/bindings/video/nvidia,tegra-display-hub.txt
```
NVIDIA Tegra Display Hub

The Tegra Display Hardware (DC) provides an engine for display processing
pipeline with support of format conversion, scaling, rotation of display
content with supporting different protocols for display pipeline.

This display-hub node is used for mainly initializing chip-level information
about display HW, such as the total number of heads, windows, and SORs.
It is also used for retrieval of the static IMP table from device tree.
Rest of details for Tegra DC are given in ./nvidia,tegrat194-dc.txt

Required properties:
- compatible: Must be "nvidia,tegra186-display" or "nvidia,tegra194-display".
- reg: The physical base address and length of the address spaces for all heads.
  For T194, the physical base address should be that of HEAD0, and
  the length should be 0x40000 to cover HEAD0 - HEAD3.
- nvidia,valid_heads: This is a legacy property that is carried over from T186.
  It must be set to 0x0.
- nvidia,disp_imp_table: This table contains static IMP (Is Mode Possible)
  settings for different display configurations. IMP is essentially a SW/HW
  feature that programs display's bandwidth resources so that the display pipeline
  doesn't underflow.

Subnodes:
- display@152x0000: Refer to its binding doc:
  Documentation/devicetree/bindings/video/nvidia,tegra194-dc.txt

Example:
=======

SoC DTSI:
--------

display-hub@15200000 {
	compatible = "nvidia,tegra194-display", "simple-bus";
	reg = <0x0 0x15200000 0x0 0x40000>;
	nvidia,valid_heads = <0x0>;
	nvidia,disp_imp_table = <&disp_imp_table>;

	display@15200000 {...};
	display@15210000 {...};
	display@15220000 {...};
	display@15230000 {...};
};
```

## kernel/nvidia/Documentation/devicetree/bindings/video/nvidia,tegra194-cec.txt
```
NVIDIA Tegra Consumer Electronics Control

The Tegra CEC provides an engine for Consumer Electronics Control protocol
implementation. It is used to transfer command to connected monitor via
display connector.

This document describes the device tree bindings for the CEC hardware itself,
as well as for subnodes corresponding to this engine.

Required properties:
- status: Should be "disabled" in SoC and "okay" in Board DTSI.
- compatible: Must be "nvidia,tegra194-cec".
- reg: A list of physical base address and length of the controller's
  registers.
- interrupts: The interrupt IRQ info for the controller.
- clocks: Must contain an entry for each entry in clock-names.
- clock-names: Must include the following entries:
  "cec"

Example:
=======

SoC DTSI:
--------

tegra_cec: tegra_cec {
	status = "disabled";
	compatible = "nvidia,tegra194-cec";
	reg = <0x0 0x03960000 0x0 0x00001000>;
	interrupts = <0 162 0x04>;
	clocks = <&bpmp_clks TEGRA194_CLK_CEC>;
	clock-names = "cec";
};

Board DTSI:
----------

tegra_cec: tegra_cec {
	status = "okay";
};
```

## kernel/nvidia/Documentation/devicetree/bindings/video/nvidia,tegra194-dc.txt
```
NVIDIA Tegra Display Controller

The Tegra Display Hardware (DC) provides an engine for display processing
pipeline with support of format conversion, scaling, rotation of display
content with supporting different protocols for display pipeline.

This document describes the device tree bindings for the Display Controller
hardware itself, as well as for subnodes corresponding to this engine.

Required properties:
- status: Should be "disabled" in SoC and "okay" in Board DTSI.
- compatible: Must be "nvidia,tegra194-dc".
- reg: A list of physical base address and length of the controller's
  registers.
- interrupts: The interrupt IRQ info for the controller.
- iommus: DC Stream ID, should be "TEGRA_SID_NVDISPLAY".
- iso-smmu: Isochronous SMMU, should be set because display HW memory accesses are always ISO.
- non-coherent: Non-coherent DMA, should be set because ISO clients can't snoop CPU caches.
- nvidia,dc-ctrlnum: Controller number mapping to display hardware physical number.
- clock-names: Must include the following entries:
  "nvdisplayhub", "nvdisplay_p0", "nvdisplay_p1", "nvdisplay_p2",
  "nvdisplay_p3", "pllp_display", "pll_d", "plld2", "plld3", "plld4"
- clocks: Must contain an entry for each entry in clock-names.
  See ../clocks/clock-bindings.txt for details
- reset-names: Must include the following entries:
  - "misc", "wgrp0", "wgrp1", "wgrp2", "wgrp3", "wgrp4", "wgrp5", "headX"
- resets: Must contain an entry for each entry in reset-names.
  See ../reset/reset.txt for details.
- fb_reserved: The frame buffer reserved for this display controller.
- iommu-direct-regions: The mapping of framebuffer to this display controller.
- pinctrl-names: Define pinctrls for input/output pins per SOR.
- pinctrl-0 : The pincontrol settings to dpd disable on SOR0.
- pinctrl-1 : The pincontrol settings to dpd enable on SOR0.
- pinctrl-2: The pincontrol settings to dpd disable on SOR1.
- pinctrl-3 : The pincontrol settings to dpd enable on SOR1.
- pinctrl-4: The pincontrol settings to dpd disable on SOR2.
- pinctrl-5: The pincontrol settings to dpd enable on SOR2.
- pinctrl-6: The pincontrol settings to dpd disable on SOR3.
- pinctrl-7: The pincontrol settings to dpd enable on SOR3.
Optional properties:
- nvidia,cmu-enable: Controls output LUT on NvDisplay.
- disable-seamless:  Set to 1 if want to disable the seamless display feature. 

Example:
=======

SoC DTSI:

head0: display@15200000 {
	status: "disabled";
	compatible = "nvidia,tegra194-dc";
	reg = <0x0 0x15200000 0x0 0x10000>;
	interrupts = <0 153 4>;

	iommus = <&smmu TEGRA_SID_NVDISPLAY>;
	iso-smmu;
	non-coherent;

	nvidia,dc-ctrlnum = <0>;
	nvidia,cmu-enable = <0x1>;

	clock-names = "nvdisplay_disp",
		      "nvdisplayhub", "nvdisplay_p0",
		      "nvdisplay_p1", "nvdisplay_p2",
		      "nvdisplay_p3", "pllp_display",
		      "pll_d", "plld2",
		      "plld3", "plld4";
	clocks = <&bpmp_clks TEGRA194_CLK_NVDISPLAY_DISP>,
		 <&bpmp_clks TEGRA194_CLK_NVDISPLAYHUB>,
		 <&bpmp_clks TEGRA194_CLK_NVDISPLAY_P0>,
		 <&bpmp_clks TEGRA194_CLK_NVDISPLAY_P1>,
		 <&bpmp_clks TEGRA194_CLK_NVDISPLAY_P2>,
		 <&bpmp_clks TEGRA194_CLK_NVDISPLAY_P3>,
		 <&bpmp_clks TEGRA194_CLK_PLLP_OUT0>,
		 <&bpmp_clks TEGRA194_CLK_PLLD>,
		 <&bpmp_clks TEGRA194_CLK_PLLD2>,
		 <&bpmp_clks TEGRA194_CLK_PLLD3>,
		 <&bpmp_clks TEGRA194_CLK_PLLD4>,
		 <&bpmp_clks TEGRA194_CLK_EMC>;
	reset-names = "misc", "wgrp0", "wgrp1", "wgrp2",
		      "wgrp3", "wgrp4", "wgrp5", "head0";
	resets = <&bpmp_resets TEGRA194_RESET_NVDISPLAY0_MISC>,
		 <&bpmp_resets TEGRA194_RESET_NVDISPLAY0_WGRP0>,
		 <&bpmp_resets TEGRA194_RESET_NVDISPLAY0_WGRP1>,
		 <&bpmp_resets TEGRA194_RESET_NVDISPLAY0_WGRP2>,
		 <&bpmp_resets TEGRA194_RESET_NVDISPLAY0_WGRP3>,
		 <&bpmp_resets TEGRA194_RESET_NVDISPLAY0_WGRP4>,
		 <&bpmp_resets TEGRA194_RESET_NVDISPLAY0_WGRP5>,
		 <&bpmp_resets TEGRA194_RESET_NVDISPLAY0_HEAD0>;
	fb_reserved = <&fb0_reserved>;
	iommu-direct-regions = <&fb0_reserved &fb1_reserved
				&fb2_reserved &fb3_reserved>;

	pinctrl-names = "hdmi-dp0-dpd-disable", "hdmi-dp0-dpd-enable",
			"hdmi-dp1-dpd-disable", "hdmi-dp1-dpd-enable",
			"hdmi-dp2-dpd-disable", "hdmi-dp2-dpd-enable",
			"hdmi-dp3-dpd-disable", "hdmi-dp3-dpd-enable";
	pinctrl-0 = <&hdmi_dp0_dpd_disable>;
	pinctrl-1 = <&hdmi_dp0_dpd_enable>;
	pinctrl-2 = <&hdmi_dp1_dpd_disable>;
	pinctrl-3 = <&hdmi_dp1_dpd_enable>;
	pinctrl-4 = <&hdmi_dp2_dpd_disable>;
	pinctrl-5 = <&hdmi_dp2_dpd_enable>;
	pinctrl-6 = <&hdmi_dp3_dpd_disable>;
	pinctrl-7 = <&hdmi_dp3_dpd_enable>;
}; //display@15200000


Board DTSI:
----------

head0: display@15200000 {
	status: "okay";
};
```
