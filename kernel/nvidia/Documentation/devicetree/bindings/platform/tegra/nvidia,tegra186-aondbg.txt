## kernel/nvidia/Documentation/devicetree/bindings/platform/tegra/nvidia,tegra186-aondbg.txt
```
NVIDIA Tegra SPE/AON debug with communication via the "IVC" protocol.

AON is an aux CPU which communicates with CCPLEX over IVC. The AON debug driver
provides a set of debug features used to fetch the SPE processor state and the
power state in which it is running. It provides some debugfs nodes to fetch
FW version and some register dumps in case of an error. Also adds a provision
to enable run time debug spew.

Required properties:
- compatible
    Array of strings.
    one of:
    - "nvidia,tegra186-aondbg"
- mboxes
    Should have the respective mbox index to indicate the ivc channel id.
    Formatted as per standard rules for this property

Example:

aondbg {
    compatible = "nvidia,tegra186-aondbg";
    mboxes = <&aon 1>;
};
```

## kernel/nvidia/Documentation/devicetree/bindings/platform/tegra/nvidia,tegra186-hsp.txt
```
NVIDIA Tegra Hardware Synchronization Primitives (HSP)

The HSP modules are used for the processors to share resources and communicate
together. It provides a set of hardware synchronization primitives for
interprocessor communication. So the interprocessor communication (IPC)
protocols can use hardware synchronization primitives, when operating between
two processors not in an SMP relationship.

The HSP features supported are shared mailboxes and shared semaphores.
Arbitrated semaphores and doorbells are not currently used.

Required properties:
- name : Should be hsp
- compatible
    Array of strings.
    one of:
    - "nvidia,tegra186-hsp"
- reg : Offset and length of the register set for the device.
- interrupt-names
    Array of strings.
    Contains a list of names for the interrupts described by the interrupt
    property. May contain the following entries, in any order:
    - "shared0" (for top0 or top1 hsp only)
    - "shared1", "shared2", "shared3", "shared4"
    - "shared5", "shared6", "shared7", "doorbell" (for top0 hsp only)
    - "full0" ... "full7" (for pre-routed full mailbox interrupts only)
    - "empty0" ... "empty7" (for pre-routed empty mailbox interrupts only)
    Users of this binding MUST look up entries in the interrupt property
    by name, using this interrupt-names property to do so.
    For "sharedX", X refers to the HSP_INT_IE_<X> register used to route HSP
    interrupts to a shared interrupt.
    For "fullN" and "emptyN", N refers to the number of the shared mailbox or
    register HSP_SHRD_MBOX_MBOX_<N>_SHRD_MBOX_0. Any "fullN" or "emptyN" can be
    used with APE HSP, which have all HSP interrupts directly routed to APE GIC.
    For other HSP blocks, the interrupt must be prerouted to a shared interrupt
    with a corresponding bit set in HSP_INT_IE_<i> register.
- interrupts
    Array of interrupt specifiers.
    Must contain one entry per entry in the interrupt-names property,
    in a matching order.
- #mbox-cells : Should be 2.
- nvidia,mbox-ie : if present, use mailbox-specific IE register

The mbox specifier of the "mboxes" property in the client node should
contain two data cells. The first one should be the HSP type and the
second one should be the ID of the mailbox that the client is going to
use. The information about data cell contents can be found in the
following file.

- <dt-bindings/mailbox/tegra186-hsp.h>.

Example:

hsp_rce: tegra-hsp@b950000 {
    compatible = "nvidia,tegra186-hsp";
    reg = <0x0 0x0b950000 0x0 0x00090000>;
    interrupts =    <0 TEGRA194_IRQ_RCE_HSP_SHARED_1 0x4>,
            <0 TEGRA194_IRQ_RCE_HSP_SHARED_2 0x4>,
            <0 TEGRA194_IRQ_RCE_HSP_SHARED_3 0x4>,
            <0 TEGRA194_IRQ_RCE_HSP_SHARED_4 0x4>;
    nvidia,mbox-ie;
    #mbox-cells = <2>;
    interrupt-names = "shared1", "shared2", "shared3", "shared4";
};

client {
    ...
    mboxes =
        <&hsp_rce TEGRA_HSP_MBOX_TYPE_SM TEGRA_HSP_SM_RX(3)>,
        <&hsp_rce TEGRA_HSP_MBOX_TYPE_SM TEGRA_HSP_SM_TX(0)>,
        <&hsp_rce TEGRA_HSP_MBOX_TYPE_SM TEGRA_HSP_SM_RX(1)>,
        <&hsp_rce TEGRA_HSP_MBOX_TYPE_SS 0>;
    mbox-names = "progress-rx", "vm-tx", "vm-rx", "vm-ss";
};
```

## kernel/nvidia/Documentation/devicetree/bindings/platform/tegra/nvidia,tegra186-roc-flush.txt
```
Nvidia, tegra186-roc-flush:
==================

The device node describes t186 ROC HW and
its register address range.
ROC is the interface between core cluster,
Memory and IO subsystem.
It provides arbitration, Encrypts/Decrypts carve-out accesses,
Rd/Wr to MC, manages IO communication and many more things.

Required properties:
--------------------
- compatible = Must be one of the following
               "nvidia,tegra186-roc-flush"
- reg: ROC register range
Optional properties:
--------------------
- status: "okay" or "disabled"

Examples:
========
roc-flush@e080000 {
	compatible = "nvidia,tegra186-roc-flush";
	reg = <0x0 0xe080000 0x0 0x10000>;
	status = "disabled";
};
```

## kernel/nvidia/Documentation/devicetree/bindings/platform/tegra/nvidia,tegra194-rce.txt
```
NVIDIA Tegra T194 RCE Auxiliary CPU

RCE (Real-time Camera Engine) is an auxiliary CPU providing real-time
control of camera capture devices.

The RCE firmware implements IVC, and uses HSP mailboxes and shared
semaphores to set up IVC.  When the RCE FW starts, it expects AST
regions 0/1/2 are already set up for the RCE to access FW in DRAM,
SYSRAM if applicable, and the special carveout used by camera
hardware. By default, the memory areas and AST regions are set up by
the Tegra bootloader.

After RCE is started, it waits for "HSP-VM" commands in the designated
HSP shared mailboxes to set up IVC channels and trace area.  With a
special firmware image, RCE supports up to two VM Guest OS instances
to use the camera capture devices.

== RCE top-level node ==

The RCE core is represented by the top-level node including direct HW resources
such as clocks, resets etc.

Required properties:
- compatible: Should be "nvidia,tegra194-rce" for T19x.
- nvidia,cpu-name: CPU name used when logging
- reg: Address entries (RCE EVP, RCE PM. RCE CPU AST,
  RCE DMA AST)
  Formatted as per standard rules for this property.
- reg-names: "rce-evp",  "rce-pm", "ast-cpu", "ast-dma"
  as per the reg property.
- clock-names: Names of the clocks required by RCE.
  Must include following entries:
  - "rce-cpu-nic", "rce-nic"
- clocks: Should contain an entry for each entry in clock-names.
  See ../clock/clock-bindings.txt for details.
- reset-names: Names of the resets required for RCE.
  Must include following entry:
  - "rce-all"
- resets: Should contain an entry for each entry in reset-names.
  See ../reset/reset.txt for
- nvidia,camera-device-names: Names of the camera devices required by RCE.
  Should include following entries:
  - "isp", "vi", "nvcsi"
- nvidia,camera-devices: Should contain an OF phandle for each entry
  in nvidia,camera-device-names.
- iommus: A reference to the IOMMU.
    See Documentation/devicetree/bindings/iommu/iommu.txt.
- iommu-resv-regions: Contains 4 cells representing two 64-bit
  integers indicating start and end of the reserved memory region.
  Should contain reservations for address ranges outside the aperture
  used by RCE FW, 0xa000000..0xc000000 for RCE VM1 interface,
  0xc0000000..0xe0000000 for RCE VM2 interface.
- dma-coherent: Present if dma operations are coherent
- nvidia,ivc-channels: A phandle list of IVC channel regions.
  For each IVC channel regions:
  - an OF phandle pointing to the list,
  - optional arguments (3 cells by default, values are ignored)
  For IVC channel details, please refer to: ./tegra-ivc-channel.txt

Optional properties:
- interrupt-names: names of interrupts used by RCE. Should include
  following entry:
  - "wdt-remote"
- interrupts: Should contain an entry for each entry in
  interrupt-names. See ../interrupt-controller/interrupts.txt
- nvidia,clock-rates should include two rates for each entry in clocks,
  inactive rate (19.2 MHz) and active rate (370 MHz)
- nvidia,clock-parents: should include two parent clocks, one used for
  inactive rates (clk-m) and another for active rates (nafll-rce).
  See ../clock/clock-bindings.txt for details.
- nvidia,clock-parent-names: should contain names for the parent clocks
- nvidia,autosuspend-delay-ms: Autosuspend delay for RCE device in
  milliseconds.
- nvidia,trace: A phandle to OF node representing trace.

== RCE Sub Nodes for the HSP Protocol ==

The hsp protocol node describes the hardware synchronization
primitive(s) used between CCPLEX and RCE to signal, e.g., incoming IVC
messages or IVC write room.

Required properties, when the HSP-VM protocol is used between CCPLEX
and RCE:
- compatible = "nvidia,tegra-camrtc-hsp-vm";
- mbox-names: Names of the mbox devices used by the hsp-vm
  protocol. Must include following entries: "vm-tx", "vm-rx". Should
  include entry "vm-ss".
- mboxes: Must contain an mbox specifier entry for each entry in
  mbox-names.

* For more HSP details, refer: ./nvidia,tegra186-hsp.txt

== Possible example ==

rtcpu@bc00000 {
	compatible = "nvidia,tegra194-rce";
	reg =	<0 0xbc00000 0 0x1000>,	  /* RCE EVP (RCE_ATCM_EVP) */
		<0 0xb9f0000 0 0x40000>,  /* RCE PM */
		<0 0xb840000 0 0x10000>,
		<0 0xb850000 0 0x10000>;
	reg-names = "rce-evp", "rce-pm", "ast-cpu", "ast-dma";
	clocks = <&bpmp_clks TEGRA194_CLK_RCE_CPU_NIC>,
		 <&bpmp_clks TEGRA194_CLK_RCE_NIC>;
	clock-names = "rce-cpu-nic", "rce-nic";
	nvidia,clock-rates = <19200000 370000000>, <19200000 370000000>;

	nvidia,clock-parents = <&bpmp_clks TEGRA194_CLK_CLK_M>,
		<&bpmp_clks TEGRA194_CLK_NAFLL_RCE>;
	nvidia,clock-parent-names = "clk-m", "nafll-rce";

	resets = <&bpmp_resets TEGRA194_RESET_RCE_ALL>;
	reset-names = "rce-all";

	interrupts = <0 TEGRA194_IRQ_RCE_WDT_REMOTE 0x4>;
	interrupt-names = "wdt-remote";

	nvidia,camera-devices = <&isp &vi &nvcsi>;
	nvidia,camera-device-names = "isp", "vi", "nvcsi";

	nvidia,memory-bw = <0xffffffff>;
	iommus = <&smmu TEGRA_SID_RCE>;
	iommu-resv-regions = <0x0 0x0 0x0 0xA0000000 0x0>,
			<0xc0000000 0xffffffff 0xffffffff>;
	dma-coherent;

	nvidia,trace = <&{/tegra-rtcpu-trace} 4 0x70100000 0x100000>;
	nvidia,ivc-channels = <&{/camera-ivc-channels} 2 0x90000000 0x10000>;

	nvidia,autosuspend-delay-ms = <5000>;

	hsp-vm1 {
		compatible = "nvidia,tegra-camrtc-hsp-vm";
		mboxes =
			<&hsp_rce TEGRA_HSP_MBOX_TYPE_SM TEGRA_HSP_SM_TX(0)>,
			<&hsp_rce TEGRA_HSP_MBOX_TYPE_SM TEGRA_HSP_SM_RX(1)>,
			<&hsp_rce TEGRA_HSP_MBOX_TYPE_SS 0>;
		mbox-names = "vm-tx", "vm-rx", "vm-ss";
	};
};
```

## kernel/nvidia/Documentation/devicetree/bindings/platform/tegra/nvidia,tegra234-epl-client.txt
```
NVIDIA Tegra EPL (Error Reporting Driver)
=========================================

This driver is used to report software detected errors via HSP mailbox
or MISC-EC registers to Safety Service module running on FSI core.

Required properties :
 - compatible : "nvidia,tegra234-epl-client"
 - mboxes     : Mailbox configuration refer "nvidia,tegra186-hsp.txt"
                for more details
 - mbox-names : Mailbox name

Optional properties :
 - client-misc-sw-generic-err0 : Device driver's name which reports error
                                 via MISC-EC 0
 - client-misc-sw-generic-err1 : Device driver's name which reports error
                                 via MISC-EC 1
 - client-misc-sw-generic-err2 : Device driver's name which reports error
                                 via MISC-EC 2
 - client-misc-sw-generic-err3 : Device driver's name which reports error
                                 via MISC-EC 3
 - client-misc-sw-generic-err4 : Device driver's name which reports error
                                 via MISC-EC 4

Example :

		epl {
			compatible = "nvidia,tegra234-epl-client";
#if TEGRA_HSP_DT_VERSION >= DT_VERSION_2
			mboxes =
				<&hsp_top2 (TEGRA_HSP_MBOX_TYPE_SM | TEGRA_HSP_MBOX_TYPE_SM_128BIT) TEGRA_HSP_SM_TX(1)>;
#else
			mboxes =
				<&hsp_top2 TEGRA_HSP_MBOX_TYPE_SM_128BIT TEGRA_HSP_SM_TX(1)>;
#endif
			mbox-names = "epl-tx";

			client-misc-sw-generic-err0 = "example_client";
		};
```

## kernel/nvidia/Documentation/devicetree/bindings/platform/tegra/tegra-cvnas.txt
```
NVIDIA Tegra CVNAS (Comput Vision NOC and SRAM)

	- CVNAS
		CVNAS provides a high bandwidth, low latency SRAM for CV cluster.
		CVNAS consists of 2 main blocks: CVNOC and CVSRAM
	- CVNOC
		CVNOC is a backbone, implemented using FlexNOC which interconnects
		masters to the memory.
	- CVSRAM
		CVSRAM is high bandwidth, low latency SRAM size of 4MB
		Except the CV clients(PVA, DLA), no other IPs can access it
		CPU can access it through low speed debug aperture

Required properties:
	- compatible : Must be one of the below -
		"nvidia,tegra-cvnas"
		"nvidia,tegra-cvnas-hv"
	- power-domains = Power domain group, should be
		TEGRA194_POWER_DOMAIN_CV
	- reg : Should contain 2 register ranges(address and length) pairs
		Register address space (MMIO). It should have values -
		CV0_REG0_BASE - CVNAS MMIO registers range
		CV0_SRAM_BASE - CVSRAM Base address and size
		HSM_BASE - HSM MMIO registers range
	- clocks: CVNAS clock
	- resets: All CVNAS resets -
		TEGRA194_RESET_CVNAS
		TEGRA194_RESET_CVNAS_FCM
	- reset-names: Names of the resets required for CVNAS.
		Must include following entries:
		rst
		rst_fcm
	- interrupts: Specify the interrupts IRQ info for device
	- cvsramslice : CVSRAM has 4 slices of 1 MB each with ECC storage
	- cvsram-reg : 4MB CVSRAM memory map
		Start address: 0x 50000000
		End address: 0x503F_FFFF
	- status : disabled or okay

Example:
	tegra-cvnas {
		compatible = "nvidia,tegra-cvnas";
		power-domains = <&bpmp TEGRA194_POWER_DOMAIN_CV>;
		reg = <0x0 0x14000000 0x0 0x20000>, /* CV0_REG0_BASE */
		      <0x0 0x14020000 0x0 0x10000>, /* CV0_SRAM_BASE */
		      <0x0 0x0b240000 0x0 0x10000>; /* HSM_BASE */
		clocks = <&bpmp_clks TEGRA194_CLK_CVNAS>;
		resets = <&bpmp_resets TEGRA194_RESET_CVNAS>,
			 <&bpmp_resets TEGRA194_RESET_CVNAS_FCM>;
		reset-names = "rst", "rst_fcm";
		interrupts = <0 238 4>,
			     <0 239 4>;
		cvsramslice = <4 0x1000>;
		cvsram-reg = <0x0 0x50000000 0x0 0x400000>;
		status = "disabled";
	};
```

## kernel/nvidia/Documentation/devicetree/bindings/platform/tegra/tegra-ivc-channel.txt
```
NVIDIA Tegra IVC channel bindings

Each IVC channel represents the unique communication protocol defined
between kernel running on CCPLEX CPUs and remote CPU core. Each IVC
channel has two memory buffers, one for each direction. The RX buffer
is for messages sent by the remote CPU, the TX channel for
messages sent to the remote CPU.

Both IPC memory buffers are have two headers followed by data
frames. The first write header is updated only by the producer and the
second read header is updated only by the consumer. The header and
frame sizes are multiples of 64-byte cache lines.

== IVC channel top-level node ==

List of IVC channels implemented by remote core to talk to CCPLEX.
The top-level node defines a shared memory area allocated by IVC
channels within it.

== IVC channel sub nodes ==

Each IVC channel implemented by the remote CPU must be represented as
a separate child node within the top-level node.

Required properties:
- compatible: Should represent the protocol to be used on this IVC channel.
  See other binding documents in this directory for potential values.
  For example:
  "nvidia,tegra186-ivc-protocol-echo" for ivc echo test channel.
- nvidia,service: Protocol name.
- nvidia,version: Protocol version
- nvidia,group: Bitmap used fro shared semaphore signaling
- nvidia,frame-size: Size of the data frame. Must be a multiple of 64.
- nvidia,frame-count: Number of frames in rx or tx buffers.
  Must be a power of 2.

Example:

camera-ivc-channels {
	echo@0 {
		compatible = "nvidia,tegra186-ivc-protocol-echo";
		nvidia,service = "echo";
		nvidia,version = <0>;
		nvidia,group = <1>;
		nvidia,frame-count = <16>;
		nvidia,frame-size = <64>;
	};
}
```
