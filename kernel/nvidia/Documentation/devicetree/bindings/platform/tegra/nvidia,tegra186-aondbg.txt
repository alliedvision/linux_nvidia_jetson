## kernel/nvidia/Documentation/devicetree/bindings/platform/tegra/tegra-nvethernet.txt
```
Device tree binding for NVIDIA Tegra194 Ethernet QOS Controller
=================================================================

Supported Hardware Features are
=====================================================/
10/100 Mbps Support                         : YES
1000 Mbps Support                           : YES
Half-duplex Support                         : YES
PCS Registers(TBI/SGMII/RTBI PHY interface) : NO
VLAN Hash Filter Selected                   : NO
SMA (MDIO) Interface                        : YES
PMT Remote Wake-up Packet Enable            : YES
PMT Magic Packet Enable                     : YES
RMON/MMC Module Enable                      : YES
ARP Offload Enabled                         : YES
IEEE 1588-2008 Timestamp Enabled            : YES
Energy Efficient Ethernet Enabled           : YES
Transmit Checksum Offload Enabled           : YES
Receive Checksum Offload Enabled            : YES
MAC Addresses 16–31 Selected                : YES
MAC Addresses 32–63 Selected                : YES
MAC Addresses 64–127 Selected               : YES
Timestamp System Time Source                : INTERNAL
Source Address or VLAN Insertion Enable     : YES
Active PHY Selected                         : RGMII
MTL Receive FIFO Size                       : 36 KBytes
MTL Transmit FIFO Size                       : 36 KBytes
IEEE 1588 High Word Register Enable          : YES
DCB Feature Enable                           : NO
Split Header Feature Enable                  : YES
TCP Segmentation Offload Enable              : YES
DMA Debug Registers Enabled                  : YES
AV Feature Enabled                           : YES
Low Power Mode Enabled                       : YES
Hash Table Size                              : No hash table selected
Total number of L3 or L4 Filters             : 8 L3/L4 Filter
Number of MTL Receive Queues                 : 4
Number of MTL Transmit Queues                : 4
Number of DMA Receive Channels               : 4
Number of DMA Transmit Channels              : 4
Number of PPS Outputs                        : No PPS output
Number of Auxiliary Snapshot Inputs          : 1 auxiliary input
=====================================================/

Required properties:
- compatible:			should be "nvidia,nveqos"
- reg: 				Physical base address and size of register
				space.
- interrupts: 			An array of tuples specifying IRQ number for
				each tx/rx queue in case of multi-queue, and
				for the only tx/rx queue,in case of single queue
				EQOS has a common interrupt for triggering any
				non DMA channel interrupts like link up/down.
				order of interrupts need to be listed as common,
				Tx followed by Rx interrupts.
- clocks: 			Holds Phandle and clock specifiers in same
				order for each entry in clock-names property.
- clock-names: 			Specifies the names of the needed clocks.
				pllrefe_vcoout: This is the parent PLL reference
				clock which is generated by the CAR module to
				EQOS IP.

				eqos_axi: This is the free-running AXI clock
				input provided by the application. The DMA and
				the MTL modules also operate with this clock

				eqos_rx: The external PHY provides this receive
				clock for RGMIII interfaces. This clock is
				125 MHz in 1 Gbps mode, 25 MHz in 100 Mbps mode,
				2.5 MHz in 10 Mbps mode. All RGMII receive
				signals received by the MAC are synchronous to
				this clock. This clock input is required for
				all PHY interfaces

				eqos_ptp_ref:The PTP reference clock. The HW
				signal name is clk_ptp_ref_i

				eqos_tx:The external or internal PLL provides
				this transmission clock. This is 125 MHz in
				1 Gbps mode, 25 MHz in 100 Mbps mode, 2.5 MHz
				in 10 Mbps mode. All transmission signals
				generated by the MAC are synchronous to this
				clock. This clock is required for all PHY
				interfaces

				axi_cbb: This is a free-running clock input
				provided by the application. The MAC Control
				Interface, CSR, and Station Management Agent
				(SMA) of the MAC run on this clock. The valid
				frequency range of this clock is 20–300 MHz
				(minimum frequency is 25 MHz when the MMC
				module is active in 1000 Mbps mode). Frequencies
				outside this range may result in incorrect
				operation.
- resets: 			Holds Phandle and rest specifiers in the same
				order for each entry in reset-names property.
- reset-names: 			Specifies the name of the reset line.
- iommus			A list of phandle and IOMMU specifier pairs that
				describe the IOMMU master interfaces of the
				device. IOMMU specifier points stream ID used
				for IP which can be used for address translation
- dma-coherent:			Present if dma operations are coherent
- nvidia,ptp_ref_clock_speed: 	This is reference for PTP clock frequency and
				the value set for tegra is 312.5MHz.
				The frequency of this clock is programmable and
				can be configured based on the requirements.
				The maximum frequency it can take is 312.5MHz
				and minimum frequency is 25MHz
- nvidia,instance_id:		Ethernet interface instance id. Fixed id value
				is used. For mgbe0 is 0, mgbe1 is 1,
				mgbe2 is 2, mgbe3 is 3 and eqos is 4.
- nvidia,phy-reset-gpio:	The GPIO phandle and specifier for the PHY
				reset signal.
- nvidia,rxq_enable_ctrl:	Mode of the MTL Receive Queue to enable either
				AV mode or legacy mode.
				example: rxq_enable_ctrl = <rx0 rx1 rx2 rx3>
				0x0 = Not enabled, 0x1 = Enabled for AV
				0x2 = Enabled for Legacy, 0x3 = Reserved
- nvidia,pause_frames: 		Enable(0) Disable(1) for Pause frame support.
- nvidia,rx_riwt:		Specifies the RX wathcdog interrupt timeout in
				usec.The RIWT field is programmed as
				(<val> * 256) / 62.5. if rx_riwt is 0 then RIWT
				is disabled and IOC will be enabled. Minimum
				value is 3 and Maximum value is 1020.
- nvidia,rx_frames:		Specifies the RX frame count for interrupt
				coalescing. If rx_frames is 0 then RX frame
				count based interrupt coalescing is disabled and
				Rx interrupt will be triggered based on rx_riwt
				value. Minimum value for rx_frames is 1 and
				Maximum value is 256.
- nvidia,tx_usecs:		Specifies the TX software timer interrupt
				timeout in usec. if tx_usecs is 0 then TX
				software timer is disabled and Tx interrupt
				will be triggered for each packet. Minimum
				value is 32 and Maximum value is 1020.
- nvidia,tx_frames:		Specifies the TX frame count for interrupt
				coalescing. If tx_frames is 0 then TX frame
				count based interrupt coalescing is disabled and
				Tx interrupt will be triggered based on tx_usecs
				value. Minimum value for tx_frames is 1 and
				Maximum value is 10.
- nvidia,promisc_mode:		Specifies if promiscuous mode should be allowed
				or not. Set to 1 to allow or 0 to disallow
				promiscuous mode. Default is 1 (allowed).
- nvidia,num-dma-chans:		Number of DMA channels that need to be used.
				Minimum value is 1 and Maximum value is 4.
- nvidia,dma-chans:		The channel number of DMA channels to be used.
				Number of channels provided here should be equal
				to the value in nvidia,num-dma-chans property.
				Valid numbers are 0,1,2,3
- nvidia,num-mtl-queues:	Number of MTL Queues that need to be used.
				Minimum value is 1 and Maximum value is 4.
- nvidia,mtl-queues:		Queues that need to be filled based on the
				nvidia,mtl-queues. Valid numbers are 0,1,2,3
- nvidia,ptp-rx-queue:		This field specifies the Rx queue on which the
				untagged PTP packets sent over the Ethernet
				payload (not over IPv4 or IPv6) are routed.
- nvidia,tx-queue-prio: 	Each byte in this property indicates the
				packet priorities 0 to 7. When this is set, it
				means the packet with that priority will be
				routed to the Tx queue specified in
				nvidia,mtl-queues property at the same index
				position.
- nvidia,slot_num_check:	List of flags (0x0 to disable, 0x1 to enable)
				to configure slot function per DMA channel.
				Once this flag is enabled the corresponding TX
				queue will be configured in AVB Strict priority
				mode, not in CBS mode. So it will starve
				TX queue 0 hence it is recommended to enable
				CBS to set bandwidth limits as per use case.
				The TX queue 0 can't be programmed for AVB mode,
				so the corresponding DMA channel can't be
				configured for slot function.
- nvidia,slot_intvl_vals:	List of slot intervals (with a range from 1usec
				to 4096usec) for fetching the data from
				system memory per DMA channel give in
				the dma-chans property. If this is not
				specified 125usec default will be used.
- nvidia,rx-queue-prio: 	Each byte in this property is a bit map of
				individual vlan priorities 0 to 7. When a bit is
				uniquely set in this property i.e. same bit map
				shall not be set in multiple bytes of this
				property, it means the tagged packet with that
				priority will be routed to the Rx queue
				specified in nvidia,mtl-queues property at the
				same index position.
- nvidia,dcs-enable:		Dynamic Channel Selection enable(1) or
				disable(0). This property is mutually
				exclusive with rx-queue-prio i.e. if this is
				enabled, then rx-queue-prio should not be
				provided and vice versa.
- nvidia,mc-dmasel:		This property enables us to route the MC MAC
				RX packets to multiple DMA channels. Specify
				hot bit encoded DMA receive channel selection.
				(Example for DMA channels 1, 2 and 3 route
				set value to 0xE)
- eqos_mii_rx_input_state_disable:	Disables eqos rx pad pins.
- eqos_mii_rx_input_state_enable:	Enables eqos rx pad pins.
- nvidia,pad_calibration:	Specifies if pad calibration should be allowed
				or not. Set to 1 to allow or 0 to disallow
				pad calibration mode. Default is 1 (allowed).
- nvidia,max-platform-mtu:	Maximum MTU size supported for a platform.
				currently it is set to 9000 for embedded
				platforms. if DT entry is not
				present then it will be set to 1500 for
				automotive platforms. In case of automotive
				platforms MAC is connected to a switch and not
				to PHY directly. The switch limits the max MTU
				to 1500B, hence this property is used to
				prevent configuring MTU size greater than 1500B
				for EQOS contoller as well. In case of
				embedded platforms MAC is connected directly to
				PHY and hence MTU size of upto 9018 is supported
				(9022 in case of tagged frame).
- phy-mode: 			Operation mode of the PHY interface and it
				should be "rgmii-id".
- phy-handle:			Phandle, specifies a reference to a node
				representing a PHY device;
- nvidia,residual-queue:	Residual Queue to receive untagged Preempted
				fragments. RxQ0 can't be residual queue.
- nvidia,skip_mac_reset:	Flag to skip MAC reset from driver.
				1 = skip doing mac reset, 0 = okay to reset
- nvidia,tc-mapping:		Traffic class mapping for TxQ. This will map
				Transmit queue to a traffic class. Default
				mapping is 1:1 between TxQ and TC class. Valid
				property for IP with more number queue than TC.
- nvidia,mac-addr-idx:		Chosen node inside DT will updated with list of
				MAC addresses in increasing order upto the
				maximum MAC addresses based on platform
				configuration.
				This DT property holds the value (index)
				to fetch from the MAC address list inside
				chosen node. This is read only property for
				a given platform.
				ex: If there is Ethernet controller DT node
				with index 8, the controller MAC address
				is at /chosen/nvidia,ether-mac8
- nvidia,ptp_m2m_role:		Ethernet HW role in PTP MAC-TO-MAC time sync.
				This  DT property holds the value to identify
				role of HW. Ethernet HW can act as primary
				interface(1), secondary interface(2) or
				inactive interface(0). By default all HW are
				inactive interface if DT property not defined.
- nvidia,pps_op_ctrl:		Set PPS output control. Default(0) pps output
				is 1 pulse (of width clk_ptp_i) every second.
				Enable(1) the binary rollover is 2 Hz, and
				the digital rollover is 1 Hz.
				Low period of 537 ms and a high period of 463 ms.
				If DT property is not defined, it is set to
				default(0)

MDIO node
- mdio:				Child of Ethernet controller which holds the PHY
				devices connected via MDIO bus
- compatible:			Should be "nvidia,eqos-mdio"
PHY nodes
- reg:				PHY ID number.
- marvell,copper-mode:		Mode of PHY is copper mode.
- marvell,reg-init:		Override some configuration registers based
				on this setting. Format is
				<reg-page reg mask value>,...;
eqos_cool_dev
- cooling-min-state:		An integer indicating the smallest cooling state
				accepted
- cooling-max-state:		An integer indicating the largest cooling state
				accepted
- #cooling-cells:		Used to provide cooling device specific
				information.Must be at least 2, one cell to
				specify minimum and maximum cooling state used
				in the reference. Please refer kernel-4.14/
				Documentation/devicetree/bindings/thermal/
				thermal.txt for detail thermal related settings

Example:

	ethernet@2490000 {
		compatible = "nvidia,nveqos";
		reg = <0x0 0x02490000 0x0 0x10000>;    /* EQOS Base Register */
		interrupts =    <0 194 0x4>,    /* common */
				<0 186 0x4>,    /* tx0 */
				<0 187 0x4>,    /* tx1 */
				<0 188 0x4>,    /* tx2 */
				<0 189 0x4>,    /* tx3 */
				<0 190 0x4>,    /* rx0 */
				<0 191 0x4>,    /* rx1 */
				<0 192 0x4>,    /* rx2 */
				<0 193 0x4>;    /* rx3 */
		clocks = <&bpmp_clks TEGRA194_CLK_PLLREFE_VCOOUT>,
			<&bpmp_clks TEGRA194_CLK_EQOS_AXI>,
			<&bpmp_clks TEGRA194_CLK_EQOS_RX>,
			<&bpmp_clks TEGRA194_CLK_EQOS_PTP_REF>,
			<&bpmp_clks TEGRA194_CLK_EQOS_TX>,
			<&bpmp_clks TEGRA194_CLK_AXI_CBB>;
		clock-names = "pllrefe_vcoout", "eqos_axi", "eqos_rx",
				"eqos_ptp_ref", "eqos_tx", "axi_cbb";
		resets = <&tegra_car TEGRA186_RESET_EQOS>;
		reset-names = "mac_rst";
		phy-mode = "rgmii";
		status = "disabled";
		nvidia,ptp_ref_clock_speed = <312500000>;
		nvidia,num-dma-chans = <4>;
		nvidia,dma-chans = <0 1 2 3>;
		nvidia,num-mtl-queues = <4>;
		nvidia,mtl-queues = <0 1 2 3>;
		nvidia,rx-queue-prio = <0x2 0x1 0x30 0x48>;
		nvidia,slot_num_check = <0x0 0x1 0x1 0x1>;
		nvidia,slot_intvl_vals = <0x0 0x7D 0x7D 0x7D>;
		nvidia,dcs-enable = <0x0>;
		nvidia,tx-queue-prio = <0x0 0x7 0x2 0x3>;
		iommus = <&smmu TEGRA_SID_EQOS>;
		iommu-resv-regions = <0x0 0x0 0x0 0x40000000 0x0
				      0x60000000 0xffffffff 0xffffffff>;
		dma-coherent;
		/* usec value for Rx watchdog interrupt */
		nvidia,rx_riwt = <124>;
		nvidia,max-platform-mtu= <9000>;
		nvidia,mac-addr-idx = <0>;
		eqos_cool_dev: eqos-cool-dev {
				cooling-min-state = <0>;
				cooling-max-state = <5>;
				#cooling-cells = <2>;
			};

		mdio {
			compatible = "nvidia,eqos-mdio";
			#address-cells = <1>;
			#size-cells = <0>;

			phy: phy@0 {
	     			reg = <0>;
	     			marvell,copper-mode;
				/* Setup LED[2] as interrupt pin (active low) */
				marvell,reg-init = <0x03 0x12 0x7fff 0x880>;
			};
		};
	}
```

## kernel/nvidia/Documentation/devicetree/bindings/reset/nvidia,bpmp-resets.txt
```
BPMP Resets

Binding for the BPMP reset driver.

Required properties:
- compatible: Must be "nvidia,bpmp-resets"
- reg: Should be 0
- #clock-cells: Should be 1

Example:

        bpmp_resets: bpmp_reset@0 {
                compatible = "nvidia,bpmp-resets";
                reg = <0x0 0x0 0x0 0x0>;
                #reset-cells = <1>;
        };
```
