## kernel/nvidia/Documentation/devicetree/bindings/video/nvidia,tegra194-disx-pd.txt
```
NVIDIA Tegra Display Power Domains

This document describes the device tree bindings for the DC power domains,
as well as for subnodes corresponding to these engines. These nodes present
under SoC power domain parent node.

Required properties:
- compatible: This can be either "nvidia,tegra194-disa-pd",
  "nvidia,tegra194-disb-pd" or "nvidia,tegra194-disc-pd".
  All these nodes should be present. These power domains
  control power to heads and windows given below:
  - DISA power domain
    - HEAD0
    - WINDOW0
  - DISB power domain
    - HEAD1
    - WINDOW1, WINDOW2
  - DISC power domain
    - HEAD2, HEAD3
    - WINDOW3, WINDOW4, WINDOW5
- partition-id: A power partition which needs to enabled before DC operation.

Example:
=======

SoC DTSI:
--------

disa_pd: disa-pd {
	compatible = "nvidia,tegra194-disa-pd";
	partition-id = <TEGRA194_POWER_DOMAIN_DISP>;
};

disb_pd: disb-pd {
	compatible = "nvidia,tegra194-disb-pd";
	partition-id = <TEGRA194_POWER_DOMAIN_DISPB>;
};

disc_pd: disc-pd {
	compatible = "nvidia,tegra194-disc-pd";
	partition-id = <TEGRA194_POWER_DOMAIN_DISPC>;
}
```

## kernel/nvidia/Documentation/devicetree/bindings/video/nvidia,tegra194-dpaux.txt
```
NVIDIA Tegra Display Port Aux.

The Tegra DPAUX provides an engine for programming Display Port Auxiliary
channels so that display data can be output to connected monitor.
It also used by HDMI for DDC communication with connected monitor.

This document describes the device tree bindings for the DPAUX hardware itself,
as well as for subnodes corresponding to this engine.

Required properties:
- status: Should be "disabled" in SoC and "okay" in Board DTSI.
- compatible: Must be "nvidia,tegra194-dpaux".
- reg: A list of physical base address and length of DPAUX's registers.
- interrupts: The interrupt IRQ info for the DPAUX hardware.
- nvidia,dpaux-ctrlnum: DPAUX number mapping to display hardware physical number.
- clock-names: Must include the following entries:
  "dpaux"
- clocks: Must contain an entry for each entry in clock-names.
  See ../clocks/clock-bindings.txt for details
- reset-names: Must include the following entries:
  "dpaux"
- resets: Must contain an entry for each entry in reset-names.
  See ../reset/reset.txt for details.
- power-domains: Power domain group, should be configured for controlling DPAUX hardware.
  This should always be set to "&disa_pd" because all of the DPAUX instances belong to
  the DISP domain.

Example:
=======

SoC DTSI:
--------

dpaux0: dpaux@155c0000 {
	status: "disabled";
	compatible = "nvidia,tegra194-dpaux";
	reg = <0x0 0x155c0000 0x0 0x00010000>;
	interrupts = <0 159 4>;
	nvidia,dpaux-ctrlnum = <0>;

	clocks = <&bpmp_clks TEGRA194_CLK_DPAUX>;
	clock-names = "dpaux";
	resets = <&bpmp_resets TEGRA194_RESET_DPAUX>;
	reset-names = "dpaux";
	power-domains = <&disa_pd>;
}; //dpaux0

Board DTSI:
----------

dpaux0: dpaux@155c0000 {
	status: "okay";
};
```

## kernel/nvidia/Documentation/devicetree/bindings/video/nvidia,tegra194-host1x.txt
```
NVIDIA Tegra Host1x

The Tegra Host1x hardware provides a bus for multimedia and
other data processing engines, with support for offloading
engine programming from CPU, hardware-based synchronization
between engines and other hardware on the SoC or attached buses,
and support for virtualizing these resources.

This document describes the device tree bindings for the Host1x
hardware itself, as well as for subnodes corresponding to
engines on the Host1x bus that are traditionally managed as
part of the Host1x driver on NVIDIA downstream kernels:
- VIC: Video Image Compositor
- NVJPG: JPG decompressor
- NVENC: Video encoder
- NVDEC: Video decoder
- TSEC: Security engine

Required properties:
- compatible: "nvidia,tegra194-host1x" for native,
    "nvidia,tegra194-host1x-hv" for virtualized. Additionally,
    "simple-bus".
- reg: Physical base address and length of the controller's registers.
  For Tegra194, one entry for each entry in 'reg-names':
    "guest" - VM region assigned to the operating system / VM.
    "sem-syncpt-shim" - Memory syncpoint shim aperture.
- interrupts: Two entries, first pointing to the syncpoint threshold
  interrupt, second pointing to the general (error) interrupt.
- resets: One entry pointing to HOST1X reset.
- clocks: One entry for each entry in 'clock-names':
    "host1x": Host1x clock
    "actmon": Actmon clock
- iommus: Entries for any stream IDs for Host1x CDMA use.
- nvidia,vmid: Index of the VM region assigned to the VM (starting from 1).

Optional properties:
- reg / reg-names:
    "hypervisor": Common register region, if not running as a guest
       in a virtualized configuration.
    "actmon" - Host1x ACTMON register aperture.
- nvidia,ch-base: Index of first channel assigned to this VM
- nvidia,nb-channels: Number of channels assigned to this VM
- nvidia,pts-base: ID of first syncpoint assigned to this VM
- nvidia,nb-pts: Number of syncpoints assigned to this VM
- nvidia,vi-syncpt-pool: <base length> pair describing range of
    syncpoints reserved to be allocated by VI.
- nvidia,nb-hw-pts: Number of syncpoints in hardware.
- vmserver-owns-engines: 1 in virtualized system
- ivc-queue0: IVC queue to NvHost Server in virtualized system

Subnodes:

Context devices:
  For each data buffer context stream ID usable by this instance, a node with:
  - compatible: "nvidia,tegra186-iommu-context"
  - iommus: Entry for the stream ID

VIC / NVJPG / NVENC / NVENC1 :
- compatible: For engine owned by this VM, one of
    "nvidia,tegra194-vic", "nvidia,tegra194-nvjpg", "nvidia,tegra194-nvenc".
    For engine owned by NvHost Server, one of
    "nvidia,tegra194-vhost-vic", "nvidia,tegra194-vhost-nvjpg", "nvidia,tegra194-vhost-nvenc".
- reg: Register aperture
- interrupts: Interrupt
- resets: Reset
- clocks: Clock
- clock-names: "vic"/"nvjpg"/"nvenc"
- power-domains: Power domain
- iommus: Entry for firmware stream ID

NVDEC / NVDEC1 :
As for VIC/NVJPG/NVENC, but with
- compatible: "nvidia,tegra194-nvdec" or "nvidia,tegra194-vhost-nvdec".
- clocks / clock-names: Additional entries for "kfuse" and "efuse"

TSEC / TSECB:
As for VIC/NVJPG/NVENC, but with
- compatible: "nvidia,tegra194-tsec".
- clocks / clock-names: Additional entry for "efuse"

Other subnodes are described in separate binding files.
```
