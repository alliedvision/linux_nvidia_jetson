## kernel/nvidia/Documentation/devicetree/bindings/video/nvidia,tegra234-max-gmsl-dp-ser.txt
```
Maxim GMSL DP Serializer Driver

Required properties:
- compatible : should be "maxim,max_gmsl_dp_ser".
- reg : I2C address of the Maxim display serializer.
- max_gmsl_dp_ser-pwrdn : GPIO pin number of the PWRDN pin.
                          This is the pin that's used to power
                          up the Maxim display serializer chip.
- gmsl-link-select : This property is an array of 4 unsigned 8 bit values
                     that determines which GMSL output link will be enabled
                     for each video pipe X, Y, Z, and U..
                     The possible values for each pipe are:
                     - 0x0 (Link A),
                     - 0x1 (Link B),
                     - 0x2 (Link A + B).

Optional properties:
- dprx-link-rate : Configures the DP link rate of the serializer chip.
                   The default value is 0x1E (HBR3). The possible values are:
                   - 0xA (HBR),
                   - 0x14 (HBR2),
                   - 0x1E (HBR3).
- dprx-lane-count : Configures the DP lane count of the serializer chip.
                    The default value is 0x4. The possible values are:
                    - 0x1,
                    - 0x2,
                    - 0x4.
- ser-errb : GPIO pin number of the ERRB pin. This pin is used for error
             and fault reporting by the serializer chip.
- enable-mst : This is a boolean property. If this property is present
               the driver will enable MST mode.
- mst-payload-ids : This property is an array of 4 unsigned 8 bit values which
                    represent MST payload IDs of pipe X, Y, Z, U. This property
                    is mandatory if enable-mst property is mentioned in dt.
- gmsl-stream-ids : This property is an array of 4 unsigned 8 bit values which
                    represent GMSL stream IDs of pipe X, Y, Z, U. This property
                    is mandatory if enable-mst property is mentioned in dt.

Example:

	i2c@31e0000 {
		status = "okay";
		maxim_ser: max_gmsl_dp_ser@40 {
			compatible = "maxim,max_gmsl_dp_ser";
			reg = <0x40>;
			status = "okay";
			max_gmsl_dp_ser-pwrdn = <&tegra_main_gpio
							TEGRA234_MAIN_GPIO(G, 3)
							GPIO_ACTIVE_HIGH>;
			ser-errb = <&tegra_main_gpio TEGRA234_MAIN_GPIO(G, 7) 0>;
			dprx-link-rate = <0x1e>;
			dprx-lane-count = <0x4>;
			enable-mst;
			mst-payload-ids  = /bits/ 8 <0x1 0x2 0x3 0x4>;
                        gmsl-stream-ids  = /bits/ 8 <0x0 0x1 0x2 0x3>;
                        gmsl-link-select = /bits/ 8 <0x0 0x1 0x2 0x1>;
		};
	};
```

## kernel/nvidia/Documentation/devicetree/bindings/video/tegra194-pva.txt
```
NVIDIA Programmable Vision Accelatrator (PVA )

PVA is fixed-function hardware accelerator used for low to mid level
computer vision and image processing applications. This document
describes the device tree bindings for PVA hardware itself, as well as
for subnodes corresponding to this engine.

Required properties:
- compatible: "nvidia,tegra194-pva"
- power-domains: phandle pointing to the parent power domain
- reg: Physical base address and length of the PVA registers.
- interrupts: The interrupt IRQ info for PVA
- resets: One entry pointing to PVA reset.
- clock-names: Must include the following entries:
    "pva0/1":  AXI
    "pva0/1":  VPS0
    "pva0/1":  VPA1
- clocks: One entry for each entry in 'clock-names'
- iommus: Entry for PVA0/1 stream IDs
- dma-coherent: Present if dma operations are coherent

Example from tegra194-soc-base.dtsi:
        pva0: pva0 {
                compatible = "nvidia,tegra194-pva";
                power-domains = <&bpmp TEGRA194_POWER_DOMAIN_PVAA>;
                reg = <0x0 0x16000000 0x0 0x800000>;
                interrupts = <0 234 0x04>;
                resets = <&bpmp_resets TEGRA194_RESET_PVA0_ALL>;
                clocks = <&bpmp_clks TEGRA194_CLK_PVA0_AXI>,
                        <&bpmp_clks TEGRA194_CLK_PVA0_VPS0>,
                        <&bpmp_clks TEGRA194_CLK_PVA0_VPS1>;
                clock-names = "axi", "vps0", "vps1";
                iommus = <&smmu TEGRA_SID_PVA0>;
                dma-coherent;
        };
```

## kernel/nvidia/Documentation/devicetree/bindings/watchdog/softdog-platform.txt
```
Software watchdog

Software watchdog is enabled when a hardware watchdog controller is not
available. This would work in multi cpu system where one or more cpus hang
while cpu running wdt is still working.

Required properties:
- compatible: Should be "softdog-platform".

Optional properties for recovery mode:
- nvidia,watchdog-index: Watchdog to be use, it can be 0, 1 or 2.
- nvidia,timer-index: Timer to be use for counter. It can be 0 to 7.
- watchdog,nowayout: Watchdog cannot be disabled.
- watchdog,reboot: initiate reboot when watchdog is triggered.
- watchdog,panic: panic when watchdog is triggered.

Examples:
soft_wdt: soft_watchdog {
	compatible = "softdog-platform";
	status = "disabled";
};
```

## kernel/nvidia/Documentation/devicetree/bindings/watchdog/tegra-hv-wdt.txt
```
Tegra Virtual Watch Dog Timer

This implements the watchdog timer on Hypervisor based systems. The Virtual
WDT driver kicks the watchdog(once every 28 seconds by default) though ivc
communication to the WDT Server. When the Watch Dog Timer Server notices
that the watch dog kick is not received from the guest for a timeout
period(1 minute) the guest is rebooted

Required Properties:
- compatible: should be "nvidia,tegra-hv-wdt"
- ivc: ivc channel used to communicate with the WDT Server to kick the watchdog

Example:
	tegra_hv_wdt {
		compatible = "nvidia,tegra-hv-wdt";
		ivc = <&tegra_hv 77>;
	};
```

## kernel/nvidia/drivers/Kconfig
```kconfig
append_menu "Device Drivers"

if ARCH_TEGRA
source "drivers/bluetooth/realtek/Kconfig"
source "drivers/misc/tegra186-ahc/Kconfig"
source "drivers/nvpmodel/Kconfig"
source "drivers/nv-p2p/Kconfig"
source "drivers/iommu/Kconfig"
source "drivers/nvpps/Kconfig"
source "drivers/trusty/Kconfig"
source "drivers/virt/tegra/Kconfig"
endif

endmenu
```

## kernel/nvidia/drivers/block/Kconfig
```kconfig
if BLK_DEV

config TEGRA_HV_BLKDEV
	bool "Tegra Virtual Block I/O Device"
	depends on BLK_DEV && TEGRA_HV_MANAGER
	default n

endif # BLK_DEV

config TEGRA_HV_BLKDEV_OOPS
	bool "Tegra Virtual Block I/O Driver for OOPS partition"
	depends on BLK_DEV && PSTORE && TEGRA_HV_MANAGER
	select PSTORE_ZONE
	default n
```

## kernel/nvidia/drivers/char/hw_random/Kconfig
```kconfig
#
# Hardware Random Number Generator (RNG) configuration
#

if HW_RANDOM

config HW_RANDOM_TEGRA
       tristate "Tegra Random Number Generator support"
       depends on HW_RANDOM && CRYPTO_DEV_TEGRA_VIRTUAL_SE_INTERFACE
       default HW_RANDOM
       ---help---
         This driver provides kernel-side support for the Random Number
         Generator hardware found on tegra.

         If unsure, say N.

endif # HW_RANDOM
```

## kernel/nvidia/drivers/cpuidle/Kconfig.arm
```kconfig
#
# ARM CPU Idle drivers
#
config CPU_IDLE_TEGRA18X
	bool "CPU Idle Driver for NVIDIA Tegra18x SoCs"
	depends on ARCH_TEGRA_18x_SOC
	default y
	select CPU_IDLE_MULTIPLE_DRIVERS
	select DT_IDLE_STATES
	help
	  Support for entering different power states on NVIDIA Tegra18x
	  SoCs when CPUs become idle.

	  Select this to enable cpuidle on NVIDIA Tegra18x SoCs.

config CPU_IDLE_TEGRA19X
	tristate "CPU Idle Driver for NVIDIA Tegra19x SoCs"
	depends on ARCH_TEGRA_19x_SOC || ARCH_TEGRA_194_SOC
	default y
	select CPU_IDLE_MULTIPLE_DRIVERS
	select DT_IDLE_STATES
	help
	  Support for entering different power states on NVIDIA Tegra19x
	  SoCs when CPUs become idle.
	  Select this to enable cpuidle on NVIDIA Tegra19x SoCs.

config CPU_IDLE_TEGRA_AUTO
	tristate "CPU Idle Driver for NVIDIA Tegra auto platforms"
	default n
	select CPU_IDLE_MULTIPLE_DRIVERS
	select DT_IDLE_STATES
	help
	  Support for entering different power states on NVIDIA Tegra auto
	  platforms when CPUs become idle.
	  Select this if you enable SC7 on Tegra auto platforms.
```

## kernel/nvidia/drivers/gpio/Kconfig
```kconfig
if GPIOLIB

config NV_GPIO_TEGRA186
	bool "NVIDIA Tegra186 GPIO support (Downstream version)"
	select GPIO_SYSFS
	depends on !GPIO_TEGRA186
	default y if ARCH_TEGRA_18x_SOC || ARCH_TEGRA_19x_SOC
	help
	Support for the NVIDIA Tegra186 GPIO controller driver.


config GPIO_TMPM32X_I2C
	tristate "GPIO support for Toshiba MCU TMPM32x I2C"
	depends on I2C
	depends on OF
	select MFD_TMPM32X_I2C
	select GPIOLIB_IRQCHIP
	help
	  GPIO driver for Toshiba MCU TMPM32x I2C.

endif
```

## kernel/nvidia/drivers/hwmon/Kconfig
```kconfig
menu "HWMON devices"

config SENSORS_F75308
       tristate "F75308 Hardware Monitor"
       default n
       depends on I2C
       help
         Say Y to enable F75308 hardware monitor. F75308 hardware monitor
         is an I2C slave which can be used to learn the temperature, voltage,
         and govern the connected fans by reading/writing the values from/to
         the associated registers by an external I2C master.
endmenu
```

## kernel/nvidia/drivers/iio/imu/bmi088/Kconfig
```kconfig
config BMI088_IIO
	tristate "Bosch BMI088 IMU using IIO"
	depends on I2C && SYSFS && IIO && TEGRA_HTS_GTE && !NVS_BMI08X_IIO
	default n
	help
	  Enable Bosch BMI088 I2C based IMU driver, if enabled as module, it
	  will be generated as bmi088.ko
```

## kernel/nvidia/drivers/interconnect/tegra/Kconfig
```kconfig
config INTERCONNECT_TEGRA
	bool "Tegra interconnect drivers"
	depends on ARCH_TEGRA
	help
	  Support for Tegra interconnect provider.
```

## kernel/nvidia/drivers/iommu/Kconfig
```kconfig
config ARM_SMMU_SUSPEND
	bool "ARM SMMU SUSPEND"
	depends on (ARM_SMMU && PM_SLEEP)
	default y
	help
	  Support for ARM System MMU suspend where all the required SMMU
	  registers will be saved to memory and upon resume warmboot/bootloader
	  will restore SMMU registers from memory.
```

## kernel/nvidia/drivers/mfd/Kconfig
```kconfig
if HAS_IOMEM

config MFD_TMPM32X_I2C
	tristate
	depends on I2C
	depends on OF
	select MFD_CORE

config MFD_NVVRS_PSEQ
	bool "Nvidia's Voltage Regulator Specification Power Sequencer"
	depends on I2C=y
	depends on OF || COMPILE_TEST
	select MFD_CORE
	select REGMAP_I2C
	select REGMAP_IRQ
	select IRQ_DOMAIN
	help
		Say yes here to add support for Voltage Regulator Specification based
		Power Sequencer having child device node RTC. This driver provides common
		support for accessing the device; additional drivers must be enabled in
		order to use the functionality of the device.
endif
```

## kernel/nvidia/drivers/misc/nvscic2c-pcie/Kconfig
```kconfig
# SPDX-License-Identifier: GPL-2.0
config NVSCIC2C_PCIE
	tristate "NVIDIA Chip-to-Chip between PCIe-RP and PCIe-EP"
	depends on PCI && PCI_ENDPOINT
	default n
	help
	 This enables SoftwareCommunicationInterface for Host-to-Host
	 communication between PCIe Rootport and PCIe Endpoint.
	 If unsure, Please say N.
```

## kernel/nvidia/drivers/misc/nvsciipc/Kconfig
```kconfig
config NVSCIIPC
	tristate "NvSciIpc kernel module"
	default n
	help
	This kernel module is added for supporting vuid and secure
	buffer sharing feature of NvSciIpc.

	Select Y to enable nvsciipc support built into kernel
	or select M to enable nvsciipc support as loadable module.
```

## kernel/nvidia/drivers/net/ethernet/Kconfig
```kconfig
#
# Ethernet LAN device configuration
#

if ETHERNET

source "drivers/net/ethernet/nvidia/Kconfig"
source "drivers/net/ethernet/realtek/Kconfig"
source "drivers/net/ethernet/nvidia/nvethernet/Kconfig"

endif # ETHERNET
```

## kernel/nvidia/drivers/net/ethernet/nvidia/nvethernet/Kconfig
```kconfig
config NVETHERNET
	tristate "NVIDIA Tegra Ethernet EQOS driver"
	select PHYLIB
	select CRC32
	select MII
	depends on OF && HAS_DMA
	default n
	help
	Say Y here if you have a NVIDIA Tegra Ethernet EQOS Adapter.

	To compile this driver as a module, choose M here: the module
	will be called nvethernet.
config NVETHERNET_SELFTESTS
	bool "Support for NVETHERNET Selftests"
	depends on NVETHERNET
	default n
	help
	  This adds support for NVETHERNET Selftests using ethtool. Enable this
	  feature if you are facing problems with your HW.
```

## kernel/nvidia/drivers/nv-p2p/Kconfig
```kconfig
#
#
#

menuconfig TEGRA_RDMA
	tristate "TEGRA_RDMA_DRIVER"
	default n
	help
	    If in doubt, say N.
```

## kernel/nvidia/drivers/pci/controller/Kconfig
```kconfig
# SPDX-License-Identifier: GPL-2.0

config PCIE_TEGRA_VF
	tristate "NVIDIA Tegra PCIe VF driver"
	help
	  Say Y here if you want to enumerate PCIe virtual functions in VM.
```
