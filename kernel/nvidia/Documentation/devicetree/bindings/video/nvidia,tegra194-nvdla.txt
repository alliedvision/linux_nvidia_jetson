## kernel/nvidia/Documentation/devicetree/bindings/video/nvidia,tegra194-nvdla.txt
```
NVIDIA Deep Learning Accelerator (NVDLA)

NVDLA is fixed-function hardware accelerator used for inferencing Convolutional Neural Networks.

This document describes the device tree bindings for NVDLA hardware itself, as well as for subnodes
corresponding to this engine.

Required properties:
- compatible: "nvidia,tegra194-nvdla"
- power-domains: phandle pointing to the parent power domain
- reg: Physical base address and length of the DLA registers (includes DLA Falcon and DLA Core Engines).
- interrupts: The interrupt IRQ info for DLA
- resets: One entry pointing to DLA reset.
- clock-names: Must include the following entries:
    "nvdla0/1": DLA Core Engine clock
    "nvdla0/1_flcn": DLA Falcon clock
- clocks: One entry for each entry in 'clock-names'
- iommus: Entry for DLA stream ID
- iommu-group-id: Entry for specifying IOMMU group DLA belongs to, should be "TEGRA_IOMMU_GROUP_HOST1X".
- dma-coherent: Present if dma operations are coherent

Example from tegra194-soc-base.dtsi:

	nvdla0: nvdla0@15880000 {
		compatible = "nvidia,tegra194-nvdla";
		power-domains = <&bpmp TEGRA194_POWER_DOMAIN_DLAA>;
		reg = <0x0 0x15880000 0x0 0x00040000>;
		interrupts = <0 236 0x04>;

		resets = <&bpmp_resets TEGRA194_RESET_DLA0>;
		clocks = <&bpmp_clks TEGRA194_CLK_DLA0_CORE>,
			 <&bpmp_clks TEGRA194_CLK_DLA0_FALCON>;
		clock-names = "nvdla0", "nvdla0_flcn";

		iommus = <&smmu TEGRA_SID_NVDLA0>;
		iommu-group-id = <TEGRA_IOMMU_GROUP_HOST1X>;
		dma-coherent;
	};
```

## kernel/nvidia/Documentation/devicetree/bindings/video/nvidia,tegra194-sor.txt
```
NVIDIA Tegra Serial Output Resource

The Tegra Serial Output Resource (SOR) provides an engine for programming
protocol so that display data can be output to connected monitor.

This document describes the device tree bindings for the SOR hardware itself,
as well as for subnodes corresponding to this engines.

Required properties:
- status: Should be "disabled" in SoC and "okay" in Board DTSI.
- compatible: Must be "nvidia,tegra194-sor".
- reg: A list of physical base address and length of SOR's registers.
- interrupts: The interrupt IRQ info for the SOR hardware.
- nvidia,sor-ctrlnum: SOR number mapping to display hardware physical number.
- nvidia,dpaux: SOR mapping to underlying DPAUX controller.
  SOR instance should match DPAUX instance number.
- nvidia,xbar-ctrl: The 'xbar-ctrl' property controls the mapping of the lanes
  between the SOR and the pad macro.
- clock-names: Must include the following entries:
  "sor0_ref", "sor_safe", "sor0_pad_clkout", "sor0", "pll_dp", "pllp_out".
  "maud", "hda", "hda2codec_2x", "hda2hdmi"
- clocks: Must contain an entry for each entry in clock-names.
  See ../clocks/clock-bindings.txt for details
- reset-names: Must include the following entries:
  "sor", "hda", "hda2hdmicodec"
- resets: Must contain an entry for each entry in reset-names.
  See ../reset/reset.txt for details.
- hdmi-display: Information if this SOR can support hdmi display.
- dp-display: Information if this SOR can support dp display.
- nvidia,sor-hdcp-not-supported: With enabled, do not initialize HDCP driver.

Example:
=======

SoC DTSI:
--------

sor0: sor {
	status: "disabled";
	compatible = "nvidia,tegra194-sor";
	reg = <0x0 0x15B00000 0x0 0x40000>;
	interrupts = <0 157 0x4>;

	nvidia,sor-ctrlnum = <0>;
	nvidia,dpaux = <&dpaux0>;
	nvidia,xbar-ctrl = <0x2 0x1 0x0 0x3 0x4>;

	clocks = <&bpmp_clks TEGRA194_CLK_SOR0_REF>,
		 <&bpmp_clks TEGRA194_CLK_SOR_SAFE>,
		 <&bpmp_clks TEGRA194_CLK_SOR0_PAD_CLKOUT>,
		 <&bpmp_clks TEGRA194_CLK_SOR0_OUT>,
		 <&bpmp_clks TEGRA194_CLK_PLLDP>,
		 <&bpmp_clks TEGRA194_CLK_PLLP_OUT0>,
		 <&bpmp_clks TEGRA194_CLK_MAUD>,
		 <&bpmp_clks TEGRA194_CLK_HDA>,
		 <&bpmp_clks TEGRA194_CLK_HDA2CODEC_2X>,
		 <&bpmp_clks TEGRA194_CLK_HDA2HDMICODEC>;
	clock-names = "sor0_ref", "sor_safe", "sor0_pad_clkout",
		      "sor0", "pll_dp", "pllp_out0",
		      "maud", "hda", "hda2codec_2x",
		      "hda2hdmi";
	resets = <&bpmp_resets TEGRA194_RESET_SOR0>,
		 <&bpmp_resets TEGRA194_RESET_HDA>,
		 <&bpmp_resets TEGRA194_RESET_HDA2HDMICODEC>;
	reset-names = "sor0","hda_rst","hda2hdmi_rst";

	sor0_hdmi_display: hdmi-display {
		compatible = "hdmi,display";
		status = "disabled";
	};
	sor0_dp_display: dp-display {
		compatible = "dp, display";
		status = "disabled";
	};
}; //sor

Board DTSI:
----------

sor0: sor0 {
	status: "okay";
};
```

## kernel/nvidia/Documentation/devicetree/bindings/video/nvidia,tegra234-display.txt
```
NVIDIA Tegra234 Display Controller
===================================

The Tegra Display Controller (DC) provides an engine for display processing
pipeline with support of format conversion, scaling, rotation of display
content with supporting different protocols for display pipeline.

This document describes the device tree bindings for the Display Controller
hardware itself, as well as for subnodes corresponding to this engine.

On Tegra234, Display Controller settings are specified as part of two blobs:
a. DCB (Display Control Block), and
b. Device Tree

The configuration is split as below:
a. DCB specifies the supported Display Devices, Connector Types, DP/HDMI properties, etc.
b. Device Tree has SoC specific properties, like register space, clocks, interrupts, etc.

Tegra Display firmware takes data from both DCB and Device Tree to configure Display Controller.

This document explains the device-tree properties under display@13800000 node.
For DCB properties, please check the readme.txt available along with dcb_tool.

1) display@13800000 Node:
 Display node is specified under device-tree root.

Required properties:
- name: "display@13800000"
- compatible: Must be "nvidia,tegra234-display".
- nvidia,dcb-image: Holds the dcb blob (an array of hex values), which specifies the supported display devices and controllers.
      Check the readme.txt available along with dcb_tool for details on DCB and its properties.
- iommus: DC ISO Stream ID, should be "TEGRA_SID_ISO_NVDISPLAY". Display video surface memory
      is fetched as ISO.
- non-coherent: Non-coherent DMA, should be set because ISO clients can't snoop CPU caches.
- interconnects: Pairs of phandles and interconnect provider specifier to denote the edge source
      and destination ports of the interconnect path. Display is an interconnect consumer device.
      Refer to Documentation/devicetree/bindings/interconnect/interconnect.txt for details.
- interconnect-names: List of interconnect path name strings sorted in the same order as the
      interconnects property. Consumers drivers will use order as the interconnects property.
      Consumers drivers will use specifier pairs.
- os_gpio_hotplug_a: Specifies the HDMI hotplug gpio pin.
      Refer to Documentation/devicetree/bindings/gpio/gpio.txt to know more on how to specify a gpio pin.

Optional properties:
These properties are not used by Display Firmware on T234.
- status: Should be "disabled" in SoC and "okay" in Board dts files.
- reg: A list of physical base address and length of the controller's
      registers.
- interrupts: The interrupt IRQ info for the controller.
- clock-names: Names of the clocks that are accessed by Display Firmware. The order of names
      should match the clock IDs in clocks property.
- clocks: Must contain an entry indicating clock ID for each entry in clock-names.
      Refer to Documentation/devicetree/bindings/clocks/clock-bindings.txt for details.
- reset-names: Resets that are controlled by Display Firmware. The order of names should match
      the reset IDs in resets property.
- resets: Must contain an entry indicating reset ID for each entry in reset-names.
      Refer to Documentation/devicetree/bindings/reset/reset.txt for details.
- nvidia,disp-sw-soc-chip-id: Chip Identfier. Must be set to 0x2350 for T234.
- nvidia,bpmp: Specifies the BPMP device node.
- nvidia,num-dpaux-instance: Number of dpaux instances available on SoC. On T234, it is 1.

 1.A) nvdisplay-niso node:
 This node represents the Non-ISO properties of display. NISO memory accesses are used for display configuration updates through Pushbuffer.

Required properties
- compatible: Should contain "nvidia,tegra234-display-niso".
- iommus: DC NISO Stream ID, should be "TEGRA_SID_NISO0_NVDISPLAY". Pushbuffer memory access is NISO.
- dma-coherent: NISO memory accesses need to be Coherent.

1.B) dsi node:
 This node represents the DSI controller. DSI register space is part of Display registers in T234.
 Refer to nvidia,tegra234-dsi.txt for more details.

Example:
=======

SoC DTSI:
---------

	nvdisplay: display@13800000 {
		compatible = "nvidia,tegra234-display";
		power-domains = <&bpmp TEGRA234_POWER_DOMAIN_DISP>;
		nvidia,num-dpaux-instance = <1>;
		reg-names = "nvdisplay", "dpaux0", "hdacodec", "mipical";
		reg = <0x0 0x13800000 0x0 0xEFFFF    /* nvdisplay */
		       0x0 0x155C0000 0x0 0xFFFF     /* dpaux0 */
		       0x0 0x0242c000 0x0 0x1000     /* hdacodec */
		       0x0 0x03990000 0x0 0x10000>;  /* mipical */
		interrupt-names = "nvdisplay", "dpaux0", "hdacodec";
		interrupts = <0 416 4
		              0 419 4
			      0  61 4>;
		nvidia,bpmp = <&bpmp>;
		clocks = <&bpmp_clks TEGRA234_CLK_HUB>,
			 <&bpmp_clks TEGRA234_CLK_DISP>,
			 <&bpmp_clks TEGRA234_CLK_NVDISPLAY_P0>,
			 <&bpmp_clks TEGRA234_CLK_NVDISPLAY_P1>,
			 <&bpmp_clks TEGRA234_CLK_DPAUX>,
			 <&bpmp_clks TEGRA234_CLK_FUSE>,
			 <&bpmp_clks TEGRA234_CLK_DSIPLL_VCO>,
			 <&bpmp_clks TEGRA234_CLK_DSIPLL_CLKOUTPN>,
			 <&bpmp_clks TEGRA234_CLK_DSIPLL_CLKOUTA>,
			 <&bpmp_clks TEGRA234_CLK_SPPLL0_VCO>,
			 <&bpmp_clks TEGRA234_CLK_SPPLL0_CLKOUTPN>,
			 <&bpmp_clks TEGRA234_CLK_SPPLL0_CLKOUTA>,
			 <&bpmp_clks TEGRA234_CLK_SPPLL0_CLKOUTB>,
			 <&bpmp_clks TEGRA234_CLK_SPPLL0_DIV10>,
			 <&bpmp_clks TEGRA234_CLK_SPPLL0_DIV25>,
			 <&bpmp_clks TEGRA234_CLK_SPPLL0_DIV27PN>,
			 <&bpmp_clks TEGRA234_CLK_SPPLL1_VCO>,
			 <&bpmp_clks TEGRA234_CLK_SPPLL1_CLKOUTPN>,
			 <&bpmp_clks TEGRA234_CLK_SPPLL1_DIV27PN>,
			 <&bpmp_clks TEGRA234_CLK_VPLL0_REF>,
			 <&bpmp_clks TEGRA234_CLK_VPLL0>,
			 <&bpmp_clks TEGRA234_CLK_VPLL1>,
			 <&bpmp_clks TEGRA234_CLK_NVDISPLAY_P0_REF>,
			 <&bpmp_clks TEGRA234_CLK_RG0>,
			 <&bpmp_clks TEGRA234_CLK_RG1>,
			 <&bpmp_clks TEGRA234_CLK_DISPPLL>,
			 <&bpmp_clks TEGRA234_CLK_DISPHUBPLL>,
			 <&bpmp_clks TEGRA234_CLK_DSI_LP>,
			 <&bpmp_clks TEGRA234_CLK_DSI_CORE>,
			 <&bpmp_clks TEGRA234_CLK_DSI_PIXEL>,
			 <&bpmp_clks TEGRA234_CLK_PRE_SOR0>,
			 <&bpmp_clks TEGRA234_CLK_PRE_SOR1>,
			 <&bpmp_clks TEGRA234_CLK_DP_LINK_REF>,
			 <&bpmp_clks TEGRA234_CLK_SOR_LINKA_INPUT>,
			 <&bpmp_clks TEGRA234_CLK_SOR_LINKA_AFIFO>,
			 <&bpmp_clks TEGRA234_CLK_SOR_LINKA_AFIFO_M>,
			 <&bpmp_clks TEGRA234_CLK_RG0_M>,
			 <&bpmp_clks TEGRA234_CLK_RG1_M>,
			 <&bpmp_clks TEGRA234_CLK_SOR0_M>,
			 <&bpmp_clks TEGRA234_CLK_SOR1_M>,
			 <&bpmp_clks TEGRA234_CLK_PLLHUB>,
			 <&bpmp_clks TEGRA234_CLK_SOR0>,
			 <&bpmp_clks TEGRA234_CLK_SOR1>,
			 <&bpmp_clks TEGRA234_CLK_SOR_PAD_INPUT>,
			 <&bpmp_clks TEGRA234_CLK_PRE_SF0>,
			 <&bpmp_clks TEGRA234_CLK_SF0>,
			 <&bpmp_clks TEGRA234_CLK_SF1>,
			 <&bpmp_clks TEGRA234_CLK_DSI_PAD_INPUT>,
			 <&bpmp_clks TEGRA234_CLK_PRE_SOR0_REF>,
			 <&bpmp_clks TEGRA234_CLK_PRE_SOR1_REF>,
			 <&bpmp_clks TEGRA234_CLK_SOR0_PLL_REF>,
			 <&bpmp_clks TEGRA234_CLK_SOR1_PLL_REF>,
			 <&bpmp_clks TEGRA234_CLK_SOR0_REF>,
			 <&bpmp_clks TEGRA234_CLK_SOR1_REF>,
			 <&bpmp_clks TEGRA234_CLK_OSC>,
			 <&bpmp_clks TEGRA234_CLK_DSC>,
			 <&bpmp_clks TEGRA234_CLK_MAUD>,
			 <&bpmp_clks TEGRA234_CLK_AZA_2XBIT>,
			 <&bpmp_clks TEGRA234_CLK_AZA_BIT>,
			 <&bpmp_clks TEGRA234_CLK_MIPI_CAL>,
			 <&bpmp_clks TEGRA234_CLK_UART_FST_MIPI_CAL>,
			 <&bpmp_clks TEGRA234_CLK_SOR0_DIV>;
		clock-names = "nvdisplayhub_clk",
			      "nvdisplay_disp_clk",
			      "nvdisplay_p0_clk",
			      "nvdisplay_p1_clk",
			      "dpaux0_clk",
			      "fuse_clk",
			      "dsipll_vco_clk",
			      "dsipll_clkoutpn_clk",
			      "dsipll_clkouta_clk",
			      "sppll0_vco_clk",
			      "sppll0_clkoutpn_clk",
			      "sppll0_clkouta_clk",
			      "sppll0_clkoutb_clk",
			      "sppll0_div10_clk",
			      "sppll0_div25_clk",
			      "sppll0_div27_clk",
			      "sppll1_vco_clk",
			      "sppll1_clkoutpn_clk",
			      "sppll1_div27_clk",
			      "vpll0_ref_clk",
			      "vpll0_clk",
			      "vpll1_clk",
			      "nvdisplay_p0_ref_clk",
			      "rg0_clk",
			      "rg1_clk",
			      "disppll_clk",
			      "disphubpll_clk",
			      "dsi_lp_clk",
			      "dsi_core_clk",
			      "dsi_pixel_clk",
			      "pre_sor0_clk",
			      "pre_sor1_clk",
			      "dp_link_ref_clk",
			      "sor_linka_input_clk",
			      "sor_linka_afifo_clk",
			      "sor_linka_afifo_m_clk",
			      "rg0_m_clk",
			      "rg1_m_clk",
			      "sor0_m_clk",
			      "sor1_m_clk",
			      "pllhub_clk",
			      "sor0_clk",
			      "sor1_clk",
			      "sor_pad_input_clk",
			      "pre_sf0_clk",
			      "sf0_clk",
			      "sf1_clk",
			      "dsi_pad_input_clk",
			      "pre_sor0_ref_clk",
			      "pre_sor1_ref_clk",
			      "sor0_ref_pll_clk",
			      "sor1_ref_pll_clk",
			      "sor0_ref_clk",
			      "sor1_ref_clk",
			      "osc_clk",
			      "dsc_clk",
			      "maud_clk",
			      "aza_2xbit_clk",
			      "aza_bit_clk",
			      "mipi_cal_clk",
			      "uart_fst_mipi_cal_clk",
			      "sor0_div_clk";
		resets = <&bpmp_resets TEGRA234_RESET_NVDISPLAY>,
			 <&bpmp_resets TEGRA234_RESET_DPAUX>,
			 <&bpmp_resets TEGRA234_RESET_DSI_CORE>,
			 <&bpmp_resets TEGRA234_RESET_MIPI_CAL>;
		reset-names = "nvdisplay_reset",
			      "dpaux0_reset",
			      "dsi_core_reset",
			      "mipi_cal_reset";
		status = "disabled";
		nvidia,disp-sw-soc-chip-id = <0x2350>;
#if TEGRA_IOMMU_DT_VERSION >= DT_VERSION_2
		interconnects = <&mc TEGRA234_MEMORY_CLIENT_NVDISPLAYR>,
			        <&mc TEGRA234_MEMORY_CLIENT_NVDISPLAYR1>;
		interconnect-names = "dma-mem", "read-1";
#endif

		iommus = <&smmu_iso TEGRA_SID_ISO_NVDISPLAY>;
		non-coherent;
		nvdisplay-niso {
			compatible = "nvidia,tegra234-display-niso";
			iommus = <&smmu_niso0 TEGRA_SID_NISO0_NVDISPLAY>;
			dma-coherent;
		};
		dsi {
			compatible = "nvidia,tegra234-dsi";
			nvidia,active-panel = "NULL";
			status = "disabled";
		};
	}; //display@13800000


Board DTS:
-----------

	nvdisplay: display@13800000 {
		status: "okay";
	};
```
