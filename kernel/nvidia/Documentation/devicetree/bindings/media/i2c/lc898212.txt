## kernel/nvidia/Documentation/devicetree/bindings/misc/therm_fan_est.txt
```
Thermal fan estimator driver.

Properties :
 - compatible : Should contain "thermal-fan-est".
 - shared_data : A sub node thermal_fan_est_shared_data.
 - trip_length : The number of temperature would be triggered.
 - profiles : List all supporting fan mode.

Properties in thermal_fan_est_shared_data node : Required.
 - toffset : Tolerance of calibration data.
 - polling_period : The period used to update the temperature.
 - ndevs : The number of cooling device.
 - cdev_type : Cooling device.
 - tzp_governor_name : Select thermal governor.
	Support "pid_thermal_gov" and "cont_therm_gov".
 - dev_data in dev1 node : List hot spots for sampling the temperature.

Properties in profiles : Required.
 - default : Default fan profile.
 - active_trip_temps : A list of temperature points.
 - active_hysteresis : Define the scope of switch point to a lower speed.
	If temperature < (active_trip_temps[index] - active_hysteresis[index]),
	then fan will switch to a lower speed.

Example:

	thermal_fan_est_shared_data: tfesd {
		toffset = <0>;
		polling_period = <1100>;
		ndevs = <1>;
		cdev_type = "pwm-fan";
		tzp_governor_name = "pid_thermal_gov";
		dev1 {
			dev_data = "CPU-therm";
			coeffs = <100 0 0 0 0 0 0 0 0 0 0 0 0 0 0 0 0 0 0 0>;
		};
	};

	thermal-fan-est {
		name = "thermal-fan-est";
		compatible = "thermal-fan-est";
		status = "okay";
		shared_data = <&thermal_fan_est_shared_data>;
		trip_length = <10>;
		profiles {
			default = "quiet";
			quiet {
				active_trip_temps = <0 75000 77000 79000 81000
					83000 150000 160000 170000 180000>;
				active_hysteresis = <0 40000 12000 10000 10000
					9000 0 0 0 0>;
			};
			cool {
				active_trip_temps = <0 65000 67000 69000 71000
					73000 150000 160000 170000 180000>;
				active_hysteresis = <0 35000 10000 9000 9000
					9000 0 0 0 0>;
			};
		};
	};
```

## kernel/nvidia/Documentation/devicetree/bindings/mtd/tegra-virt-mtd-storage.txt
```
Tegra Virtual MTD Storage driver

Virtual MTD Storage Driver is the front end driver that interfaces with the
Storage Virtualization System for Tegra SOC and provides an MTD device
interface

Required Properties:
- compatible: should be "nvidia,tegra-virt-mtd-storage"
- ivc:        ivc channel to used for communication with Virtualization System
- mempool:    mempool used for data transfers with Virtualization System

Example:
	tegra_virt_storage4 {
		compatible = "nvidia,tegra-virt-mtd-storage";
		ivc = <&tegra_hv 106>;
		mempool = <21>;
		status = "okay";
	};
```

## kernel/nvidia/Documentation/devicetree/bindings/net/can/nv_hv_seccan.txt
```
Comms and Security virtual CAN controller Device Tree Bindings
--------------------------------------------------------------

This is the virtualised CAN device driver for Comms and Security enabled PCT, Linux will be the
guest VM and it used this device driver to communicate with Comms VM via IVC


Required properties:
compatible:         should be "nvidia,tegra-hv-seccan"
       ivc:         ivc channel number

Example:
       tegra_hv_seccan@0 {
         compatible = "nvidia,tegra-hv-seccan";
         status = "okay";
         ivc = <&tegra_hv 355>;
       };
```

## kernel/nvidia/Documentation/devicetree/bindings/net/tegra-hv-net.txt
```
Tegra Hypervisor Ethernet emulation driver

This driver provides ethernet emulation over a Tegra IVC channel

Required Properties:
- compatible:          should be "nvidia,tegra-hv-net"
- ivc:                 ivc channel number used for communication
- use-random-mac-addr: enables generation of a random max address that will
                       be used for the interface

Example:
	tegra_hv_net {
		compatible = "nvidia,tegra-hv-net";
		status = "okay";
		ivc = <&tegra_hv 79>;
	};
```

## kernel/nvidia/Documentation/devicetree/bindings/nvlink/nvidia,t19x-nvlink-controller.txt
```
Nvidia, t19x-nvlink-controller:
==============================

The device node describes Tegra Nvlink controller for T194. NVLINK is a high
speed serial communication protocol and an interconnect developed by NVIDIA.

Required properties:
--------------------
- compatible = Must be "nvidia,t19x-nvlink-controller".
- reg: A list of physical base address and length for each set of controller
  registers.
- clocks: Must contain an entry for each entry in clock-names.
  See ../clocks/clock-bindings.txt for details.
- clock-names: Must include the following entries:
  - "nvhs_pll0_mgmt"
  - "pllrefe_vcoout_gated"
  - "nvlink_sys"
  - "pllnvhs"
  - "clk_m"
  - "nvlink_pll_txclk"
  - "nvlink_tx"
- resets: Must contain an entry for each entry in reset-names.
  See ../reset/reset.txt for details.
- reset-names: Must include the following entries:
  - "mssnvl"
  - "nvhs_uphy_pm"
  - "nvhs_uphy"
  - "nvhs_uphy_pll0"
  - "nvhs_uphy_l0"
  - "nvhs_uphy_l1"
  - "nvhs_uphy_l2"
  - "nvhs_uphy_l3"
  - "nvhs_uphy_l4"
  - "nvhs_uphy_l5"
  - "nvhs_uphy_l6"
  - "nvhs_uphy_l7"
  - "nvlink"
- interrupts: The interrupts IRQ info for the device.
- local_dev_id: Local Nvlink endpoint device(T194) ID. This must be 0.
- local_link_id: Local Nvlink endpoint device(T194) link ID. This must be 0.
- remote_dev_id: Remote Nvlink endpoint device(dGPU) ID. This must be 1.
- remote_link_id: Remote Nvlink endpoint device(dGPU) link ID. This must be 1.

Examples:
========

Tegra194:
--------

SoC DTSI:

tnvlink_controller: tegra_nvlink_controller {
	compatible = "nvidia,t19x-nvlink-controller";
	reg = <0x0 0x3b80000 0x0 0x1000 /* NVLW_TIOCTRL */
	       0x0 0x3b84000 0x0 0x1000 /* NVLW_NVLIPT */
	       0x0 0x3b86000 0x0 0x1000 /* NVLW_MINION */
	       0x0 0x3b90000 0x0 0x4000 /* NVLW_NVL */
	       0x0 0x3b94000 0x0 0x1000 /* NVLW_SYNC2X */
	       0x0 0x3b96000 0x0 0x1000 /* NVLW_NVLTLC */
	       0x0 0x1f00000 0x0 0x20000>; /* MSSNVLINK_0 */
	clocks = <&bpmp_clks TEGRA194_CLK_NVHS_PLL0_MGMT>,
			<&bpmp_clks TEGRA194_CLK_PLLREFE_VCOOUT_GATED>,
			<&bpmp_clks TEGRA194_CLK_NVLINK_SYS>,
			<&bpmp_clks TEGRA194_CLK_PLLNVHS>,
			<&bpmp_clks TEGRA194_CLK_CLK_M>,
			<&bpmp_clks TEGRA194_CLK_NVLINK_PLL_TXCLK>,
			<&bpmp_clks TEGRA194_CLK_NVLINK_TX>;
	clock-names = "nvhs_pll0_mgmt", "pllrefe_vcoout_gated", "nvlink_sys",
			"pllnvhs", "clk_m", "nvlink_pll_txclk", "nvlink_tx";
	resets = <&bpmp_resets TEGRA194_RESET_MSSNVL>,
			<&bpmp_resets TEGRA194_RESET_NVHS_UPHY_PM>,
			<&bpmp_resets TEGRA194_RESET_NVHS_UPHY>,
			<&bpmp_resets TEGRA194_RESET_NVHS_UPHY_PLL0>,
			<&bpmp_resets TEGRA194_RESET_NVHS_UPHY_L0>,
			<&bpmp_resets TEGRA194_RESET_NVHS_UPHY_L1>,
			<&bpmp_resets TEGRA194_RESET_NVHS_UPHY_L2>,
			<&bpmp_resets TEGRA194_RESET_NVHS_UPHY_L3>,
			<&bpmp_resets TEGRA194_RESET_NVHS_UPHY_L4>,
			<&bpmp_resets TEGRA194_RESET_NVHS_UPHY_L5>,
			<&bpmp_resets TEGRA194_RESET_NVHS_UPHY_L6>,
			<&bpmp_resets TEGRA194_RESET_NVHS_UPHY_L7>,
			<&bpmp_resets TEGRA194_RESET_NVLINK>;
	reset-names = "mssnvl", "nvhs_uphy_pm", "nvhs_uphy", "nvhs_uphy_pll0",
			"nvhs_uphy_l0", "nvhs_uphy_l1", "nvhs_uphy_l2",
			"nvhs_uphy_l3",	"nvhs_uphy_l4",	"nvhs_uphy_l5",
			"nvhs_uphy_l6",	"nvhs_uphy_l7", "nvlink";
	interrupts = <0 178 0x4>; /* NVLINK2HOST interrupt */
	status = "disabled";
};

Board DTSI:

tegra_nvlink_controller {
	status = "okay";

	endpoint {
		local_dev_id = <0>;
		local_link_id = <0>;
		remote_dev_id = <1>;
		remote_link_id = <1>;
	};
};
```

## kernel/nvidia/Documentation/devicetree/bindings/nvmap/nvidia-generic_carveout.txt
```
NVIDIA generic carveout
-----------------------

This is child node of upstream /reserved-memory node.
It's used for OS to exclude the memory region for normal usage.

The memory region,"generic_carveout" is a heap and used by nvmap
clients to allocate physical memory from the heap
with certain cache-attributes.

For further property details, refer /reserved-memory
documentation.

Required properties:
- compatible: "nvidia,generic_carveout";

Example:
--------
	generic_reserved: generic_carveout {
		compatible = "nvidia,generic_carveout";
			size = <0 0>;
			alignment = <0 0x100000>;
			alloc-ranges = <0 0 0x1 0>;
			no-map;
			status = "disabled";
		};
```

## kernel/nvidia/Documentation/devicetree/bindings/nvmap/nvidia-gosmem_carveout.txt
```
NVIDIA gosmem carveout
-----------------------
"gosmem" carveout is reserved memory used for allocating "grid of
semaphore", GoS. GoS is used by CV clients, pva, dla, vi and isp
to allocate/modify bunch of semaphore values on one go.
This imrpoves perf.

This is child node of upstream /reserved-memory node.
It's used for OS to exclude the memory region for normal usage.

Required properties:
- compatible: "nvidia,gosmem";
- no-map: CPU can't map the memory for Rw
- cvdevs: CV(Compute Vision) clients who can access the gosmem carveout

Rest of the properties are common properties defined under /reserved-memory node Documentation

Example:
--------
	gos_reserved: grid-of-semaphores {
		compatible = "nvidia,gosmem";
		size = <0 0x6000>;
		alignment = <0 0x1000>;
		no-map;
		status = "disabled";
		cvdevs = <&nvdla0 &nvdla1 &pva0 &pva1 &vi_thi &isp_thi>;
	};
```

## kernel/nvidia/Documentation/devicetree/bindings/nvmap/nvidia-ivm_carveout.txt
```
NVIDIA ivm carveout
-----------------------

This is child node of upstream /reserved-memory node.
It's used for OS to exclude the memory region for normal usage.

The memory region,"ivm_carveout" declares ivm heap and used by nvmap
clients to allocate physical memory from the heap
with certain cache-attributes. The allocation from IVM heap is shared
in guest VMs.


Required properties:
- compatible: "nvidia,ivm_carveout";
- status: property is used to enable or disable the heap.
- reg: property is currently ignored, as IVM heap starting address and size are probed from hypervisor in run time.
- ivm: property links to the heap entry made in PCT platform_config.h,
       here the second element should be the index of the heap declared in in .mempools field
- alloc: property indicates whether it is a producer VM which can allocate or not.
         Note that for any IVM heap only one guest VM should configure alloc = 1, while other configures alloc=0

Rest of the properties are common properties defined under /reserved-memory node Documentation

Example:
--------
	ivm0: carveout0 {
		status = "okay";
		compatible = "nvidia,ivm_carveout";
		reg = <0x0 0x0 0x0 0x04c00000>;
		ivm = <&tegra_hv 16>;
		alloc = <1>;
		no-map;
	};
~
```

## kernel/nvidia/Documentation/devicetree/bindings/nvmap/nvidia-ramoops.txt
```
NVIDIA ramoops carveout
-----------------------

This is child node of upstream /reserved-memory node.
It's used for OS to exclude the memory region for normal usage.

The memory region,"ramoops_carveout" declares storage for oops messages.
It's used by system to recored oops log at the perisistent memory location.
Start address is modified by boot loader.

Required properties:
- compatible: "nvidia,ivm_carveout";

Rest of the properties are common properties defined under /reserved-memory node Documentation

Example:
--------
	ramoops_reserved: ramoops_carveout {
		compatible = "nvidia,ramoops";
		size = <0x0 0x200000>;
		alignment = <0x0 0x10000>;
		alloc-ranges = <0x0 0x0 0x1 0x0>;
		no-map;
	};
```

## kernel/nvidia/Documentation/devicetree/bindings/nvmap/nvidia-vpr_carveout.txt
```
NVIDIA vpr carveout
-----------------------
VPR is an acronym which stands for "Video Protection Region".
VPR is a region in memory which is secured by the MC from
access and modification by engines that are not part of the
video decode and display process.
The intended use of the VPR region is to prevent rogue
hardware or software from gaining access to protected video data

This is child node of upstream /reserved-memory node.
It's used for OS to exclude the memory region for normal usage.

Required properties:
- compatible: "nvidia,vpr_carveout";
- reusable: It tells the VPR memory can be used by CMA

Rest of the properties are common properties defined under /reserved-memory node Documentation

Example:
--------
	vpr: vpr-carveout {
		compatible = "nvidia,vpr-carveout";
		size = <0 0x2a000000>;
		alignment = <0 0x400000>;
		alloc-ranges = <0x0 0x80000000 0x0 0x70000000>;
		reusable;
	};
```
