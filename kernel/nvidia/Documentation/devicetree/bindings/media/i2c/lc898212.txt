## kernel/nvidia/Documentation/devicetree/bindings/media/tegra-cdi-mgr.txt
```
NVIDIA tegra cdi mgr driver

This file documents the properties used by the cdi-mgr driver in tegra platform

Required properties:
- compatible : Should be "nvidia,cdi-mgr"
- i2c-bus : Should contain the i2c bus number that the device is attached to tegra for controlling the cdi
- csi-port : Should contain the csi port number that the device is attached to tegra for image streaming

Optional properties:
- pwdn-gpios : Should contain the list for gpios to control power in order of aggregator and camera instances
- pwr-items : Map power items to the GPIO item specified in the pwdn-gpios list, starting from 0. For example,
              pwr-item 0 is for the deserializer, while pwr-item 1, 2, 3, 4 are for links 0, 1, 2, 3
- default-power-on : If this property is used, while probing the device, pwdn-gpios are powered on
- runtime-pwrctrl-off : If this property is used, power control gpios keep the same status and they're
                        never changed.
- interrupt-parent : Should contain interrupt parent for gpio interrupt
- interrupts : Should contain the gpio number that is connected to status pin in cdi device
- pwms : PWM property to point to the PWM chip, chip-relative PWM number and period in nano seconds
- ext-pwr-ctrl-deserializer : Deserializer power is controlled externally
- ext-pwr-ctrl-sensor : Sensor power is controlled externally

Example:
sipl_devblk_0 {
	compatible = "nvidia,cdi-mgr";
	pwms = <&sipl_devblk_pwm_4 0 33333333>; /* PWM name, chip-relative PWM number, period in nano seconds */
	status = "okay";
	tegra {
		i2c-bus = <0>;
		csi-port = <0>;
		interrupt-parent = <&tegra_main_gpio>;
		interrupts = <TEGRA194_MAIN_GPIO(P, 5) 2>; /* GMSLA_STATUS_OC : falling edge sensitive */
	};

	deserializer {
		addr = <0x29>;   /* 7 bit slave address */
		reg_len = <16>;  /* 16 bit register length */
		dat_len = <8>;   /* 8 bit data length */
		des_i2c_port = <0>; /* I2C port number of the deserializer */
		/* des_tx_port = <0>;*/ /* CSI Tx port number. Define des_tx_port only if the dedicated output Tx port is required */
		dphy_rate_x2 = <2500000>; /* Data rate in DPHY x2. Unit size is kbps */
		dphy_rate_x4 = <2500000>; /* Data rate in DPHY x4. Unit size is kbps */
		cphy_rate_x2 = <2000000>; /* Data rate in CPHY x2. Unit size is ksps */
		cphy_rate_x4 = <1700000>; /* Data rate in CPHY x4. Unit size is ksps */
	};

	pwr_ctrl {
		power_port = <0>;
		ext-pwr-ctrl-deserializer; /* The deserializer power is controlled by Aurix */
		ext-pwr-ctrl-sensor; /* The sensor power is controlled by Aurix */
	};
};
```

## kernel/nvidia/Documentation/devicetree/bindings/media/tegra-cdi-pwm.txt
```
NVIDIA tegra cdi pwm driver

This file documents the properties used by the cdi-mgr driver in tegra platform

Required properties:
- compatible : Should be "nvidia,cdi-pwm"
- pwms : PWM property to point to the PWM chip, chip-relative PWM number and to
         specify the period time to be used
- pwm-cells : Specify the number of cells used for the PWM chip
- npwm : number of PWMs controlled by this chip
- force_on : Force to turn PWM on and disable control of cdi-pwms

Example:
sipl_devblk_pwm_4: sipl_pwm_gen_4 {
	compatible = "nvidia,cdi-pwm";
	pwms = <&tegra_pwm5 0 0>; /* by default the number of cells is 2 */
	#pwm-cells = <2>;
	npwm = <4>; /* number of PWMs controlled by this chip */
	force_on; /* Force turn on PWM and disable control of sipl_devblk_pwm */
	status = "disabled";
};
```

## kernel/nvidia/Documentation/devicetree/bindings/media/tegra-isc-mgr.txt
```
NVIDIA tegra isc mgr driver

This file documents the properties used by the isc-mgr driver in tegra platform

Required properties:
- compatible : Should be "nvidia,isc-mgr"
- i2c-bus : Should contain the i2c bus number that the device is attached to tegra for controlling the isc
- csi-port : Should contain the csi port number that the device is attached to tegra for image streaming

Optional properties:
- pwdn-gpios : Should contain the list for gpios to control power in order of aggregator and camera instances
- pwr-items : Map power items to the GPIO item specified in the pwdn-gpios list, starting from 0. For example,
              pwr-item 0 is for the deserializer, while pwr-item 1, 2, 3, 4 are for links 0, 1, 2, 3
- default-power-on : If this property is used, while probing the device, pwdn-gpios are powered on
- runtime-pwrctrl-off : If this property is used, power control gpios keep the same status and they're
                        never changed.
- interrupt-parent : Should contain interrupt parent for gpio interrupt
- interrupts : Should contain the gpio number that is connected to status pin in isc device
- pwms : PWM property to point to the PWM chip, chip-relative PWM number and period in nano seconds
- ext-pwr-ctrl-deserializer : Deserializer power is controlled externally
- ext-pwr-ctrl-sensor : Sensor power is controlled externally
- cphy-map-trio0 : CPHY map for trio 0. Valid values are "A_B_C", "A_C_B", "B_C_A", "B_A_C", "C_A_B", C_B_A".
- cphy-map-trio1 : CPHY map for trio 1. Valid values are "A_B_C", "A_C_B", "B_C_A", "B_A_C", "C_A_B", C_B_A".
- cphy-map-trio2 : CPHY map for trio 2. Valid values are "A_B_C", "A_C_B", "B_C_A", "B_A_C", "C_A_B", C_B_A".
- cphy-map-trio3 : CPHY map for trio 3. Valid values are "A_B_C", "A_C_B", "B_C_A", "B_A_C", "C_A_B", C_B_A".

Example:
isc-mgr.0 {
    compatible = "nvidia,isc-mgr";
    i2c-bus = <2>;
    csi-port = <0>;
    pwdn-gpios = < &gpio TEGRA_GPIO(X, 1) GPIO_ACTIVE_HIGH     /* GMSL_IN1_PDN */
                   &gpio TEGRA_GPIO(H, 2) GPIO_ACTIVE_HIGH     /* TA_TV1_TV2_ENA */
                   &gpio TEGRA_GPIO(H, 5) GPIO_ACTIVE_HIGH>;   /* TA_TV3_TV4_ENA */
    pwr-items =  <0 1 1 2 2>; /* map pwr-items to pwdn-gpios */
    /* default-power-on; */ /* Deactivate pwdn-gpios */
    /* runtime-pwrctr-off; */
    interrupt-parent = <&gpio>;
    interrupts = <TEGRA_GPIO(V, 2) 2>; /* gpio PS3 : falling edge sensitive */
    pwms = <&isc_pwm 0 33333333>; /* PWM name, chip-relative PWM number, period in nano seconds */
    ext-pwr-ctrl-deserializer;
    ext-pwr-ctrl-sensor;
    cphy-map-trio0 = "A_B_C";
    cphy-map-trio1 = "C_A_B";
    cphy-map-trio2 = "A_B_C";
    cphy-map-trio3 = "C_A_B";
    status = "okay";
};
```

## kernel/nvidia/Documentation/devicetree/bindings/misc/mods/mods-clocks.txt
```
NVIDIA Tegra MODS clock bindings

Mods clock is an interface to access  BPMP exposed clocks from MODS for
diagnostic application and characterization.
MODS accesses and configures various clocks using this interface.

Required properties:
	- compatible: Should be "simple-bus".
	- device_type: Should be "mods-simple-bus".
	- #address-cells: Number of address cells in each subnode, set to <1>.
	- #size-cells: Number of size cells in each subnode, set to <0>.

	-- MODS clocks (mods-clocks) --
	- compatible: Should be "nvidia,mods-clocks".
	- clocks: All bpmp exported clocks.
	- clock-names: Names of the above clocks.
	- resets: All bpmp exported resets.
	- reset-names: Names of the above resets.

Optional properties:
	- status: set to "disabled" for normal operation.

Example:

	mods-simple-bus {
		compatible = "simple-bus";
		device_type = "mods-simple-bus";
		#address-cells = <1>;
		#size-cells = <0>;

		mods-clocks {
			compatible = "nvidia,mods-clocks";
			status = "disabled";
			clocks = <&bpmp_clks TEGRA194_CLK_ACTMON>,
				<&bpmp_clks TEGRA194_CLK_ADSP>,
				<&bpmp_clks TEGRA194_CLK_ADSPNEON>;
			clock-names = "actmon",
				"adsp",
				"adspneon";
			resets = <&bpmp_resets TEGRA194_RESET_ACTMON>,
				<&bpmp_resets TEGRA194_RESET_ADSP_ALL>,
				<&bpmp_resets TEGRA194_RESET_AFI>;
			reset-names = "actmon",
				"adsp_all",
				"afi";
		}
	}
```

## kernel/nvidia/Documentation/devicetree/bindings/misc/nvidia,mods_test.txt
```
NVIDIA MODS driver stub for retrieving physical addresses.

NVIDIA MODS driver is a driver used by diagnostic software.  One of the
functions provided by the driver is retrieving physical addresses associated
with page-locked memory used in user space for communication with devices.
In order to be able to retrieve physical addresses, the NVIDIA MODS driver
registers itself as a dummy platform driver, which requires specifying a
device tree node.  This device tree node is defined inside in the driver just
for the registration and it does not have to exist in the device tree at all.

Properties :
 - compatible : Should contain "nvidia,mods_test".
```

## kernel/nvidia/Documentation/devicetree/bindings/misc/nvidia,tegra-saf775x.txt
```
* NVIDIA Tegra SAF775x codec driver

The Tegra SAF775x provide userspace interface to control
programming of SAF775x hardware.

Required properties:
- compatible: Must be "nvidia,tegra-saf775x".
- rst-gpio : phandle for tmpm32xi2c_61 and gpio number on tmpm32xi2c_61.

Example:

saf775x { /* dirana3 */
	status = "okay";
	compatible = "nvidia,tegra-saf775x";
	rst-gpio = <&tmpm32xi2c_61 TMPM32X_GPIO(A, 7) 0>;
};
```

## kernel/nvidia/Documentation/devicetree/bindings/misc/nvidia,tegra186-ahc.txt
```
* NVIDIA Tegra AHC device

The Tegra AHC device is interface to AHUB clients interface
which can capture interrupt and live status of all ahub
clients.

Required properties:
- compatible: Must be "nvidia,tegra186-ahc".
- interrupt-parent : phandle for agic device
- reg : register address space for ahc
- interrupt : property define interrupt number, state, routed
  interface

Example:

tegra_ahc: ahc@290b900 {
	compatible = "nvidia,tegra186-ahc";
	interrupt-parent = <&tegra_agic>;
	reg = <0x0 0x290b900 0x0 0x200>;
	interrupts =  <GIC_SPI INT_AHUB_ERR IRQ_TYPE_LEVEL_HIGH ROUTE_TO_HOST_INTF0>;
};
```

## kernel/nvidia/Documentation/devicetree/bindings/misc/nvidia,tegra18x-eqos-ape.txt
```
* NVIDIA Tegra EQOS APE Driver

The Tegra EQOS APE Driver which exposes interface for userspace
for retrieving information regarding drift between audio and eqos
clocks. And based on that a correction can be done by using asrc
to get clocks in sync.

Required properties:
- compatible: Must be "nvidia,tegra18x-eqos-ape";.
- reg: Should contain AMISC registers location and length. This should be
  a two entries that includes amisc idle register and EAVB related address
  space.
- clocks: Must contain three entries for the APE, PLL_A_OUT0 and PLLA
- clock-names: Must contain the alias of APE, PLL_A_OUT0 and PLLA as
  "eqos_ape.ape", "pll_a_out0", "pll_a".

Example:

eqos_ape@2990000 {
	status = "okay";
	compatible = "nvidia,tegra18x-eqos-ape";
	reg = <0x0 0x02990054 0x0 0x4>, /* AMISC IDLE*/
		<0x0 0x029900c0 0x0 0x28>;  /* AMISC EAVB*/
	clocks = <&bpmp_clks TEGRA194_CLK_APE>,
		<&bpmp_clks TEGRA194_CLK_PLLA_OUT0>,
		<&bpmp_clks TEGRA194_CLK_PLLA>;
	clock-names = "eqos_ape.ape", "pll_a_out0", "pll_a";
};
```

## kernel/nvidia/Documentation/devicetree/bindings/misc/nvsciipc/nvidia,nvsciipc.txt
```
NvSciIpc Kernel Driver

The NvSciIpc(Nvidia Software Communication Interfaces - Inter Process Communication) library
provides API for any two entities in a system to communicate with each other irrespective of
where they are placed.
NvSciIpc Kernel driver implements the Kernel space support needed for NvSciIpc functionality.
At present this is used only to support secure buffer sharing usecase across processes

Required properties:
--------------------
- compatible: should be nvidia,nvsciipc

Example:
--------
	nvsciipc-kernel {
		compatible = "nvidia,nvsciipc";
		status = "okay";
	};
```

## kernel/nvidia/Documentation/devicetree/bindings/misc/nvsec/nvsecmsg.txt
```
Comms and Security inter vm message Device Tree Bindings
--------------------------------------------------------

The inter vm message is a Comms and Security feature which supports inter VM message exchange
between Security VM and guest VM


Required properties:
compatible:         should be "nvidia,tegra-hv-secmsg"
    taggsc:         message service tag
                    format: taggsc = <vm_id, ivm_service>
                            vm_id: comms&security pct guest vm id starts from 1
                      ivm_service: the service number, should keep as 3 for the nvsecmsg application

       ivc:         ivc channel number

  platform:         comms&security pct platform id for supporting multiple platforms
                    e.g. "driveav" is for the drive AV pct. There will be new ids for
                    pcts which need comms and security service

Example:
       tegra_hv_secmsg {
          compatible = "nvidia,tegra-hv-secmsg";
          status = "okay";
          taggsc = <1 3>;
          ivc = <&tegra_hv 365>;
          platform = "driveav";
       };
```

## kernel/nvidia/Documentation/devicetree/bindings/misc/tegra-cec/nvidia,tegra234-cec.txt
```
NVIDIA Tegra Consumer Electronics Control

The Tegra Consumer Electronics Control (CEC) provides an engine for programming
CEC protocol so that CEC data can be transmitted and received to connected HDMI monitor.

This document describes the device tree bindings for the CEC hardware.

Required properties:
- status: Should be "disabled" in SoC and "okay" in Board DTSI.
- compatible: Must be "nvidia,tegra234-cec".
- reg: A list of physical base address and length of CEC's registers.
- interrupts: The interrupt IRQ info for the CEC hardware.
- reset-names: Must include the following entries:
  "TEGRA234_RESET_CEC"
- resets: Must contain an entry for each entry in reset-names.
  See ../reset/reset.txt for details.

In order to enable CEC on a specific board, Board DTSI should be used.
The Pinmux settings should be also changed in Board Pinmux DTSI file as given
below. Only change pinmux settings if CEC functionality is needed. Otherwise
it will draw more power as PAD is always powered on due to below settings.

Example:
=======

SoC DTSI:
--------

tegra_cec: tegra_cec {
	compatible = "nvidia,tegra234-cec";
	reg = <0x0 0x0c3e0000 0x0 0x00001000>;
	interrupts = <0 279 0x04>;
	resets = <&bpmp_resets TEGRA234_RESET_CEC>;
	reset-names = "cec";
	status = "disabled";
};

Board DTSI:
----------

tegra_cec: tegra_cec {
	status = "okay";
};

Pinmux DTSI:
-----------

Required properties:
- nvidia,pins : String contains the name of a pin on which CEC is connected.
    This must be set as per board schematic.
- nvidia,function: A string containing the name of the function to mux to the
    pin. Must be set to "hdmi".
- nvidia,pull: Integer, representing the pull-down/up to apply to the pin.
    0: none, 1: down, 2: up. Must be set to "TEGRA_PIN_PULL_UP"
- nvidia,tristate: Integer.
    0: passthrough, 1: tristate. Must be set to TEGRA_PIN_PASSTHROUGH/DISABLE
- nvidia,enable-input: Integer. Enable the pin's input path.
    enable :TEGRA_PIN_ENABLE0 and
    disable or output only: TEGRA_PIN_DISABLE. Must be set to ""
- nvidia,io-high-voltage: input/output voltage.
    enable: TEGRA_PIN_ENABLE.
    disable: TEGRA_PIN_DISABLE. Must be set to "TEGRA_PIN_ENABLE". This will
    drain more power as PAD is set to high voltage on always.
- nvidia,io-high-voltage: LPDR settings
    enable: TEGRA_PIN_ENABLE.
    disable: TEGRA_PIN_DISABLE. Must be set to "TEGRA_PIN_DISABLE".

Example:
=======

hdmi_cec_pgg0 {
	nvidia,pins = "hdmi_cec_pgg0";
	nvidia,function = "hdmi";
	nvidia,pull = <TEGRA_PIN_PULL_UP>;
	nvidia,tristate = <TEGRA_PIN_DISABLE>;
	nvidia,enable-input = <TEGRA_PIN_ENABLE>;
	nvidia,io-high-voltage = <TEGRA_PIN_ENABLE>;
	nvidia,lpdr = <TEGRA_PIN_DISABLE>;
};
```
