## kernel/nvidia/Documentation/devicetree/bindings/media/i2c/lc898212.txt
```
ON Semiconductor LC898212 Camera Focuser, NVIDIA TCF driver bindings

The ON Semiconductor LC898212 is a digitally-controlled voice coil motor (VCM)
focuser module built into embedded camera packages.

Camera-board specific overlays are applied by the NVIDIA Tegra plugin-manager
pre-boot, they define the physical regulator and GPIO connections which differ
by the Jetson board and chip generation, and the camera daughter board revision.

Required properties:
	- compatible: Should be "onnn,lc898212".
	- reg: Sensor I2C bus address, default is 0x72.

	- vcmvdd-reg: Name of the voice coil motor (VCM) focuser power
		regulator.
	- vvcm-supply: Voice coil motor (VCM) focuser power source.

	- min_focus_distance: Minimum focus distance ratio.
	- hyper_focal: Hyperfocal distance ratio.
	- focal_length: Focal length.
	- f_number: Focuser f-number.
	- aperture: Focuser aperture f-number.

Optional properties:
	- support_mfi: Whether focuser synchronization is supported.

Deprecated properties:
	- devnode: Name of V4L2 character device in filesystem, this property is
		now deprecated, the Tegra Camera Framework enumerates them
		automatically.
	- type: Set to "default" if property is still necessary in software
		stack.

Example:

	lc898212@72 {
		compatible = "onnn,lc898212";
		reg = <0x72>;

		/* physical camera layer interface tags */
		devnode = "video3";
		type = "default";
		min_focus_distance = "10.0"; /* 1.0f/0.1f */
		hyper_focal = "0.2"; /* 1.0f/5.0f */
		focal_length = "4.73";
		f_number = "2.2";
		aperture = "2.2";
	};

	/* Camera board-specific config overlay */
	lc898212_2: lc898212@72 {
		vvcm-supply = <&en_vdd_vcm_2v8>;
		support_mfi = "true";
	};
```

## kernel/nvidia/Documentation/devicetree/bindings/media/i2c/pca9570.txt
```
NXP Semiconductor PCA9570 GPIO Expander, NVIDIA driver bindings

The NXP Semiconductor PCA9570 is an I2C 4-bit GPIO expander.

Required properties:
	- compatible: Should be "nxp,pca9570".
	- reg: Sensor I2C bus address, default is 0x24.
	- channel: Device channel index [alpha char.].
	- drive_ac: Device IC name.

Example:

	pca9570_a@24 {
		compatible = "nvidia,pca9570";
		reg = <0x24>;
		channel = "a";
		drive_ic = "DRV8838";
	};
```

## kernel/nvidia/Documentation/devicetree/bindings/media/spi/imx204.txt
```
Sony IMX204 CMOS Image Sensor, NVIDIA TCF driver bindings

The Sony IMX204 is a 20.68 MP CMOS colour image sensor; the following Device
Tree bindings are for the NVIDIA Tegra Camera Framework (TCF) driver, for use on
embedded NVIDIA Tegra SOC platforms.

Camera-board specific overlays are applied by the NVIDIA Tegra plugin-manager
pre-boot, they define the physical regulator and GPIO connections which differ
by the Jetson board and chip generation, and the camera daughter board revision.

Required properties:
	- compatible: Should be "sony,imx204".
	- sensor_model: Name of sensor, should be "imx204".
	- reg: Sensor SPI chip select, should be '0'.
	- modeXY: Please see tegra-camera-framework.txt for DT bindings.

	- avdd-reg: Name of analog power regulator.
	- vana-supply: Analog power source (2.80 V).
	- iovdd-reg: Name of interface power regulator.
	- vif-supply: Interface power source (1.80 V).
	- dvdd-reg: Name of digital power regulator.
	- vdig-supply: Digital power source (1.20 V).

	- spi-max-frequency: Speed of the SPI bus for control programming [Hz].
	- clocks: All clocks from the Tegra SoC used to drive sensor.
	- clock-names: Names of the above clocks.
	- mclk: Name of the MIPI clock (aka. INCK) driven from the Tegra SOC.
	- clock-frequency: Frequency of the mclk source [Hz].
	- reset-gpios: GPIO(s) used to ouput reset/enable signal.
	- pwdn-gpios: GPIO(s) used to enable/disable sensor power.

	- focus_macro: Focus macro distance.
	- focus_infinity: Focus distance at infinity.
	- focus_max_slew_rate: Focuser maximum slew rate.
	- min_aperture = Minimum aperture.
	- max_aperture = Maximum aperture.
	- min_aperture_fnumber: Minimum aperture f-number (x1000).
	- max_aperture_fnumber: Maximum aperture f-number (x1000).
	- aperture_max_slew_rate: Maximum aperture slew rate.
	- fnumber_map: F-number (x1000) to focuser motor position LUT.

Optional properties:
	- physical_w: Horizontal width of active surface [mm].
	- physical_h: Vertical height of active surface [mm].

	- has_eeprom: Property is present if there is a sensor-external EEPROM.
	- fuse_id_start_addr: Sensor-internal fuse base I2C address.

	- use_sensor_mode_id: Whether to enable use of the V4L2
		CID_SENSOR_MODE_ID control, which enables explicit sensor mode
		enumeration and selection. (Default: false)

	- delayed_gain: Whether gain settings should be offset by one frame to
		be in sync w/ exposure settings (takes effect on n+2 frame).
		 (Default: false)
	- use_decibel_gain: Whether to convert gain to dB units before passing
		to driver. (Default: false)
	- post_crop_frame_drop: Number of frames to silently discard following
		application of crop settings, as the initial ones may be
		corrupted. (Default: 0)
	- limit_analog_gain: Enable as a WAR to prevent banding for the IMX185
		sensor. (Default: false)

	- nvidia,gmsl-ser-device: MIPI CSI-2 serializer device node.
	- nvidia,gmsl-dser-device: MIPI CSI-2 deserializer device node.

Deprecated properties:
	- devnode: Name of V4L2 character device in filesystem, this property is
		now deprecated, the Tegra Camera Framework enumerates them
		automatically.
	- dovdd-supply: Digital I/O power source (1.80 V), should use vif-supply
		for new drivers.

Example:

	imx204@0 {
		compatible = "sony,imx204";
		reg = <0>;
		spi-max-frequency = <12000000>;

		/* Physical dimensions of sensor */
		physical_w = "4.713";
		physical_h = "3.494";

		/* enable delay gain due to no hardware group hold support */
		delayed_gain = "true";

		/* Define any required hw resources needed by driver */
		/* ie, clocks, io pins, power sources */
		/* mclk = "cam_mclk1"; Not in use. */
		devname = "imx204";

		/* Sensor Model */
		sensor_model = "imx204";

		focus_macro = "100";
		focus_infinity = "208";
		focus_max_slew_rate = "180";
		min_aperture = "2";
		max_aperture = "90";
		min_aperture_fnumber = "2000";
		max_aperture_fnumber = "22000";
		aperture_max_slew_rate = "180";
		/* <FNumber*1000 motor-pos> */
		fnumber_map = <2000 2>, <2800 34>, <4000 49>, <5600 59>,
			<8000 67>, <11000 71>, <16000 75>, <22000 78>;
	};

	/* Camera board-specific config overlay */
	imx204@0 {
		reset-gpios = <&tegra_main_gpio SLVS_CAM0_RST_L GPIO_ACTIVE_HIGH>;
	};
```

## kernel/nvidia/Documentation/devicetree/bindings/media/tegra-camera-framework.txt
```
NVIDIA Tegra Camera Framework (TCF) bindings

The Tegra Camera Framework (TCF) is a kernel API for digital image sensor
drivers to register and interface with the V4L2 Framework on Tegra SOC
platforms. User-mode applications may directly request raw (e.g. bayer, YUV)
frame captures through sysfs device nodes enumerated in the /dev/videoXY.

Using the V4L2 CIDs, sensor programming is abstracted; they enable automatic
power and clocks control, resolution and mode selection, and sensor gain,
exposure and frame rate programming (for 3A).

Supported sources include: MIPI CSI-2 (via Tegra NVCSI, incl. TPGs), SLVS-EC
(via Tegra SLVS-EC, T19x only), NVIDIA VIVID and other V4L2 devices (e.g.
webcams).

== Sensor Modes ==

Enumerated sensor modes are initial platform configuration and properties of the
data to be received from the sensor. Frame sizes, data types, clocks and
physical input streams are fixed; but frame rates, exposure times and gain may
be varied.

For source control settings (gain, framerate, exposure), the ranges are given
as fixed-point integer literal values, at 1 s = 1,000,000 us resolution; this is
done to preserve precision in floating-point calculations.

Modes are enumerated as mode<0..N-1> in the base of sensors' Device Tree nodes.

Required properties:
	- mclk_khz: Rate of the MIPI clock (aka. INCK) driven from the Tegra SoC
		[kHz].
	- num_lanes: Number of D-Phy lanes or C-Phy trios.
	- tegra_sinterface: The NVCSI port, enumerated from "serial_<A-E>"
		(<T19x) and "serial<A-H>" (>=T19x).
	- phy_mode: The MIPI CSI-2 PHY mode; "DPHY" or "CPHY"; or "SLVS" for
		Sony SLVS-EC.
	- discontinuous_clk: Whether the D-Phy clock is discontinuous; "yes" or
		"no".
	- dpcm_enable: Whether DPCM compression is enabled; "true" or "false".

	- active_width: Horizontal width of the valid image surface [px].
	- active_height: Vertical height of the valid image surface [px].
	- mode_type: Pixel readout format; usually "bayer".
	- pixel_phase: Pixel arrangment, usually "rggb" or variation.
	- csi_pixel_bit_depth: Pixel bit depth [bit].
	- readout_orientation: Rotations of the image surface performed by the
		sensor; specified as {"90", "180", "270"}.
	- line_length: Length of pixel line [px].
	- inherent_gain: Sensor inherent gain, usually "1".
	- mclk_multiplier: Factor, pix_clk_hz / (mclk_khz * 1000).
	- pix_clk_hz: Pixel rate from the sensor [Hz].

	Source Control Settings:
	- gain_factor: Integer conversion factor, set to "1000000".
	- min_gain_val: Minimum gain [dB] = min_gain_val / gain_factor.
	- max_gain_val: Maximum gain [dB] = max_gain_val / gain_factor.
	- step_gain_val: Smallest gain to vary [dB] = step_gain_val /
		gain_factor.
	- default_gain: Default gain [dB]; recommended to match min_gain_val for
		optimal results.
	- framerate_factor: Integer conversion factor, set to "1000000".
	- min_framerate: Minimum framerate [fps] = min_framerate /
		framerate_factor.
	- max_framerate: Maximum framerate [fps] = max_framerate /
		framerate_factor.
	- step_framerate: Smallest framerate to vary [fps] =
		step_framerate / framerate_factor.
	- default_framerate: Default framerate [fps]; recommended to match
		max_framerate for optimal results.
	- exposure_factor: Integer conversion factor, set to "1000000".
	- min_exp_time: Minimum exposure [us] = min_exp_time / exposure_factor.
	- max_exp_time: Maximum exposure [us] = max_exp_time / exposure_factor.
	- step_exp_val: Smallest exposure to vary [us] =
		step_exp_time / exposure_factor.
	- default_exp_time: Default exposure [us]; recommended to match
		min_exp_time for optimal results.

	- embedded_metadata_height: The number of extra lines in each frame
		containing metadata (not counted in active_height).

Optional properties:
	Wide Dynamic Range (WDR) settings:
	- min_hdr_ratio: Minimum HDR ratio.
	- max_hdr_ratio: Maximum HDR ratio.
	- num_of_exposure: Number of exposures [frame].
	- num_of_ignored_lines: Cropping use, number of ignored lines [line].
	- num_of_lines_offset_0: Cropping use, vertical blanking before short
		exposure data [line].
	- num_of_ignored_pixels: Cropping use, length of line info [px].
	- num_of_left_margin_pixels: Cropping use, left margin before active
		pixels area (after num_of_ignored_pixels).
	- num_of_right_margin_pixels: Cropping use, right margin after active
		pixels area.

Example:

	imx274_a@1a {
		...

		mode0 {
			mclk_khz = "24000";
			num_lanes = "4";
			tegra_sinterface = "serial_a";
			phy_mode = "DPHY";
			discontinuous_clk = "yes";
			dpcm_enable = "false";
			cil_settletime = "0";

			active_w = "3840";
			active_h = "2160";
			mode_type = "bayer";
			pixel_phase = "rggb";
			csi_pixel_bit_depth = "10";
			readout_orientation = "0";
			line_length = "4208";
			inherent_gain = "1";
			mclk_multiplier = "24";
			pix_clk_hz = "576000000";

			gain_factor = "1000000";
			min_gain_val = "1000000";
			max_gain_val = "44400000";
			step_gain_val = "1";
			default_gain = "1000000";
			min_hdr_ratio = "1";
			max_hdr_ratio = "1";
			framerate_factor = "1000000";
			min_framerate = "1500000";
			max_framerate = "60000000";
			step_framerate = "1";
			default_framerate= "60000000";
			exposure_factor = "1000000";
			min_exp_time = "44";
			max_exp_time = "478696";
			step_exp_time = "1";
			default_exp_time = "16667";
			embedded_metadata_height = "1";
		};
		mode1 {
			...
		};
	}

== Tegra Camera Platform ==

This node provides the complete system view of camera resources, it is used for
bandwidth and clock allocation, and user-space applications (e.g. NVIDIA PCL).

A module is a unit camera package, it is further subdivided into drivernodes,
which are image sensors, lenses and focusers.

If available, a custom lens property may be created to provide the camera
package metadata to user-space applications. The path to this structure is
specified as a "v4l2_lens" drivernode under modules.

Required properties:
	compatible: Should be "nvidia, tegra-camera-platform".
	num_csi_lanes: Total number of concurrent NVCSI lanes.
	max_lane_speed = Maximum D-Phy or C-Phy lane data rate [kb/s].
	min_bits_per_pixel: Minimum pixel bit depth [bit].
	vi_peak_byte_per_pixel: Maximum data packets to VI per pixel [byte].
	vi_bw_margin_pct: VI bandwidth margin [pct], concurrent use.

	max_pixel_rate = Maximum ISP processing rate [kPx/s], concurrent use.
	isp_peak_byte_per_pixel: Maximum data packets to ISP per pixel [byte].
	isp_bw_margin_pct: ISP bandwidth margin [pct], concurrent use.

	-- Modules (modules) --
	badge: String use for matching camera module to ISP program configuration,
		"<sensor_model>_" + "<position>_" + "<six-char package model>".
	position: Camera position on device; {"rear", "front", "bottom", "top",
		"center", "topleft", "topright, "centerleft", "centerright",
		"bottomleft", "bottomright", "<0-5>"}.
	orientation: Camera rotation; multiplier of 90 degrees; {"1", "2", "3"}.

	-- Driver Nodes (drivernodeXY) --
	pcl_id: PCL device class; {"v4l2_sensor", "v4l2_lens", ...}.
	devname: Sensors only, V4L2 device name string; "<sensor_model> 3" +
		"<0-9, sensor index>" + "-00" + "<sensor I2C addr.>".
	proc-device-tree: Full path to the sensor Device Tree node in the
		filesystem.

Optional properties:
	-- Camera Package Lens --
	min_focus_distance: Minimum focus distance [mm].
	hyper_focal: Hyper-focal distance at infinity [mm].
	focal_length: Focal length [mm].
	f_number: Aperture integer literal [f-stop].
	aperture: Aperture decimal literal [f-stop].

Example:

	tegra-camera-platform { {
		compatible = "nvidia, tegra-camera-platform";

		num_csi_lanes = <8>;
		max_lane_speed = <1500000>;
		min_bits_per_pixel = <10>;
		vi_peak_byte_per_pixel = <2>;
		vi_bw_margin_pct = <25>;
		max_pixel_rate = <750000>;
		isp_peak_byte_per_pixel = <5>;
		isp_bw_margin_pct = <25>;

		modules {
			module0 {
				badge = "imx274_bottom_A6V26";
				position = "bottom";
				orientation = "1";
				drivernode0 {
					/* Declare PCL support driver (classically known as guid)  */
					pcl_id = "v4l2_sensor";
					/* Driver v4l2 device name */
					devname = "imx274 30-001a";
					/* Declare the device-tree hierarchy to driver instance */
					proc-device-tree = "/proc/device-tree/i2c@3180000/tca9546@70/i2c@0/imx274_a@1a";
				};
				drivernode1 {
					/* Declare PCL support driver (classically known as guid)  */
					pcl_id = "v4l2_lens";
					proc-device-tree = "/proc/device-tree/lens_imx274@A6V26/";
				};
			};
		}
	}

	lens_imx274@A6V26 {
		min_focus_distance = "0.0";
		hyper_focal = "0.0";
		focal_length = "5.00";
		f_number = "2.0";
		aperture = "2.2";
	};
```
