## kernel/avt/drivers/media/i2c/Kconfig
```kconfig
if VIDEO_V4L2

menu "Allied Vision Drivers"
	visible if !MEDIA_SUBDRV_AUTOSELECT || COMPILE_TEST

config VIDEO_AVT_CSI2
	tristate "Allied Vision CSI2 camera support"
	depends on I2C && VIDEO_V4L2 && VIDEO_V4L2_SUBDEV_API
	help
	  This is a Video4Linux2 sensor-level driver for Allied Vision camera.

	  To compile this driver as a module, choose M here: the
	  module will be called avt_csi2.

endmenu

endif
```

## kernel/kernel-5.10/Documentation/devicetree/bindings/ata/nvidia,tegra124-ahci.txt
```
Tegra SoC SATA AHCI controller

Required properties :
- compatible : Must be one of:
  - Tegra124 : "nvidia,tegra124-ahci"
  - Tegra132 : "nvidia,tegra132-ahci", "nvidia,tegra124-ahci"
  - Tegra210 : "nvidia,tegra210-ahci"
- reg : Should contain 2 entries:
  - AHCI register set (SATA BAR5)
  - SATA register set
- interrupts : Defines the interrupt used by SATA
- clocks : Must contain an entry for each entry in clock-names.
  See ../clocks/clock-bindings.txt for details.
- clock-names : Must include the following entries:
  - sata
  - sata-oob
- resets : Must contain an entry for each entry in reset-names.
  - pll_e
  See ../reset/reset.txt for details.
- reset-names : Must include the following entries:
  - sata
  - sata-oob
  - sata-cold
- phys : Must contain an entry for each entry in phy-names.
  See ../phy/phy-bindings.txt for details.
- phy-names : Must include the following entries:
  - For Tegra124 and Tegra132:
    - sata-phy : XUSB PADCTL SATA PHY
- For Tegra124 and Tegra132:
  - target-5v-supply : Defines the SATA 5V power regulator
  - target-12v-supply : Defines the SATA 12V power regulator
- nvidia,disable-features : Defines features to be disabled
 - devslp
 - hipm
 - dipm
 - slumber
 - partial
 - ncq
- nvidia,link-flags : Defines link flags
 - max_power
 - min_power
 - med_power
- pinctrl-names : Define pinctrls for devslp pin
 - pinctrl-0: the pincontrol settings to configure devslp pin
 - pinctrl-1: the pincontrol settings to place devslp pin in pull up state
Optional properties:
- reg :
  - AUX register set
- clock-names :
  - cml1 :
    cml1 clock should be defined here if the PHY driver
    doesn't manage them. If it does, they should not be.
- phy-names :
  - For T210:
    - sata-phy
```

## kernel/kernel-5.10/Documentation/devicetree/bindings/bus/nvidia,tegra210-aconnect.yaml
```yaml
# SPDX-License-Identifier: (GPL-2.0)
%YAML 1.2
---
$id: http://devicetree.org/schemas/sound/nvidia,tegra210-aconnect.yaml#
$schema: http://devicetree.org/meta-schemas/core.yaml#

title: NVIDIA Tegra ACONNECT Bus DT bindings

description: The Tegra ACONNECT bus is an AXI switch which is used to connnect
  various components inside the Audio Processing Engine (APE). All CPU accesses
  to the APE subsystem go through the ACONNECT via an APB to AXI wrapper. All
  devices accessed via the ACONNNECT are described by child-nodes.

maintainers:
  - Thierry Reding <treding@nvidia.com>
  - Jonathan Hunter <jonathanh@nvidia.com>
  - Sameer Pujar <spujar@nvidia.com>
  - Mohan Kumar D <mkumard@nvidia.com>

properties:
  compatible: Must be "nvidia,tegra210-aconnect"

  clocks:
    - items:
        description: APE clock
    - items:
        description: APE interface clock

  clock-names:
    - items:
        const: ape
    - items:
        const: apb2ape

  power-domains:
    description: Must contain a phandle that points to the audio powergate

  "#address-cells":
    description: The number of cells used to represent physical base addresses
      in the aconnect address space. Should be 1.

  "#size-cells":
    description: The number of cells used to represent the size of an address
      range in the aconnect address space. Should be 1.

  ranges:
    description: Mapping of the aconnect address space to the CPU address space.

required:
  - compatible
  - clocks
  - clock-names
  - power-domains
  - "#address-cells"
  - "size-cells"
  - ranges

examples:

  - |
    aconnect@702c0000 {
        compatible = "nvidia,tegra210-aconnect";
        clocks = <&tegra_car TEGRA210_CLK_APE>,
                 <&tegra_car TEGRA210_CLK_APB2APE>;
        clock-names = "ape", "apb2ape";
        power-domains = <&pd_audio>;

        #address-cells = <1>;
        #size-cells = <1>;
        ranges = <0x702c0000 0x0 0x702c0000 0x00040000>;

        child1 {
            ...
        };

        child2 {
            ...
        };
    };

...
```

## kernel/kernel-5.10/Documentation/devicetree/bindings/dma/nvidia,tegra186-gpcdma.txt
```
Tegra GPCDMA controller.

Tegra GPCDMA controller is a general purpose dma used by multiple slave
devices for faster transfers. It can support mem to mem, mem to io and
io to mem transfers.

Required properties :
- compatible :
  For Tegra186, must contain "nvidia,tegra186-gpcdma".
  For Tegra194, must contain "nvidia,tegra194-gpcdma".
- reg : Should contain gpcdma reg offset location and length.
- interrupts : Should contain list of interrupts for all channels.
- resets : Must contain handle for each entry in reset-names.
  See ../reset/reset.txt for details.
- reset-names : Must include "gpcdma".

Optional properties:
- iommus : A reference to the IOMMU. See ../iommu/iommu.txt for details.

Example :
gpcdma: dma@2600000 {
	compatible = "nvidia,tegra186-gpcdma";
	reg = <0x0 0x2600000 0x0 0x210000>;
	resets = <&bpmp TEGRA186_RESET_GPCDMA>;
	reset-names = "gpcdma";
	interrupts = <0 75 0x04
		      0 76 0x04
		      0 77 0x04
		      0 78 0x04
		      0 79 0x04
		      0 80 0x04
		      0 81 0x04
		      0 82 0x04
		      0 83 0x04
		      0 84 0x04
		      0 85 0x04
		      0 86 0x04
		      0 87 0x04
		      0 88 0x04
		      0 89 0x04
		      0 90 0x04
		      0 91 0x04
		      0 92 0x04
		      0 93 0x04
		      0 94 0x04
		      0 95 0x04
		      0 96 0x04
		      0 97 0x04
		      0 98 0x04
		      0 99 0x04
		      0 100 0x04
		      0 101 0x04
		      0 102 0x04
		      0 103 0x04
		      0 104 0x04
		      0 105 0x04
		      0 106 0x04
		      0 107 0x04>;
	iommus = <&smmu TEGRA_SID_GPCDMA_0>;
};
```

## kernel/kernel-5.10/Documentation/devicetree/bindings/dma/nvidia,tegra210-adma.yaml
```yaml
# SPDX-License-Identifier: (GPL-2.0)
%YAML 1.2
---
$id: http://devicetree.org/schemas/sound/nvidia,tegra210-adma.yaml#
$schema: http://devicetree.org/meta-schemas/core.yaml#

title: NVIDIA Tegra Audio DMA (ADMA) controller DT bindings

description:
  The Tegra Audio DMA controller that is used for transferring data
  between system memory and the Audio Processing Engine (APE).

maintainers:
  - Thierry Reding <treding@nvidia.com>
  - Jonathan Hunter <jonathanh@nvidia.com>
  - Sameer Pujar <spujar@nvidia.com>
  - Mohan Kumar D <mkumard@nvidia.com>

properties:
  compatible:
    oneOf:
      - items:
          description: for Tegra210 based platforms
          const: "nvidia,tegra210-adma"
      - items:
          description: for Tegra186 based platforms
          const: "nvidia,tegra186-adma"
      - items:
          description: for Tegra194 based platforms
          const: "nvidia,tegra194-adma"

  reg:
    description: Should contain DMA registers location and length. This should
      be a single entry that includes all of the per-channel registers in one
      contiguous bank.

  interrupt-parent:
    description: Phandle to the interrupt parent controller.

  interrupts:
    description: Should contain all of the per-channel DMA interrupts in
      ascending order with respect to the DMA channel index.

  clocks:
    description: Must contain one entry for the ADMA module clock

  clock-names:
    description: d_audio

  "#dma-cells":
    description: The first cell denotes the receive/transmit request number and
      should be between 1 and the maximum number of requests supported. This
      value corresponds to the RX/TX_REQUEST_SELECT fields in the ADMA_CHn_CTRL
      register.
    const: 1

required:
  - compatible
  - reg
  - interrupt-parent
  - interrupts
  - clocks
  - clock-names
  - "#dma-cells"

examples:

  - |
    adma: dma@702e2000 {
        compatible = "nvidia,tegra210-adma";
        reg = <0x0 0x702e2000 0x0 0x2000>;
        interrupt-parent = <&tegra_agic>;
        interrupts = <GIC_SPI 24 IRQ_TYPE_LEVEL_HIGH>,
                     <GIC_SPI 25 IRQ_TYPE_LEVEL_HIGH>,
                     <GIC_SPI 26 IRQ_TYPE_LEVEL_HIGH>,
                     <GIC_SPI 27 IRQ_TYPE_LEVEL_HIGH>,
                     <GIC_SPI 28 IRQ_TYPE_LEVEL_HIGH>,
                     <GIC_SPI 29 IRQ_TYPE_LEVEL_HIGH>,
                     <GIC_SPI 30 IRQ_TYPE_LEVEL_HIGH>,
                     <GIC_SPI 31 IRQ_TYPE_LEVEL_HIGH>,
                     <GIC_SPI 32 IRQ_TYPE_LEVEL_HIGH>,
                     <GIC_SPI 33 IRQ_TYPE_LEVEL_HIGH>,
                     <GIC_SPI 34 IRQ_TYPE_LEVEL_HIGH>,
                     <GIC_SPI 35 IRQ_TYPE_LEVEL_HIGH>,
                     <GIC_SPI 36 IRQ_TYPE_LEVEL_HIGH>,
                     <GIC_SPI 37 IRQ_TYPE_LEVEL_HIGH>,
                     <GIC_SPI 38 IRQ_TYPE_LEVEL_HIGH>,
                     <GIC_SPI 39 IRQ_TYPE_LEVEL_HIGH>,
                     <GIC_SPI 40 IRQ_TYPE_LEVEL_HIGH>,
                     <GIC_SPI 41 IRQ_TYPE_LEVEL_HIGH>,
                     <GIC_SPI 42 IRQ_TYPE_LEVEL_HIGH>,
                     <GIC_SPI 43 IRQ_TYPE_LEVEL_HIGH>,
                     <GIC_SPI 44 IRQ_TYPE_LEVEL_HIGH>,
                     <GIC_SPI 45 IRQ_TYPE_LEVEL_HIGH>;
        clocks = <&tegra_car TEGRA210_CLK_D_AUDIO>;
        clock-names = "d_audio";
        #dma-cells = <1>;
    };

...
```

## kernel/kernel-5.10/Documentation/devicetree/bindings/fuse/nvidia,tegra186-efuse.txt
```
Tegra Fuse controller

Tegra Fuse controller driver reads fuse registers of chip.

Required properties :
- compatible: Each chip has different spare reg offset and length.
  Must be one of these :
  - For Tegra186, "nvidia,tegra186-efuse",
  - For Tegra194, "nvidia,tegra194-efuse",
  - For Tegra210, "nvidia,tegra210-efuse".
- reg : Fuse controller registers location and length.
- clocks : Handle for Tegra Fuse controller clock.
- clock-names : contains fuse controller clock name "fuse".

Optional properties :
- nvidia,clock-always-on : controller clock turned on at boot and remains on.

Example:
	efuse@3820000 {
		compatible = "nvidia,tegra186-efuse";
		reg = <0x0 0x03820000 0x0 0x600>;
		clocks = <&tegra_car TEGRA186_CLK_FUSE>;
		clock-names = "fuse";
		nvidia,clock-always-on;
		status = "disabled";
	};
```

## kernel/kernel-5.10/Documentation/devicetree/bindings/gpu/nvidia,gv11b-vpgu.txt
```
NVIDIA Tegra Graphics Processing Units - Virtualized

Required properties:
- compatible: "nvidia,<soc>-<gpu>-vpgu" or "nvidia,<gpu>-vgpu"
  "nvidia,<soc>-<gpu>-vgpu" means the GPU support for a specific SOC.
  "nvidia,<gpu>-vgpu" means the GPU support on any chip.
  Currently recognized values:
  - nvidia,tegra186-gp10b-vgpu
  - nvidia,gv11b-vgpu
- reg: Physical base address and length of the controller's BAR0 registers.
- reg-names: Must contain "usermode"
- ivc-queue3: Command IVC queue number.
- ivc-queue4: Notification IVC queue number.
- mempool3: Memory pool for command IVC queue.
- mempool-css: Mempool for cyclestats snapshot image.
- mempool-fecs-trace: Memory pool for FECS traces image.

Optional properties:
- nvidia,host1x: host1x device, needed for syncpoint support.

Example for GV11B

	vgpu {
	        compatible = "nvidia,gv11b-vgpu";
	        reg = <0x0 0x17810000 0x0 0x10000>;
	        reg-names = "usermode";
	        nvidia,host1x = <&host1x>;
	        status = "okay";
	        ivc-queue3 = <&tegra_hv 44>;
	        ivc-queue4 = <&tegra_hv 45>;
	        mempool3 = <&tegra_hv 0>;
	        mempool-css = <&tegra_hv 1>;
	        mempool-fecs-trace = <&tegra_hv 2>;
	};
```

## kernel/kernel-5.10/Documentation/devicetree/bindings/gpu/nvidia,gv11b.txt
```
NVIDIA Tegra Graphics Processing Units

Required properties:
- compatible: "nvidia,<soc>-<gpu>" or "nvidia,<gpu>"
  "nvidia,<soc>-<gpu>" means the GPU support for a specific SOC.
  "nvidia,<gpu>" means the GPU support on any chip.
  Currently recognized values:
  - nvidia,tegra210-gm20b
  - nvidia,tegra186-gp10b
  - nvidia,gv11b
- reg: Physical base address and length of the controller's registers.
  Must contain two entries:
  - first entry for bar0
  - second entry for bar1
  An optional third entry is used only in case of simulation.
- interrupts: Must contain an entry for each entry in interrupt-names.
  See ../interrupt-controller/interrupts.txt for details.
- interrupt-names: Must include the following entries:
  - stall
  - nonstall
- vdd-supply: regulator for supply voltage. Only required for GPUs not using
  power domains.
- clocks: Must contain an entry for each entry in clock-names.
  See ../clocks/clock-bindings.txt for details.
- clock-names: Must include the following entries:
  - gpu
  - pwr
- resets: Must contain an entry for each entry in reset-names.
  See ../reset/reset.txt for details.
- reset-names: Must include the following entries:
  - gpu
- power-domains: GPUs that make use of power domains can define this property
  instead of vdd-supply.

Optional properties:
- dma-coherent : Present if DMA operations are coherent.
- iommus: A reference to the IOMMU. See ../iommu/iommu.txt for details.
- access-vpr-phys: If GPU has access to VPR.
- nvidia,host1x: host1x device, needed for syncpoint support.
- fuse-overrides: Allow overriding defaults fuses values for
  GM20B_FUSE_OPT_TPC_DISABLE,
  GP10B_FUSE_OPT_ECC_EN,
  GV11B_FUSE_OPT_TPC_DISABLE
- support-gpu-tools: Controls the support for debug tools like profiler,
  debugger and feature like CTXSW tracing. Value of 0 indicates that the
  above debug tools are not supported. Any value other than 0 indicates
  that the driver support for above debug tools is enabled. The debug
  tools support is enabled by default, even if the property is missing
  in the GPU DT node.

Example for GP10B:

        gp10b {
                compatible = "nvidia,tegra186-gp10b";
                reg = <0x0 0x17000000 0x0 0x1000000
                       0x0 0x18000000 0x0 0x1000000
                       0x0 0x03b41000 0x0 0x00001000>;
                interrupts = <0 70 0x04
                              0 71 0x04>;
                interrupt-names = "stall", "nonstall";
                nvidia,host1x = <&host1x>;
                iommus = <&smmu TEGRA_SID_GPUB>;
                access-vpr-phys;
                resets = <&tegra_car TEGRA186_RESET_GPU>;
                clocks = <&tegra_car TEGRA186_CLK_GPCCLK>,
                        <&tegra_car TEGRA186_CLK_GPU>;
                clock-names = "gpu", "gpu_sys";
                fuse-overrides = <GP10B_FUSE_OPT_ECC_EN 0x9999>;
        };

Example for GV11B:

        gv11b {
                compatible = "nvidia,gv11b";
                reg = <0x0 0x17000000 0x0 0x1000000
                       0x0 0x18000000 0x0 0x1000000
                       0x0 0x03b41000 0x0 0x00001000>;
                interrupts = <0 70 0x04
                              0 71 0x04>;
                interrupt-names = "stall", "nonstall";
                nvidia,host1x = <&host1x>;
                access-vpr-phys;
                clocks = <&bpmp_clks TEGRA194_CLK_GPCCLK>,
                        <&bpmp_clks TEGRA194_CLK_GPU_PWR>;
                clock-names = "gpu", "gpu_sys";
                resets = <&bpmp_resets TEGRA194_RESET_GPU>;
                dma-coherent;
                support-gpu-tools = <1>;
        };
```
