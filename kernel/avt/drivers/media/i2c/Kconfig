## kernel/kernel-5.10/Documentation/devicetree/bindings/media/gpio-ir-receiver.txt
```
Device-Tree bindings for GPIO IR receiver

Required properties:
	- compatible: should be "gpio-ir-receiver".
	- gpios: specifies GPIO used for IR signal reception.

Optional properties:
	- linux,rc-map-name: see rc.txt file in the same
	  directory.
	- linux,autosuspend-period: autosuspend delay time,
	  the unit is milisecond.
	- min-delay: minimum delay(ms) to send IR event reset for raw IR decoding.
	- allowed-protos: 64 bit integer, platform specific allowed
			  IR protocols.

Example node:

	ir: ir-receiver {
		compatible = "gpio-ir-receiver";
		gpios = <&gpio0 19 1>;
		min-delay = <500>;
		linux,rc-map-name = "rc-rc6-mce";
		linux,autosuspend-period = <125>;
		allowed-protos = <0x00000000 0x00000080>;
	};
```

## kernel/kernel-5.10/Documentation/devicetree/bindings/phy/phy-tegra194-p2u.txt
```
NVIDIA Tegra194 & Tegra234 P2U binding

Tegra194 has two PHY bricks namely HSIO (High Speed IO) and NVHS (NVIDIA High
Speed) each interfacing with 12 and 8 P2U instances respectively.
Tegra234 has three PHY bricks namely HSIO (High Speed IO) and NVHS (NVIDIA High
Speed) and GBE (Gigabit Ethernet) each interfacing with 8 P2U instances
respectively.
A P2U instance is a glue logic between Synopsys DesignWare Core PCIe IP's PIPE
interface and PHY of HSIO/NVHS/GBE bricks. Each P2U instance represents one PCIe
lane.

Required properties:
- compatible: For Tegra19x, must contain "nvidia,tegra194-p2u".
	      For Tegra23x, must contain "nvidia,tegra234-p2u".
- reg: Should be the physical address space and length of respective each P2U
       instance.
- reg-names: Must include the entry "ctl".

Optional properties:
- nvidia,skip-sz-protect-en: This is a boolean property and needs to be present
    if the platform is using SRNS clocking configuration and the number of
    retimers present between root port and endpoint are two.
    This is applicable only for T234 and not for T194 as it doesn't
    support SRNS configuration. In T234 also, it is applicable only for the
    two retimers case and not for the single retimer case.

Required properties for PHY port node:
- #phy-cells: Defined by generic PHY bindings.  Must be 0.

Refer to phy/phy-bindings.txt for the generic PHY binding properties.

Example:

p2u_hsio_0: phy@3e10000 {
	compatible = "nvidia,tegra194-p2u";
	reg = <0x03e10000 0x10000>;
	reg-names = "ctl";

	#phy-cells = <0>;
};
```

## kernel/kernel-5.10/Documentation/devicetree/bindings/pwm/nvidia,tegra210-pmc-blink-pwm.txt
```
Tegra pmc blink pwm

Pwm device used for pmc blink.

Required properties:
- compatible: nvidia,tegra210-pmc-blink-pwm

Example:
	tegra-pmc-blink-pwm {
		compatible = "nvidia,tegra210-pmc-blink-pwm";
		status = "disabled";
	};
```

## kernel/kernel-5.10/Documentation/devicetree/bindings/soc/nvidia/nvidia,tegra186-pmc-iopower.txt
```
NVIDIA Tegra Power Management Controller power settings

Program io pads matching with power regulators.

Required properties:
- compatible: should be nvidia,tegra186-pmc-iopower.
- pad-controllers: list of io pad controllers.
- pad-names: matching names to pad controllers.

Optional properties:
- nvidia,auto-pad-voltage-config: program pad voltage for respective pads.

Example:
	tegra_pmc_iopower: pmc-iopower {
		compatible = "nvidia,tegra186-pmc-iopower";
		pad-controllers = <&tegra_pmc TEGRA_IO_PAD_GROUP_UFS
					TEGRA_IO_PAD_GROUP_DBG
					TEGRA_IO_PAD_GROUP_SPI
					TEGRA_IO_PAD_GROUP_AUDIO_HV
					TEGRA_IO_PAD_GROUP_AO_HV
					TEGRA_IO_PAD_GROUP_DMIC_HV
					TEGRA_IO_PAD_GROUP_SDMMC1_HV
					TEGRA_IO_PAD_GROUP_SDMMC2_HV
					TEGRA_IO_PAD_GROUP_SDMMC3_HV
					TEGRA_IO_PAD_GROUP_DSI
					TEGRA_IO_PAD_GROUP_DSIB
					TEGRA_IO_PAD_GROUP_DSIC
					TEGRA_IO_PAD_GROUP_DSID
					TEGRA_IO_PAD_GROUP_HDMI_DP0
					TEGRA_IO_PAD_GROUP_HDMI_DP1>;
		pad-names = "ufs", "dbg", "spi", "audio-hv", "ao-hv",
				"dmic-hv", "sdmmc1-hv", "sdmmc2-hv", "sdmmc3-hv",
				"dsia", "dsib", "dsic", "dsid", "hdmi-dp0", "hdmi-dp1";
		status = "disabled";
	};
```

## kernel/kernel-5.10/Documentation/devicetree/bindings/soc/nvidia/nvidia,tegra194-aowake.txt
```
Tegra always on wake registers wrapper

Wrapper for Tegra AON wake regisers.

Required properties:
- compatible: should be
  "nvidia,tegra186-aowake" for Tegra186,
  "nvidia,tegra194-aowake" for Tegra194.
- reg: base address and length of Tegra aon wake registers.

Optional properties:
- nvidia,invert-pmic-interrupt-polarity: invert pmic interrupt polarity.
- nvidia,invert-interrupt: invert aon wake interrupt polarity.

Example:
aowake: pmc@c370000 {
		compatible = "nvidia,tegra194-aowake";
		reg = <0x0 0xc370000 0x0 0x600>;
		status = "disabled";
}
```

## kernel/kernel-5.10/Documentation/devicetree/bindings/sound/nvidia,tegra186-arad.yaml
```yaml
# SPDX-License-Identifier: (GPL-2.0)
%YAML 1.2
---
$id: http://devicetree.org/schemas/sound/nvidia,tegra186-arad.yaml#
$schema: http://devicetree.org/meta-schemas/core.yaml#

title: NVIDIA Tegra186 Audio Ratio Detector (ARAD) DT Bindings

description: |
  ARAD has several lanes, each of which has the capacity to find the frequency
  or time period ratio between any two of the I/O clocks in APE. This has many
  applications including sample rate conversions without software configuration
  of the ratio, ppm compensation.

maintainers:
  - Jonathan Hunter <jonathanh@nvidia.com>
  - Sameer Pujar <spujar@nvidia.com>
  - Mohan Kumar D <mkumard@nvidia.com>

properties:
  compatible:
    oneOf:
      - items:
          description: for Tegra186 based platforms
          const: "nvidia,tegra186-arad"
      - items:
          description: for Tegra194 based platforms
          const: "nvidia,tegra194-arad", "nvidia,tegra186-arad"

  reg:
    maxItems: 1
    description: Must contain physical base address and length of device's
      registers

  "#sound-dai-cells":
    description: The cell specifies number of DAIs.
    const: 1

  nvidia,ahub-arad-id:
    description: must be specified to uniquely identify ARAD instance.

required:
  - compatible
  - reg
  - "#sound-dai-cells"
  - nvidia,ahub-arad-id

examples:
  - |
    arad@290e400 {
        compatible = "nvidia,tegra186-arad";
        reg = <0x0 0x290e400 0x0 0x400>;
        nvidia,ahub-arad-id = <0>;
        #sound-dai-cells = <1>;
    };

  - |
    arad@290e400 {
        compatible = "nvidia,tegra194-arad", "nvidia,tegra186-arad";
        reg = <0x0 0x290e400 0x0 0x400>;
        nvidia,ahub-arad-id = <0>;
        #sound-dai-cells = <1>;
    };

...
```

## kernel/kernel-5.10/Documentation/devicetree/bindings/sound/nvidia,tegra186-asrc.yaml
```yaml
# SPDX-License-Identifier: (GPL-2.0)
%YAML 1.2
---
$id: http://devicetree.org/schemas/sound/nvidia,tegra186-asrc.yaml#
$schema: http://devicetree.org/meta-schemas/core.yaml#

title: NVIDIA Tegra186 Arbitrary Sample Rate Converter (ASRC) DT Bindings

description: |
  Audio systems may require high fidelity sample rate conversion. The sample
  rate may not be known at the stream setup time or is potentially time varying.
  In addition, ratio between input and output sample rate can be any arbitray
  number and input/output clocks can be derived from the asynchronous clocks.
  For such scenarios ASRC is required. It can handle wide range of sample rate
  ratios 1:24 or 24:1.

maintainers:
  - Jonathan Hunter <jonathanh@nvidia.com>
  - Sameer Pujar <spujar@nvidia.com>
  - Mohan Kumar D <mkumard@nvidia.com>

properties:
  compatible:
    oneOf:
      - items:
          description: for Tegra186 based platforms
          const: "nvidia,tegra186-asrc"
      - items:
          description: for Tegra194 based platforms
          const: "nvidia,tegra194-asrc", "nvidia,tegra186-asrc"

  reg:
    maxItems: 1
    description: Must contain physical base address and length of device's
      registers

  "#sound-dai-cells":
    description: The cell specifies number of DAIs.
    const: 1

  nvidia,ahub-asrc-id:
    description: Must be specified to uniquely identify ASRC instance.

required:
  - compatible
  - reg
  - "#sound-dai-cells"
  - nvidia,ahub-asrc-id

examples:
  - |
    asrc@2910000 {
        compatible = "nvidia,tegra186-asrc";
        reg = <0x0 0x2910000 0x0 0x2000>;
        #sound-dai-cells = <1>;
        nvidia,ahub-asrc-id = <0>;
    };

  - |
    asrc@2910000 {
        compatible = "nvidia,tegra194-asrc", "nvidia,tegra186-asrc";
        reg = <0x0 0x2910000 0x0 0x2000>;
        #sound-dai-cells = <1>;
        nvidia,ahub-asrc-id = <0>;
    };

...
```

## kernel/kernel-5.10/Documentation/devicetree/bindings/sound/nvidia,tegra210-adx.yaml
```yaml
# SPDX-License-Identifier: (GPL-2.0)
%YAML 1.2
---
$id: http://devicetree.org/schemas/sound/nvidia,tegra210-adx.yaml#
$schema: http://devicetree.org/meta-schemas/core.yaml#

title: NVIDIA Tegra210 Audio Demultiplexer (ADX) DT Bindings

description: |
  The ADX block takes an input stream with up to 16 channels and demultiplexes
  it into four output streams of up to 16 channels. A byte RAM helps to form
  output frames by any combination of bytes from input frame. It's design is
  identical to that of the byte RAM in AMX except that the data flow direction
  is reversed. The ADX provides an automatic stream activation and de-activation
  mechanism.

maintainers:
  - Jonathan Hunter <jonathanh@nvidia.com>
  - Sameer Pujar <spujar@nvidia.com>
  - Mohan Kumar D <mkumard@nvidia.com>

properties:
  compatible:
    oneOf:
      - items:
          description: for Tegra210 based platforms
          const: "nvidia,tegra210-adx"
      - items:
          description: for Tegra186 based platforms
          const: "nvidia,tegra186-adx", "nvidia,tegra210-adx"
      - items:
          description: for Tegra194 based platforms
          const: "nvidia,tegra194-adx", "nvidia,tegra210-adx"

  reg:
    maxItems: 1
    description: Must contain physical base address and length of device's
      registers

  "#sound-dai-cells":
    description: The cell specifies number of DAIs.
    const: 1

  nvidia,ahub-adx-id:
    description: Must be specified to uniquely identify an ADX instance

required:
  - compatible
  - reg
  - "#sound-dai-cells"
  - nvidia,ahub-adx-id

examples:

  - |
    adx@702d3800 {
        compatible = "nvidia,tegra210-adx";
        reg = <0x702d3800 0x100>;
        nvidia,ahub-adx-id = <0>;
        #sound-dai-cells = <1>;
    };

  - |
    adx@2903800 {
        compatible = "nvidia,tegra186-adx", "nvidia,tegra210-adx";
        reg = <0x0 0x2903800 0x0 0x100>;
        nvidia,ahub-adx-id = <0>;
        #sound-dai-cells = <1>;
    };

  - |
    adx@2903800 {
        compatible = "nvidia,tegra194-adx", "nvidia,tegra210-adx";
        reg = <0x0 0x2903800 0x0 0x100>;
        nvidia,ahub-adx-id = <0>;
        #sound-dai-cells = <1>;
    };

...
```

## kernel/kernel-5.10/Documentation/devicetree/bindings/sound/nvidia,tegra210-afc.yaml
```yaml
# SPDX-License-Identifier: (GPL-2.0)
%YAML 1.2
---
$id: http://devicetree.org/schemas/sound/nvidia,tegra210-afc.yaml#
$schema: http://devicetree.org/meta-schemas/core.yaml#

title: NVIDIA Tegra210 Audio Flow Controller (AFC) DT Bindings

description: |
  AFC can control the flow traffic between two I2S instances running at
  different clocks that are up to 100 ppm apart. The AFC implements high
  fidelity interpolation and decimation algorithms that compensate for
  clock differences. The AFC can handle burst traffic from SFCs and can
  control traffic flow anywhere in the audio route.

maintainers:
  - Jonathan Hunter <jonathanh@nvidia.com>
  - Sameer Pujar <spujar@nvidia.com>
  - Mohan Kumar D <mkumard@nvidia.com>

properties:
  compatible:
    oneOf:
      - items:
          description: for Tegra210 based platforms
          const: "nvidia,tegra210-afc"
      - items:
          description: for Tegra186 based platforms
          const: "nvidia,tegra186-afc", "nvidia,tegra210-afc"
      - items:
          description: for Tegra194 based platforms
          const: "nvidia,tegra194-afc", "nvidia,tegra210-afc"

  reg:
    maxItems: 1
    description: Must contain physical base address and length of device's
      registers

  "#sound-dai-cells":
    description: The cell specifies number of DAIs.
    const: 1

  nvidia,ahub-afc-id:
    description: Must be specified to uniquely identify an AFC instance

required:
  - compatible
  - reg
  - "#sound-dai-cells"
  - nvidia,ahub-afc-id

examples:

  - |
    afc@702d7000 {
        compatible = "nvidia,tegra210-afc";
        reg = <0x702d7000 0x100>;
        #sound-dai-cells = <1>;
        nvidia,ahub-afc-id = <0>;
    };

  - |
    afc@2907000 {
        compatible = "nvidia,tegra186-afc", "nvidia,tegra210-afc";
        reg = <0x0 0x2907000 0x0 0x100>;
        #sound-dai-cells = <1>;
        nvidia,ahub-afc-id = <0>;
    };

  - |
    afc@2907000 {
        compatible = "nvidia,tegra194-afc", "nvidia,tegra210-afc";
        reg = <0x0 0x2907000 0x0 0x100>;
        #sound-dai-cells = <1>;
        nvidia,ahub-afc-id = <0>;
    };

...
```

## kernel/kernel-5.10/Documentation/devicetree/bindings/sound/nvidia,tegra210-amx.yaml
```yaml
# SPDX-License-Identifier: (GPL-2.0)
%YAML 1.2
---
$id: http://devicetree.org/schemas/sound/nvidia,tegra210-amx.yaml#
$schema: http://devicetree.org/meta-schemas/core.yaml#

title: NVIDIA Tegra210 Audio Multiplexer (AMX) DT Bindings

description: |
  AMX block can multiplex up to four input streams, where each input stream
  can have up to 16 channels and can generate an output stream of up to 16
  channels. A byte RAM helps to form an output frame by any combination of
  bytes from the four input streams.

  Two modes of data synchronization between input streams is available. This
  feature only starts the data transfer. Once the data transfer starts (if at
  least one frame is sent out), the AMX works in "wait for all mode".
    * Wait for all mode: In the beginning, wait for all enabled input streams
      to have data before forming the very first frame.
    * Wait for any mode: Start whenever data is available in any of the enabled
      input streams.
  AMX supports auto disable and audio enable feature of IDLE streams.

maintainers:
  - Jonathan Hunter <jonathanh@nvidia.com>
  - Sameer Pujar <spujar@nvidia.com>
  - Mohan Kumar D <mkumard@nvidia.com>

properties:
  compatible:
    oneOf:
      - items:
          description: for Tegra210 based platforms
          const: "nvidia,tegra210-amx"
      - items:
          description: for Tegra186 based platforms
          const: "nvidia,tegra186-amx", "nvidia,tegra210-amx"
      - items:
          description: for Tegra194 based platforms
          const: "nvidia,tegra194-amx"

  reg:
    maxItems: 1
    description: Must contain physical base address and length of device's
      registers

  "#sound-dai-cells":
    description: The cell specifies number of DAIs.
    const: 1

  nvidia,ahub-amx-id:
    description: Must be specified to uniquely identify an AMX instance

required:
  - compatible
  - reg
  - "#sound-dai-cells"
  - nvidia,ahub-amx-id

examples:

  - |
    amx@702d3000 {
        compatible = "nvidia,tegra210-amx";
        reg = <0x702d3000 0x100>;
        #sound-dai-cells = <1>;
        nvidia,ahub-amx-id = <0>;
    };

  - |
    amx@2903000 {
        compatible = "nvidia,tegra186-amx", "nvidia,tegra210-amx";
        reg = <0x0 0x2903000 0x0 0x100>;
        #sound-dai-cells = <1>;
        nvidia,ahub-amx-id = <0>;
    };

  - |
    amx@2903000 {
        compatible = "nvidia,tegra194-amx";
        reg = <0x0 0x2903000 0x0 0x100>;
        #sound-dai-cells = <1>;
        nvidia,ahub-amx-id = <0>;
    };

...
```
