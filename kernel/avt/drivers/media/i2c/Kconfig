## kernel/kernel-5.10/Documentation/devicetree/bindings/sound/nvidia,tegra210-mixer.yaml
```yaml
# SPDX-License-Identifier: (GPL-2.0)
%YAML 1.2
---
$id: http://devicetree.org/schemas/sound/nvidia,tegra210-mixer.yaml#
$schema: http://devicetree.org/meta-schemas/core.yaml#

title: NVIDIA Tegra210 Mixer DT Bindings

description: |
  The mixer supports up to ten 7.1 channel audio input streams and five
  outputs (each of which can be a mix of any combination of the 10 input
  streams). Examples include mixing system tones with voice calls, mixing
  two audio playbacks to create a transition effect.

  Mixer features
    * Supports mixing upto 10 input streams of 7.1 channel audio each
    * Supports five outputs of which each can be a mix of 10 input streams
    * Time ramp-up/ramp-down volume control provided for each stream
    * Fixed gain for each stream is possible
    * A 32-bit sample counter is provided for each input stream to count the
      number of samples consumed
    * A peak meter for each input stream is available

maintainers:
  - Jonathan Hunter <jonathanh@nvidia.com>
  - Sameer Pujar <spujar@nvidia.com>
  - Mohan Kumar D <mkumard@nvidia.com>

properties:
  compatible:
    oneOf:
      - items:
          description: for Tegra210 based platforms
          const: "nvidia,tegra210-amixer"
      - items:
          description: for Tegra186 based platforms
          const: "nvidia,tegra186-amixer", "nvidia,tegra210-amixer"
      - items:
          description: for Tegra194 based platforms
          const: "nvidia,tegra194-amixer", "nvidia,tegra210-amixer"

  reg:
    maxItems: 1
    description: Must contain physical base address and length of device's
      registers

  "#sound-dai-cells":
    description: The cell specifies number of DAIs.
    const: 1

  nvidia,ahub-amixer-id:
    description: Must be specified with Mixer instance number

required:
  - compatible
  - reg
  - "#sound-dai-cells"
  - nvidia,ahub-amixer-id

examples:

  - |
    amixer@702dbb00 {
        compatible = "nvidia,tegra210-amixer";
        reg = <0x702dbb00 0x800>;
        #sound-dai-cells = <1>;
        nvidia,ahub-amixer-id = <0>;
    };

  - |
    amixer@290bb00 {
        compatible = "nvidia,tegra186-amixer", "nvidia,tegra210-amixer";
        reg = <0x0 0x290bb00 0x0 0x800>;
        #sound-dai-cells = <1>;
        nvidia,ahub-amixer-id = <0>;
    };

  - |
    amixer@290bb00 {
        compatible = "nvidia,tegra194-amixer", "nvidia,tegra210-amixer";
        reg = <0x0 0x290bb00 0x0 0x800>;
        #sound-dai-cells = <1>;
        nvidia,ahub-amixer-id = <0>;
    };

...
```

## kernel/kernel-5.10/Documentation/devicetree/bindings/sound/nvidia,tegra210-mvc.yaml
```yaml
# SPDX-License-Identifier: (GPL-2.0)
%YAML 1.2
---
$id: http://devicetree.org/schemas/sound/nvidia,tegra210-mvc.yaml#
$schema: http://devicetree.org/meta-schemas/core.yaml#

title: NVIDIA Tegra210 Master Volume Controller (MVC) DT Bindings

description: |
  MVC provides gain or attenuation to a digital signal path. It can be used in
  input or output signal path for per-stream volume control as well as master
  volume control. The MVC block has one input and one output. The input digital
  stream can be mono or multi-channel and out stream will have the same format
  as that of input. An independent mute or unmute control is included in the
  MVC block.

  MVC features
    * Programmable range and steps for volume control
    * Programmable curve ramp for volume control
    * Independent mute or unmute control
    * Default gain values
    * Peak meter detector

maintainers:
  - Jonathan Hunter <jonathanh@nvidia.com>
  - Sameer Pujar <spujar@nvidia.com>
  - Mohan Kumar D <mkumard@nvidia.com>

properties:
  compatible:
    oneOf:
      - items:
          description: for Tegra210 based platforms
          const: "nvidia,tegra210-mvc"
      - items:
          description: for Tegra186 based platforms
          const: "nvidia,tegra186-mvc", "nvidia,tegra210-mvc"
      - items:
          description: for Tegra194 based platforms
          const: "nvidia,tegra194-mvc", "nvidia,tegra210-mvc"

  reg:
    maxItems: 1
    description: Must contain physical base address and length of device's
      registers

  "#sound-dai-cells":
    description: The cell specifies number of DAIs.
    const: 1

  nvidia,ahub-mvc-id:
    description: Must be specified to uniquely identify MVC instance

required:
  - compatible
  - reg
  - "#sound-dai-cells"
  - nvidia,ahub-mvc-id

examples:

  - |
    mvc@702da000 {
        compatible = "nvidia,tegra210-mvc";
        reg = <0x702da000 0x200>;
        #sound-dai-cells = <1>;
        nvidia,ahub-mvc-id = <0>;
    };

  - |
    mvc@290a000 {
        compatible = "nvidia,tegra186-mvc", "nvidia,tegra210-mvc";
        reg = <0x0 0x290a000 0x0 0x200>;
        #sound-dai-cells = <1>;
        nvidia,ahub-mvc-id = <0>;
    };

  - |
    mvc@290a000 {
        compatible = "nvidia,tegra194-mvc", "nvidia,tegra210-mvc";
        reg = <0x0 0x290a000 0x0 0x200>;
        #sound-dai-cells = <1>;
        nvidia,ahub-mvc-id = <0>;
    };

...
```

## kernel/kernel-5.10/Documentation/devicetree/bindings/sound/nvidia,tegra210-ope.yaml
```yaml
# SPDX-License-Identifier: (GPL-2.0)
%YAML 1.2
---
$id: http://devicetree.org/schemas/sound/nvidia,tegra210-ope.yaml#
$schema: http://devicetree.org/meta-schemas/core.yaml#

title: NVIDIA Tegra210 Output Process Engine (OPE) DT Bindings

description: |
  The OPE has a scalable number of BiQuad stages in MBDRC (Multi-band Dynamic
  Range Controller) and Parametric Equalizer (PEQ) to support stereo, 5.1 and
  7.1 channels meeting ultra low power audio requirements.

maintainers:
  - Jonathan Hunter <jonathanh@nvidia.com>
  - Sameer Pujar <spujar@nvidia.com>
  - Mohan Kumar D <mkumard@nvidia.com>

properties:
  compatible:
    oneOf:
      - items:
          description: for Tegra210 based platforms
          const: "nvidia,tegra210-ope"
      - items:
          description: for Tegra186 based platforms
          const: "nvidia,tegra186-ope", "nvidia,tegra210-ope"
      - items:
          description: for Tegra194 based platforms
          const: "nvidia,tegra194-ope", "nvidia,tegra210-ope"

  reg:
    description: Must contain physical base address and length of device's
      registers
    maxItems: 3
    - items:
        description: OPE register space
    - items:
        description: Parametric Equalizer (PEQ) register space.
          PEQ is part of OPE module.
    - items:
        description: Multiband Dynamic Range Compressor (MBDRC) register space.
          MBDRC is part of OPE module.

  "#sound-dai-cells":
    description: The cell specifies number of DAIs.
    const: 1

  nvidia,ahub-ope-id:
    description: Must be specified to uniquely indentify an OPE instance.

required:
  - compatible
  - reg
  - "#sound-dai-cells"
  - nvidia,ahub-ope-id

examples:

  - |
    ope@702d8000 {
        compatible = "nvidia,tegra210-ope";
        reg = <0x702d8000 0x100>,
              <0x702d8100 0x100>,
              <0x702d8200 0x200>;
        #sound-dai-cells = <1>;
        nvidia,ahub-ope-id = <0>;
    };

  - |
    ope@2908000 {
        compatible = "nvidia,tegra186-ope", "nvidia,tegra210-ope"
        reg = <0x0 0x2908000 0x0 0x100>,
              <0x0 0x2908100 0x0 0x100>,
              <0x0 0x2908200 0x0 0x200>;
        #sound-dai-cells = <1>;
        nvidia,ahub-ope-id = <0>;
    };

  - |
    ope@2908000 {
        compatible = "nvidia,tegra194-ope", "nvidia,tegra210-ope";
        reg = <0x0 0x2908000 0x0 0x100>,
              <0x0 0x2908100 0x0 0x100>,
              <0x0 0x2908200 0x0 0x200>;
        #sound-dai-cells = <1>;
        nvidia,ahub-ope-id = <0>;
    };

...
```

## kernel/kernel-5.10/Documentation/devicetree/bindings/sound/nvidia,tegra210-sfc.yaml
```yaml
# SPDX-License-Identifier: (GPL-2.0)
%YAML 1.2
---
$id: http://devicetree.org/schemas/sound/nvidia,tegra210-sfc.yaml#
$schema: http://devicetree.org/meta-schemas/core.yaml#

title: NVIDIA Tegra210 Sample Frequency Converter (SFC) DT Bindings

description: |
  The SFC converts sampling frequency of the input signal from one frequency
  to another. Following are the features of SFC,
    * Supports sampling frequency conversion of streams up to two channels.
    * Has a very low latency with the maximum latency of < 125 us.
    * Supports inter conversion of following sampling frequencies
      8, 11.025, 16, 22.05, 24, 32, 44.1, 48, 88.2, 96, 176.4, 192 kHz, with
      following exceptions where conversion is not possible.
        176.4 <---> 8 kHz
        192   <---> 8 kHz
        176.4 <---> 11.025 kHz
        192   <---> 11.025 kHz

maintainers:
  - Jonathan Hunter <jonathanh@nvidia.com>
  - Sameer Pujar <spujar@nvidia.com>
  - Mohan Kumar D <mkumard@nvidia.com>

properties:
  compatible:
    oneOf:
      - items:
          description: for Tegra210 based platforms
          const: "nvidia,tegra210-sfc"
      - items:
          description: for Tegra186 based platforms
          const: "nvidia,tegra186-sfc", "nvidia,tegra210-sfc"
      - items:
          description: for Tegra194 based platforms
          const: "nvidia,tegra194-sfc", "nvidia,tegra210-sfc"

  reg:
    maxItems: 1
    description: Must contain physical base address and length of device's
      registers

  "#sound-dai-cells":
    description: The cell specifies number of DAIs.
    const: 1

  nvidia,ahub-sfc-id:
    description: Must be specified with SFC instance number.

required:
  - compatible
  - reg
  - "#sound-dai-cells"
  - nvidia,ahub-sfc-id

examples:

  - |
    sfc@702d2000 {
        compatible = "nvidia,tegra210-sfc";
        reg = <0x702d2000 0x200>;
        #sound-dai-cells = <1>;
        nvidia,ahub-sfc-id = <0>;
    };

  - |
    sfc@2902000 {
        compatible = "nvidia,tegra186-sfc", "nvidia,tegra210-sfc";
        reg = <0x0 0x2902000 0x0 0x200>;
        #sound-dai-cells = <1>;
        nvidia,ahub-sfc-id = <0>;
    };

  - |
    sfc@2902000 {
        compatible = "nvidia,tegra194-sfc", "nvidia,tegra210-sfc";
        reg = <0x0 0x2902000 0x0 0x200>;
        #sound-dai-cells = <1>;
        nvidia,ahub-sfc-id = <0>;
    };

...
```

## kernel/kernel-5.10/Documentation/devicetree/bindings/sound/nvidia,tegra30-hda.yaml
```yaml
# SPDX-License-Identifier: (GPL-2.0)
%YAML 1.2
---
$id: http://devicetree.org/schemas/sound/nvidia,tegra30-hda.yaml#
$schema: http://devicetree.org/meta-schemas/core.yaml#

title: NVIDIA Tegra30 HDA controller DT Bindings

maintainers:
  - Thierry Reding <treding@nvidia.com>
  - Jonathan Hunter <jonathanh@nvidia.com>
  - Sameer Pujar <spujar@nvidia.com>
  - Mohan Kumar D <mkumard@nvidia.com>

properties:
  compatible:
    oneOf:
      - items:
          description: for Tegra30 based platforms
          const: "nvidia,tegra30-hda"
      - items:
          description: for Tegra114 based platforms
          const: "nvidia,tegra114-hda", "nvidia,tegra30-hda"
      - items:
          description: for Tegra124 based platforms
          const: "nvidia,tegra124-hda", "nvidia,tegra30-hda"
      - items:
          description: for Tegra132 based platforms
          const: "nvidia,tegra132-hda", "nvidia,tegra30-hda"
      - items:
          description: for Tegra210 based platforms
          const: "nvidia,tegra210-hda", "nvidia,tegra30-hda"
      - items:
          description: for Tegra186 based platforms
          const: "nvidia,tegra186-hda", "nvidia,tegra30-hda"
      - items:
          description: for Tegra194 based platforms
          const: "nvidia,tegra194-hda", "nvidia,tegra30-hda"

  reg:
    maxItems: 1
    description: Should contain the HDA registers location and length.

  interrupts:
    description: The interrupt from the HDA controller.

  clocks:
    - items:
        description: clock for core HDA logic
    - items:
        description: clock for HDA codec
    - items:
        description: clock for HDA link logic

  clock-names:
    - items:
        const: hda
    - items:
        const: hda2hdmi
    - items:
        const: hda2codec_2x

  resets:
    - items:
        description: reset for HDA core
    - items:
        description: reset for HDA codec
    - items:
        description: reset for HDA link logic

  reset-names:
    - items:
        const: hda
    - items:
        const: hda2hdmi
    - items:
        const: hda2codec_2x

required:
 - compatible
 - reg
 - interrupts
 - clocks
 - clock-names
 - resets
 - reset-names

examples:

  - |
    hda@70030000 {
        compatible = "nvidia,tegra124-hda", "nvidia,tegra30-hda";
        reg = <0x0 0x70030000 0x0 0x10000>;
        interrupts = <GIC_SPI 81 IRQ_TYPE_LEVEL_HIGH>;
        clocks = <&tegra_car TEGRA124_CLK_HDA>,
                 <&tegra_car TEGRA124_CLK_HDA2HDMI>,
                 <&tegra_car TEGRA124_CLK_HDA2CODEC_2X>;
        clock-names = "hda", "hda2hdmi", "hda2codec_2x";
        resets = <&tegra_car 125>, /* hda */
                 <&tegra_car 128>, /* hda2hdmi */
                 <&tegra_car 111>; /* hda2codec_2x */
        reset-names = "hda", "hda2hdmi", "hda2codec_2x";
    };

...
```
