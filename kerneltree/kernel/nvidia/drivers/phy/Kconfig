## kerneltree/kernel/nvidia/drivers/phy/Kconfig
```kconfig
#
# PHY
#

config TEGRA_P2U
	tristate "Nvidia Tegra P2U PHY Driver"
	depends on PCIE_TEGRA_DW || PCIE_TEGRA_DW_EP
	select GENERIC_PHY
	help
	  Enable this to support the P2U (PIPE to UPHY) that is part of Tegra 19x SOCs.
```
