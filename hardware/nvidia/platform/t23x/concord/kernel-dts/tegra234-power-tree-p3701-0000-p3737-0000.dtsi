/*
 * Copyright (c) 2021, NVIDIA CORPORATION.  All rights reserved.
 *
 * This program is free software; you can redistribute it and/or modify
 * it under the terms of the GNU General Public License as published by
 * the Free Software Foundation; either version 2 of the License, or
 * (at your option) any later version.
 *
 * This program is distributed in the hope that it will be useful, but WITHOUT
 * ANY WARRANTY; without even the implied warranty of MERCHANTABILITY or
 * FITNESS FOR A PARTICULAR PURPOSE.  See the GNU General Public License for
 * more details.
 */


#include "cvb/tegra234-p3737-fixed-regulator.dtsi"

/ {
	pcie@141a0000 {
		vpcie3v3-supply = <&p3737_vdd_3v3_pcie>;
		vpcie12v-supply = <&p3737_vdd_12v_pcie>;
	};

	pcie_ep@141a0000 {
		vpcie3v3-supply = <&p3737_vdd_3v3_pcie>;
		vpcie12v-supply = <&p3737_vdd_12v_pcie>;
	};

	sdhci@3400000 {
		/*
		 * Both 3.3V and 1.8V vqmmc/IO supplies are always provided
		 * and enabling either of the supplies is controller by
		 * pad controls. Do not list any vqmmc supply here.
		 */
		vmmc-supply = <&p3737_vdd_3v3_sd>;
	};
};
