/*
 * Copyright (c) 2021-2022, NVIDIA CORPORATION.  All rights reserved.
 *
 * This program is free software; you can redistribute it and/or modify
 * it under the terms of the GNU General Public License as published by
 * the Free Software Foundation; version 2 of the License.
 *
 * This program is distributed in the hope that it will be useful, but WITHOUT
 * ANY WARRANTY; without even the implied warranty of MERCHANTABILITY or
 * FITNESS FOR A PARTICULAR PURPOSE.  See the GNU General Public License for
 * more details.
 */

/dts-v1/;
/plugin/;

/ {
	overlay-name = "Add P3737 UFS Overlay Support";
	compatible = "nvidia,tegra23x";
	nvidia,dtsfilename = __FILE__;
	nvidia,dtbbuildtime = __DATE__, __TIME__;

	fragment@0 {
		target-path = "/";
		board_config {
			odm-data = "hsio-uphy-config-3";
		};
		__overlay__ {
			ufshci@2500000 {
				nvidia,max-hs-gear = <3>;
				status = "okay";
			};
		};
	};
};

