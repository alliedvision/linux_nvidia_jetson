/*
 * Copyright (c) 2021-2023, NVIDIA CORPORATION.  All rights reserved.
 *
 * This program is free software; you can redistribute it and/or modify
 * it under the terms of the GNU General Public License as published by
 * the Free Software Foundation; version 2 of the License.
 *
 * This program is distributed in the hope that it will be useful, but WITHOUT
 * ANY WARRANTY; without even the implied warranty of MERCHANTABILITY or
 * FITNESS FOR A PARTICULAR PURPOSE.  See the GNU General Public License for
 * more details.
 *
 * T234 E2421-1098 common DTSI file.
 */

#include <tegra234-soc/tegra234-soc-cvm.dtsi>

/ {
	pmc@c360000 {
		nvidia,invert-interrupt;
	};

	nvpmodel {
		status = "okay";
	};
};
