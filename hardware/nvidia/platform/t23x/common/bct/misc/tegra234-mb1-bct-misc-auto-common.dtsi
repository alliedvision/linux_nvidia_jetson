/*
 * Copyright (c) 2021, NVIDIA CORPORATION.  All rights reserved.
 *
 * This program is free software; you can redistribute it and/or modify
 * it under the terms of the GNU General Public License as published by
 * the Free Software Foundation; either version 2 of the License, or
 * (at your option) any later version.
 *
 * This program is distributed in the hope that it will be useful, but WITHOUT
 * ANY WARRANTY; without even the implied warranty of MERCHANTABILITY or
 * FITNESS FOR A PARTICULAR PURPOSE.  See the GNU General Public License for
 * more details.
 */

/*/dts-v1/;*/


/ {
	misc {
#ifdef ENABLE_NVDEC
		enable_nvdec = <1>;
#else
		enable_nvdec = <0>;
#endif
#ifdef ENABLE_TSEC
		enable_tsec = <1>;
#else
		enable_tsec = <0>;
#endif
#ifndef CONFIG_ENABLE_SC7
		disable_sc7 = <1>;
#else
		disable_sc7 = <0>;
#endif
              cpu {
                        ccplex_platform_features = <0x0 0x00000000>;
                  };
        };
};
