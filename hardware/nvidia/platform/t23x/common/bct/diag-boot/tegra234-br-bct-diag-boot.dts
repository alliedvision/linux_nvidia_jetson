/dts-v1/;

/ {
    brbct {
        ECID = <0x00000000 0x00000000 0x00000000 0x00000000>;
        SecureDebugControlEcid = <0>;
        SecureDebugControlNoneEcid = <0>;
        u32_non_gpio_select_boot_chain = <0>;
        u32_num_boot_chains = <1>;
        preprod_dev_sign = <1>;
        bf_bl_allbits {
            bf_bl_gpio_select_boot_chain_1b                = <0>;
            bf_bl_mb1_debug_production_1b                  = <0>;
            bf_bl_sc7_rf_debug_production_1b               = <0>;
            bf_bl_psc_bl_debug_production_1b               = <0>;
            bf_bl_psc_rf_debug_production_1b               = <0>;
            bf_bl_psc_fw_debug_production_1b               = <0>;
            bf_bl_bpmp_debug_production_1b                 = <0>;
            bf_bl_bpmp_ist_debug_production_1b             = <0>;
            bf_bl_mce_debug_production_1b                  = <0>;
            bf_bl_ist_ccplex_debug_production_1b           = <0>;
            bf_bl_ist_fw_debug_production_1b               = <0>;
            bf_bl_rtc_rail_violation_detect_1b             = <0>;
            bf_bl_cust_nv_ccplex_dfd_en_1b                 = <0>;
            bf_bl_debug_with_test_keys_1b                  = <0>;
            bf_bl_debug_with_test_keys_during_psc_debug_1b = <0>;
            bf_bl_disable_bootrom_clock_boost_1b           = <0>;
            bf_bl_disable_pscrom_clk_boost_1b              = <0>;
            bf_bl_enable_scpm_reset                        = <0>;
            bf_bl_skip_oem_auth_diag_boot                  = <0>;
            bf_bl_diag_boot                                = <0>;
            bf_bl_bpmp_diag_boot                           = <1>;
            bf_bl_l0_ist                                   = <0>;
            bf_bl_l1_ist                                   = <0>;
        };
    };
};
