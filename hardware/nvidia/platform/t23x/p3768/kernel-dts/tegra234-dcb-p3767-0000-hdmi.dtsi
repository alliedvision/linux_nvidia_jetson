/*
 * Copyright (c) 2022-2023, NVIDIA CORPORATION & AFFILIATES. All rights reserved.
 *
 * SPDX-License-Identifier: GPL-2.0
*/

/ {
	display@13800000 {
		nvidia,dcb-image = [
			55 aa 16 00 00 37 34 30 30 e9 4c 19 77 cc 56 49
			44 45 4f 20 0d 00 00 00 70 01 00 00 00 00 49 42
			4d 20 56 47 41 20 43 6f 6d 70 61 74 69 62 6c 65
			01 00 00 00 10 00 82 18 30 33 2f 31 36 2f 32 33
			00 00 00 00 00 00 00 00 21 18 50 00 e1 2b 00 00
			50 4d 49 44 00 00 00 00 00 00 00 a0 00 b0 00 b8
			00 c0 00 0e 47 41 31 30 42 20 56 47 41 20 42 49
			4f 53 0d 0a 00 00 00 00 00 00 00 00 00 00 00 00
			00 00 00 00 00 00 00 00 00 00 00 00 00 00 00 00
			00 00 00 00 00 00 00 00 00 00 00 00 00 00 00 00
			00 00 00 00 00 00 00 00 00 00 00 00 00 00 00 00
			00 00 00 00 00 56 65 72 73 69 6f 6e 20 39 34 2e
			30 42 2e 30 30 2e 30 30 2e 32 31 20 0d 0a 00 43
			6f 70 79 72 69 67 68 74 20 28 43 29 20 31 39 39
			36 2d 32 30 32 33 20 4e 56 49 44 49 41 20 43 6f
			72 70 2e 0d 0a 00 00 00 ff ff 00 00 00 00 ff ff
			47 50 55 20 42 6f 61 72 64 00 00 00 00 00 00 00
			00 00 00 00 00 00 00 00 00 00 00 00 00 00 00 00
			00 00 00 43 68 69 70 20 52 65 76 20 20 20 00 00
			00 00 00 00 00 00 00 ba 91 98 96 91 9a 9a 8d 96
			91 98 df ad 9a 93 9a 9e 8c 9a df d2 df b1 90 8b
			df b9 90 8d df af 8d 90 9b 8a 9c 8b 96 90 91 df
			aa 8c 9a f2 f5 ff 00 00 00 00 00 00 00 00 00 00
			50 43 49 52 de 10 94 22 00 00 18 00 00 00 00 03
			16 00 01 00 00 80 00 00 2e 8b c0 2e 8b c0 8b c0
			4e 50 44 45 01 01 14 00 16 00 00 01 00 00 00 00
			00 00 00 00 00 00 00 00 00 00 00 00 00 00 00 00
			ff b8 42 49 54 00 00 01 0c 06 13 44 32 01 04 00
			3e 02 42 02 25 00 4a 02 43 02 2c 00 6f 02 44 01
			04 00 9b 02 49 01 24 00 9f 02 4d 02 29 00 c3 02
			4e 00 00 00 00 00 50 02 fc 00 ec 02 53 02 18 00
			e8 03 54 01 02 00 00 04 55 01 05 00 0a 04 56 01
			06 00 0f 04 78 01 08 00 15 04 64 01 02 00 1d 04
			70 02 04 00 1f 04 75 01 11 00 23 04 69 02 6e 00
			34 04 45 01 04 00 02 04 73 01 04 00 06 04 00 00
			a2 04 a2 04 e9 21 f0 21 e0 2b 00 00 00 00 00 00
			00 00 00 00 00 00 00 00 00 00 00 00 0b 94 21 00
			00 00 00 00 a8 07 00 00 00 00 00 00 00 00 02 00
			5c 5c 2e 02 00 00 42 02 04 00 10 00 00 00 00 e9
			0e 00 00 00 00 00 00 3f 44 00 00 e7 2d 00 00 00
			00 00 00 00 00 00 00 00 00 00 00 92 30 00 00 eb
			44 00 00 29 45 00 00 50 45 00 00 00 00 00 00 f6
			04 00 00 00 00 fa 04 00 00 66 08 fa 04 16 2b 66
			08 18 2b a2 04 ef 09 04 22 d4 09 c2 21 18 2b 90
			00 9b 22 01 68 08 56 09 fa 43 00 00 04 44 00 00
			f7 0f 00 00 f0 21 00 00 fc 21 00 00 30 4b 00 00
			00 00 00 00 00 00 00 00 00 00 00 00 d5 33 00 00
			bb 36 00 00 00 00 00 00 00 00 00 00 00 00 00 00
			00 00 00 00 00 00 00 00 00 00 00 00 b3 3c 00 00
			00 00 00 00 ed 3c 00 00 12 43 00 00 00 00 00 00
			00 00 00 00 df 33 00 00 32 3d 00 00 a6 43 00 00
			ad 36 00 00 00 00 00 00 00 00 00 00 c8 43 00 00
			00 00 00 00 00 00 00 00 00 00 00 00 00 00 00 00
			00 00 00 00 61 0b 00 00 dd 0a 00 00 77 0b 00 00
			11 3c 00 00 17 3c 00 00 1c 3c 00 00 20 3c 00 00
			2a 3c 00 00 31 3c 00 00 3f 3c 00 00 81 3c 00 00
			00 00 00 00 00 00 00 00 96 3c 00 00 f6 45 00 00
			9c 47 00 00 11 48 00 00 63 4a 00 00 5c 4c 00 00
			98 4c 00 00 c2 4a 00 00 9c 3c 00 00 79 3c 00 00
			00 00 00 00 00 00 00 00 00 00 00 00 c8 4e 00 00
			a0 3c 00 00 a9 3c 00 00 00 00 00 00 00 00 00 00
			00 00 00 00 00 00 00 00 00 00 00 00 00 00 00 00
			00 00 00 00 00 00 00 00 64 00 50 b5 00 19 cf 00
			28 91 0e 14 a5 0e 23 00 01 23 23 01 14 00 00 00
			0c 11 00 00 00 00 83 17 00 00 c8 0e 01 00 00 0d
			0e df 0c 00 00 00 00 01 01 00 00 00 00 af 1d 0d
			4f 00 00 00 00 00 00 00 00 00 00 00 00 00 00 00
			b2 2d 00 00 00 00 0b 94 21 00 00 66 60 f1 01 f0
			03 00 00 30 33 2f 31 36 2f 32 33 00 00 00 00 00
			00 00 00 00 00 00 00 21 01 10 00 00 00 80 01 00
			00 00 00 00 30 30 30 30 30 30 30 30 30 30 30 30
			00 00 00 00 00 00 00 00 03 42 00 00 1c 06 99 a6
			b9 51 42 01 b8 8b e9 f1 13 c6 1b 3f 54 33 00 00
			00 00 00 00 a5 4d 00 00 00 00 00 00 00 00 73 4f
			00 00 01 00 10 00 bf 09 30 00 02 00 94 22 00 00
			00 00 01 00 44 00 6b 09 00 00 a2 04 00 00 56 09
			00 00 fa 04 00 00 00 00 00 00 66 08 00 00 78 08
			00 00 61 0b 00 00 dd 0a 00 00 77 0b 00 00 8d 0b
			00 00 0d 0e 00 00 df 0c 00 00 00 00 00 00 00 00
			00 00 00 00 00 00 2c 22 00 00 30 c0 61 40 00 00
			00 10 00 00 00 00 08 23 61 00 80 00 00 00 80 00
			00 00 88 23 61 00 80 00 00 00 80 00 00 00 08 24
			61 00 80 00 00 00 80 00 00 00 88 24 61 00 80 00
			00 00 80 00 00 00 08 25 61 00 80 00 00 00 80 00
			00 00 88 25 61 00 80 00 00 00 80 00 00 00 08 26
			61 00 80 00 00 00 80 00 00 00 00 2a 13 00 00 00
			04 00 00 00 04 00 00 2a 13 00 00 00 01 00 00 00
			01 00 00 6e 13 00 00 00 04 00 00 00 04 00 00 6e
			13 00 00 00 01 00 00 00 01 00 4c 00 12 00 3f 00
			00 00 00 00 00 00 0c 24 02 00 01 00 00 00 00 00
			00 00 e4 05 02 00 7c 00 00 00 00 00 00 00 e4 05
			02 00 7c 00 00 00 18 00 00 00 e4 05 02 00 7c 00
			00 00 0c 00 00 00 e4 05 02 00 7c 00 00 00 04 00
			00 00 e4 05 02 00 7c 00 00 00 08 00 00 00 e4 05
			02 00 7c 00 00 00 14 00 00 00 20 0e 9a 00 00 00
			02 00 00 00 02 00 00 0e 9a 00 00 00 02 00 00 00
			02 00 00 0e 9a 00 01 00 00 00 01 00 00 00 34 c0
			61 40 00 00 00 80 00 00 00 00 00 0c 82 00 ff ff
			ff ff 00 00 00 00 00 0c 82 00 01 00 00 00 00 00
			00 00 00 0c 82 00 02 00 00 00 00 00 00 00 00 0c
			82 00 04 00 00 00 00 00 00 00 00 0c 82 00 08 00
			00 00 00 00 00 00 00 0c 82 00 10 00 00 00 00 00
			00 00 00 0c 82 00 20 00 00 00 00 00 00 00 90 02
			82 00 01 00 00 00 00 00 00 00 88 02 82 00 ff 00
			00 00 00 00 00 00 c0 04 82 00 07 00 00 00 00 00
			00 00 00 0a 00 00 00 00 f0 1f 00 00 00 00 88 80
			08 00 00 00 0f 00 00 00 01 00 40 c0 08 00 00 00
			0c 00 00 00 0c 00 40 c0 08 00 1f 00 00 00 00 00
			00 00 00 0a 00 00 00 00 f0 1f 00 00 00 00 74 09
			9a 00 0f 00 00 00 00 00 00 00 e8 73 13 00 01 00
			00 00 01 00 00 00 0c 06 9a 00 40 00 00 00 40 00
			00 00 64 00 12 00 40 00 00 00 40 00 00 00 04 14
			00 00 04 00 00 00 00 00 00 00 04 14 00 00 08 00
			00 00 08 00 00 00 14 38 82 00 00 00 01 00 00 00
			01 00 00 0a 00 00 00 00 f0 1f 00 00 00 00 0c 14
			00 00 01 00 00 00 01 00 00 00 0c 14 00 00 02 00
			00 00 01 00 00 00 88 54 62 00 00 00 01 00 00 00
			00 00 88 54 62 00 00 00 02 00 00 00 00 00 88 54
			62 00 00 00 04 00 00 00 00 00 9c 8b 11 00 00 00
			00 80 00 00 00 00 14 0c 82 00 01 00 00 00 00 00
			00 00 14 0c 82 00 02 00 00 00 00 00 00 00 14 0c
			82 00 04 00 00 00 00 00 00 00 14 0c 82 00 08 00
			00 00 00 00 00 00 14 0c 82 00 10 00 00 00 00 00
			00 00 14 0c 82 00 20 00 00 00 00 00 00 00 9c 8b
			11 00 00 00 00 80 00 00 00 00 10 01 82 00 01 00
			00 00 00 00 00 00 d4 06 82 00 ff 03 00 00 00 00
			00 00 14 0c 82 00 3f 00 00 00 01 00 00 00 00 14
			00 00 02 00 00 00 00 00 00 00 44 c1 61 60 01 00
			00 00 01 00 00 00 20 87 08 00 04 00 00 00 00 00
			00 00 40 00 82 00 01 00 00 00 00 00 00 00 54 9b
			41 00 ff 00 00 00 00 00 00 00 68 9b 41 00 03 00
			00 00 00 00 00 00 40 80 11 00 02 00 00 00 00 00
			00 00 04 0c 82 00 01 00 00 00 00 00 00 00 04 14
			00 00 00 04 00 00 00 00 00 00 34 04 82 00 01 00
			00 00 00 00 00 00 68 08 00 01 02 03 04 05 06 07
			00 01 02 03 04 05 06 07 41 06 24 06 00 00 00 07
			00 02 bf 00 01 51 00 04 bf 00 02 5e 00 01 bf 00
			03 52 00 03 bf 00 84 19 00 00 4f 00 85 7b 59 98
			4f 00 06 ff 00 00 4f 00 07 ff 00 00 ef 00 08 ff
			00 00 ef 00 09 ff 00 00 ef 00 0a ff 00 00 ef 00
			0b ff 00 00 ef 00 0c ff 00 00 ef 00 0d ff 00 00
			ef 00 0e ff 00 00 ef 00 0f ff 00 00 ef 00 10 42
			50 11 e4 00 11 41 42 0b e2 00 12 40 41 0a e1 00
			13 70 51 12 e5 00 14 ff 00 00 ef 00 15 ff 00 00
			ef 00 16 ff 00 00 ef 00 17 ff 00 00 ef 00 18 ff
			00 00 ef 00 19 ff 00 00 ef 00 1a ff 00 00 ef 00
			1b ff 00 00 ef 00 1c ff 00 00 ef 00 1d ff 00 00
			ef 00 1e ff 00 00 ef 00 1f ff 00 00 ef 00 00 ff
			00 00 0f 00 00 ff 00 00 0f 00 00 ff 00 00 0f 00
			00 ff 00 00 0f 00 10 07 16 10 00 bd 0a 01 f0 10
			03 00 00 00 00 ff ff ff 00 ff ff 00 10 00 00 00
			00 00 00 1f 01 00 00 00 00 00 00 ff ff ff 00 ff
			ff 00 10 00 00 00 00 00 00 2f 02 00 00 00 00 00
			00 ff ff ff 00 ff ff 00 10 00 00 00 00 00 00 3f
			03 00 00 00 00 00 00 ff ff ff 00 ff ff 00 10 00
			00 00 00 00 00 4f 04 00 00 00 00 00 00 ff ff ff
			00 ff ff 00 10 00 00 00 00 00 00 5f 05 00 00 00
			00 00 00 ff ff ff 00 ff ff 00 10 00 00 00 00 00
			00 6f 06 00 00 00 00 00 00 ff ff ff 00 ff ff 00
			10 00 00 00 00 00 00 7f 07 00 00 00 00 00 00 ff
			ff ff 00 ff ff 00 10 00 00 00 00 00 00 8f 00 00
			00 00 00 00 00 ff ff ff 00 ff ff 00 10 00 00 00
			00 00 00 9f 01 00 00 00 00 00 00 ff ff ff 00 ff
			ff 00 10 00 00 00 00 00 00 af 02 00 00 00 00 00
			00 ff ff ff 00 ff ff 00 10 00 00 00 00 00 00 bf
			03 00 00 00 00 00 00 ff ff ff 00 ff ff 00 10 00
			00 00 00 00 00 cf 04 00 00 00 00 00 00 ff ff ff
			00 ff ff 00 10 00 00 00 00 00 00 df 05 00 00 00
			00 00 00 ff ff ff 00 ff ff 00 10 00 00 00 00 00
			00 ef 06 00 00 00 00 00 00 ff ff ff 00 ff ff 00
			10 00 00 00 00 00 00 ff 07 00 00 00 00 00 00 ff
			ff ff 00 ff ff 00 10 00 00 00 00 00 00 00 01 02
			03 04 05 06 07 08 09 0a 0b 0c 0d 0e 0f 10 11 12
			13 14 15 16 17 18 19 1a 1b 1c 1d 1e 1f 10 04 20
			04 00 00 80 00 b8 4c 0a ff e0 93 04 00 20 d6 13
			00 e0 93 04 01 20 d6 13 00 ff 00 00 00 00 00 00
			00 00 00 00 00 00 00 00 ff 00 00 00 00 00 00 00
			00 00 00 00 01 00 00 00 00 ff 00 00 00 00 00 00
			00 00 00 00 00 00 00 00 ff 00 00 00 00 00 00 00
			00 00 00 00 01 00 00 00 00 ff 00 00 00 00 00 00
			00 00 00 00 00 00 00 00 ff 00 00 00 00 00 00 00
			00 00 00 00 01 00 00 00 00 ff 00 00 00 00 00 00
			00 20 05 11 01 00 00 35 0c 00 ff ff ff ff ff ff
			ff ff ff 00 00 00 00 10 05 11 01 00 00 00 00 ff
			ff 00 00 00 00 00 00 00 00 00 00 00 00 30 08 10
			01 14 01 15 0e 00 00 00 00 00 00 00 00 00 00 00
			00 00 00 00 00 00 00 00 00 00 00 00 00 00 00 00
			00 00 00 00 00 00 00 00 00 00 00 00 00 00 00 00
			00 00 00 00 00 00 00 00 00 00 00 00 00 00 00 00
			00 00 00 00 00 00 00 00 00 00 00 00 00 00 00 00
			00 00 00 00 00 00 00 00 00 00 00 00 00 00 00 00
			00 00 00 00 00 00 00 00 00 00 00 00 00 00 00 00
			00 00 00 00 00 00 00 00 00 00 00 00 00 00 00 00
			00 00 00 00 00 00 00 00 00 00 00 00 00 00 00 00
			00 00 00 00 00 00 00 00 00 00 00 00 00 00 00 00
			00 00 00 00 00 00 00 00 00 00 00 00 00 00 00 00
			00 00 00 00 00 00 00 00 00 00 00 00 00 00 00 00
			00 00 00 00 00 00 00 00 00 00 00 00 00 00 00 00
			00 00 00 00 00 00 00 00 00 00 00 00 00 00 00 00
			00 00 00 00 00 00 00 00 00 00 00 00 00 00 00 00
			00 00 00 00 00 00 00 00 00 00 00 00 00 00 00 00
			00 00 00 00 00 00 00 00 00 00 00 00 00 00 00 00
			00 00 00 00 00 00 00 00 00 00 00 00 00 00 00 00
			00 00 00 00 00 00 00 00 00 00 00 00 00 00 00 00
			00 00 00 00 00 00 00 00 00 00 00 00 00 00 00 00
			00 00 00 00 00 00 00 00 00 00 00 00 00 00 00 10
			0d 17 34 b0 8f 11 00 00 00 00 00 00 00 00 00 34
			a8 04 82 00 00 00 00 00 00 00 00 00 34 a0 04 82
			00 00 00 00 00 00 00 00 00 34 d4 02 82 00 00 00
			00 00 00 00 00 00 34 a4 04 82 00 00 00 00 00 00
			00 00 00 34 7c 14 00 00 00 00 00 00 00 00 00 00
			34 08 0e 82 00 00 00 00 00 00 00 00 00 34 0c 0e
			82 00 00 00 00 00 00 00 00 00 34 a8 83 11 00 00
			00 00 00 00 00 00 00 34 78 01 82 00 00 00 00 00
			00 00 00 00 34 78 01 82 00 00 00 00 00 00 00 00
			00 34 ac 04 82 00 00 00 00 00 00 00 00 00 34 94
			10 82 00 00 00 00 00 00 00 00 00 34 88 10 82 00
			00 00 00 00 00 00 00 00 34 8c 10 82 00 00 00 00
			00 00 00 00 00 34 90 10 82 00 00 00 00 00 00 00
			00 00 34 ac 83 11 00 00 00 00 00 00 00 00 00 34
			78 01 82 00 00 00 00 00 00 00 00 00 34 d4 02 82
			00 00 00 00 00 00 00 00 00 34 78 05 82 00 00 00
			00 00 00 00 00 00 34 b0 04 82 00 00 00 00 00 00
			00 00 00 34 78 01 82 00 00 00 00 00 00 00 00 00
			34 7c 07 82 00 00 00 00 00 00 00 00 00 10 03 1b
			05 80 00 07 60 05 08 40 08 09 60 0d 0a 40 10 0d
			f0 17 0c e0 15 0e 60 18 0f 40 1c 10 e0 23 15 80
			24 16 26 29 17 60 2d 18 40 30 19 60 35 1a 60 39
			1b 60 3d 1d e0 43 1e a5 44 1f 60 49 20 60 4d 21
			60 51 22 fc 47 23 a0 58 24 66 59 25 2c 5a 26 f2
			5a 68 74 e1 61 8d e9 54 da de d0 33 c4 0d 30 30
			cb 00 00 00 00 00 00 00 00 00 00 00 00 00 00 00
			00 00 00 00 00 00 00 00 00 00 00 00 00 00 00 00
			00 4e 56 49 44 49 41 00 00 00 00 00 00 00 00 00
			00 00 00 00 00 4e 56 49 44 49 41 20 43 6f 72 70
			6f 72 61 74 69 6f 6e 00 00 00 00 00 00 00 00 00
			00 00 00 00 00 00 00 00 22 05 02 0e 0c 00 00 00
			00 00 00 00 00 00 00 00 00 00 00 00 00 00 00 00
			00 00 00 00 00 00 00 00 00 50 04 13 0e 07 95 01
			95 01 d0 07 a0 0f 1b 00 1b 00 0f 0f 32 ff 01 3f
			08 95 01 95 01 d0 07 a0 0f 1b 00 1b 00 0f 0f 32
			ff 01 3f 0b 95 01 95 01 d0 07 a0 0f 1b 00 1b 00
			0f 0f 32 ff 01 3f 04 e1 00 13 01 94 11 28 23 e1
			00 13 01 01 01 14 ff 01 02 0c 1b 00 1b 00 40 06
			80 0c 1b 00 1b 00 01 01 28 ff 01 3f 41 1b 00 1b
			00 40 06 8c 0a 1b 00 28 00 01 ff 28 ff 03 3f 42
			1b 00 1b 00 40 06 8c 0a 1b 00 28 00 01 ff 28 ff
			03 3f 80 1b 00 1b 00 20 03 54 06 1b 00 1b 00 01
			01 14 ff 01 3f 81 1b 00 1b 00 20 03 54 06 1b 00
			1b 00 01 01 14 ff 01 3f 82 1b 00 1b 00 20 03 54
			06 1b 00 1b 00 01 01 14 ff 01 3f 83 1b 00 1b 00
			20 03 54 06 1b 00 1b 00 01 01 14 ff 01 3f 0d 1b
			00 1b 00 20 03 54 06 1b 00 1b 00 01 01 14 ff 01
			3f 0e 1b 00 1b 00 e8 03 d0 07 0d 00 1b 00 01 ff
			28 ff 01 1f 0f 95 01 95 01 d0 07 a0 0f 1b 00 1b
			00 0f 0f 32 ff 01 3f 10 04 02 06 00 00 00 07 00
			07 00 07 00 07 00 07 10 05 04 10 04 0f 0f 0f 0f
			2f 2f 2f 2f 1c 1c 1c 1c 0f 46 40 00 0e 0e 0e 0e
			2d 2d 2d 2d 13 13 13 13 0f 46 40 00 0e 0e 0e 0e
			2c 2c 2c 2c 15 15 15 15 0f 46 40 00 0e 0e 0e 0e
			2b 2b 2b 2b 17 17 17 17 0f 46 40 00 0f 0f 0f 0f
			2d 2d 2d 2d 19 19 19 19 0f 46 40 00 0f 0f 0f 0f
			2c 2c 2c 2c 1b 1b 1b 1b 0f 46 40 00 0f 0f 0f 0f
			2b 2b 2b 2b 1d 1d 1d 1d 0f 46 40 00 0f 0f 0f 0f
			2a 2a 2a 2a 1f 1f 1f 1f 0f 46 40 00 0e 0e 0e 0e
			29 29 29 29 18 18 18 18 0f 46 40 00 0e 0e 0e 0e
			28 28 28 28 1a 1a 1a 1a 0f 46 40 00 0e 0e 0e 0e
			27 27 27 27 1c 1c 1c 1c 0f 46 40 00 0e 0e 0e 0e
			26 26 26 26 1e 1e 1e 1e 0f 46 40 00 0f 0f 0f 0f
			2d 2d 2d 2d 19 19 19 19 0f 46 40 00 0f 0f 0f 0f
			2c 2c 2c 2c 1b 1b 1b 1b 0f 46 40 00 0f 0f 0f 0f
			2b 2b 2b 2b 1d 1d 1d 1d 0f 46 40 00 0f 0f 0f 0f
			2a 2a 2a 2a 1f 1f 1f 1f 0f 46 40 00 20 19 04 00
			00 50 32 74 40 e8 80 e4 57 01 04 04 06 31 1a 00
			00 07 10 00 00 3d 11 00 00 3b 12 00 00 39 13 00
			00 37 14 00 00 35 15 00 00 33 16 00 00 10 08 0e
			05 00 2c 04 04 d1 84 00 00 00 00 0a 05 00 06 00
			00 00 00 00 38 3d 3e 3f 3a 00 00 00 00 05 05 05
			05 00 00 00 00 00 00 00 00 88 58 24 00 00 00 00
			00 75 40 00 00 00 00 0a 05 00 06 00 00 00 00 00
			38 3d 3e 3f 3a 3f 3f 3f 3f 05 05 05 05 0a 0a 0a
			0a 00 00 00 00 88 58 24 00 aa aa 00 00 65 19 00
			00 00 00 0a 05 00 06 00 00 00 00 00 48 3a 3a 3a
			3a 3a 3a 3a 3a 00 00 00 00 00 00 00 00 00 00 00
			00 f8 5a 24 00 aa aa 00 00 00 00 00 00 00 00 0a
			0a 00 06 00 00 00 00 00 58 3a 3a 3a 3a 3a 3a 3a
			3a 00 00 00 00 00 00 00 00 00 00 00 00 f8 5a 24
			00 aa aa 00 00 03 00 00 01 0a 05 0f 46 40 00 00
			03 00 44 06 00 00 01 0a 08 0f 46 40 00 00 03 00
			44 08 00 00 01 0a 05 0f 46 40 00 00 03 00 44 0a
			00 00 01 0a 05 0f 46 40 00 00 03 00 44 0c 00 00
			01 0a 08 0f 46 40 00 00 03 00 44 10 08 0e 05 00
			2c 04 04 d1 84 00 00 00 00 0a 05 00 06 00 00 00
			00 00 38 3d 3e 3f 3a 00 00 00 00 05 05 05 05 00
			00 00 00 00 00 00 00 88 58 24 00 00 00 00 00 75
			40 00 00 00 00 0a 05 00 06 00 00 00 00 00 38 3d
			3e 3f 3a 00 00 00 00 05 05 05 05 00 00 00 00 00
			00 00 00 88 58 24 00 00 00 00 00 65 19 00 00 00
			00 0a 05 00 06 00 00 00 00 00 48 3a 3a 3a 3a 00
			00 00 00 00 00 00 00 00 00 00 00 00 00 00 00 f8
			5a 24 00 00 00 00 00 00 00 00 00 00 00 0a 0a 00
			06 00 00 00 00 00 58 3a 3a 3a 3a 00 00 00 00 00
			00 00 00 00 00 00 00 00 00 00 00 f8 5a 24 00 00
			00 00 00 0c 00 00 01 0a 05 0f 46 40 00 00 03 00
			44 0d 00 00 01 0a 08 0f 46 40 00 00 03 00 44 0e
			00 00 01 0a 05 0f 46 40 00 00 03 00 44 0f 01 00
			01 0a 05 0f 46 40 00 00 03 00 44 10 01 00 01 0a
			08 0f 46 40 00 00 03 00 44 10 08 0e 05 00 2c 04
			04 d1 84 00 00 00 00 0a 05 00 06 00 00 00 00 00
			38 3d 3e 3f 3a 00 00 00 00 05 05 05 05 00 00 00
			00 00 00 00 00 88 58 24 00 00 00 00 00 75 40 00
			00 00 00 0a 05 00 06 00 00 00 00 00 38 3d 3e 3f
			3a 3f 3f 3f 3f 05 05 05 05 05 05 05 05 00 00 00
			00 88 58 24 00 00 00 00 00 65 19 00 00 00 00 0a
			05 00 06 00 00 00 00 00 48 3a 3a 3a 3a 3a 3a 3a
			3a 00 00 00 00 00 00 00 00 00 00 00 00 f8 5a 24
			00 00 00 00 00 00 00 00 00 00 00 0a 0a 00 06 00
			00 00 00 00 58 3a 3a 3a 3a 3a 3a 3a 3a 00 00 00
			00 00 00 00 00 00 00 00 00 f8 5a 24 00 00 00 00
			00 0c 01 00 01 0a 05 0f 46 40 00 00 03 00 44 0d
			01 00 01 0a 08 0f 46 40 00 00 03 00 44 0e 02 00
			01 0a 05 0f 46 40 00 00 03 00 44 0f 02 00 01 0a
			05 0f 46 40 00 00 03 00 44 10 02 00 01 0a 08 0f
			46 40 00 00 03 00 44 10 08 0e 05 00 2c 04 04 d1
			84 00 00 00 00 0a 05 00 06 00 00 00 00 00 38 3d
			3e 3f 3a 00 00 00 00 05 05 05 05 00 00 00 00 00
			00 00 00 88 58 24 00 00 00 00 00 75 40 00 00 00
			00 0a 05 00 06 00 00 00 00 00 38 3d 3e 3f 3a 00
			00 00 00 05 05 05 05 00 00 00 00 00 00 00 00 88
			58 24 00 00 00 00 00 65 19 00 00 00 00 0a 05 00
			06 00 00 00 00 00 48 3a 3a 3a 3a 00 00 00 00 00
			00 00 00 00 00 00 00 00 00 00 00 f8 5a 24 00 00
			00 00 00 00 00 00 00 00 00 0a 0a 00 06 00 00 00
			00 00 58 3a 3a 3a 3a 00 00 00 00 00 00 00 00 00
			00 00 00 00 00 00 00 f8 5a 24 00 00 00 00 00 0c
			00 00 01 0a 05 0f 46 40 00 00 03 00 44 0d 00 00
			01 0a 08 0f 46 40 00 00 03 00 44 0e 00 00 01 0a
			05 0f 46 40 00 00 03 00 44 0f 01 00 01 0a 05 0f
			46 40 00 00 03 00 44 10 01 00 01 0a 08 0f 46 40
			00 00 03 00 44 10 08 0e 05 00 2c 04 04 d1 84 00
			00 00 00 0a 05 00 06 00 00 00 00 00 38 3d 3e 3f
			3a 00 00 00 00 05 05 05 05 00 00 00 00 00 00 00
			00 88 58 24 00 00 00 00 00 75 40 00 00 00 00 0a
			05 00 06 00 00 00 00 00 38 3d 3e 3f 3a 3f 3f 3f
			3f 05 05 05 05 08 08 08 08 00 00 00 00 88 58 24
			00 00 00 00 00 65 19 00 00 00 00 0a 05 00 06 00
			00 00 00 00 48 3a 3a 3a 3a 3a 3a 3a 3a 00 00 00
			00 00 00 00 00 00 00 00 00 f8 5a 24 00 00 00 00
			00 00 00 00 00 00 00 0a 0a 00 06 00 00 00 00 00
			58 3a 3a 3a 3a 3a 3a 3a 3a 00 00 00 00 00 00 00
			00 00 00 00 00 f8 5a 24 00 00 00 00 00 0c 01 00
			01 0a 05 0f 46 40 00 00 03 00 44 0d 01 00 01 0a
			08 0f 46 40 00 00 03 00 44 0e 02 00 01 0a 05 0f
			46 40 00 00 03 00 44 0f 02 00 01 0a 05 0f 46 40
			00 00 03 00 44 10 02 00 01 0a 08 0f 46 40 00 00
			03 00 44 10 08 0e 05 00 2c 04 04 d1 84 00 00 00
			00 0a 05 00 06 00 00 00 00 00 38 3d 3e 3f 3a 00
			00 00 00 05 05 05 05 00 00 00 00 00 00 00 00 88
			58 24 00 00 00 00 00 75 40 00 00 00 00 0a 05 00
			06 00 00 00 00 00 38 3d 3e 3f 3a 00 00 00 00 05
			05 05 05 00 00 00 00 00 00 00 00 88 58 24 00 00
			00 00 00 65 19 00 00 00 00 0a 05 00 06 00 00 00
			00 00 48 3a 3a 3a 3a 00 00 00 00 00 00 00 00 00
			00 00 00 00 00 00 00 f8 5a 24 00 00 00 00 00 00
			00 00 00 00 00 0a 0a 00 06 00 00 00 00 00 58 3a
			3a 3a 3a 00 00 00 00 00 00 00 00 00 00 00 00 00
			00 00 00 f8 5a 24 00 00 00 00 00 0c 00 00 01 0a
			05 0f 46 40 00 00 03 00 44 0d 00 00 01 0a 08 0f
			46 40 00 00 03 00 44 0e 00 00 01 0a 05 0f 46 40
			00 00 03 00 44 0f 01 00 01 0a 05 0f 46 40 00 00
			03 00 44 10 01 00 01 0a 08 0f 46 40 00 00 03 00
			44 7a 14 c0 61 40 01 00 c2 0d 74 05 00 6e 14 c0
			61 40 ff ff bf ff 00 00 00 00 6e e4 c5 61 40 fe
			ff ff ff 00 00 00 00 71 5b b0 1a 71 5b 63 17 5b
			68 17 71 56 00 ff 72 71 6e 0c c1 61 40 fe ff ff
			ff 00 00 00 00 6e 40 65 61 80 fe ff ff ff 00 00
			00 00 71 10 07 01 60 01 60 00 00 00 00 00 00 00
			00 00 00 00 00 00 00 00 00 00 00 00 00 00 00 00
			00 00 00 00 00 00 00 00 00 00 00 00 00 00 00 00
			00 00 00 00 00 00 00 00 00 00 00 00 00 00 00 00
			00 00 00 00 00 00 00 00 00 00 00 00 00 00 00 00
			00 00 00 00 00 00 00 00 00 00 00 00 00 00 00 00
			00 00 00 00 00 00 00 00 00 00 00 00 00 00 00 00
			00 00 00 00 00 00 00 00 00 00 00 00 00 00 00 00
			00 00 00 00 00 00 00 00 00 00 00 00 00 00 00 00
			00 00 00 00 00 00 00 00 00 00 00 00 00 00 00 00
			00 00 00 00 00 00 00 00 00 00 00 00 00 00 00 00
			00 00 00 00 00 00 00 00 00 00 00 00 00 00 00 00
			00 00 00 00 00 00 00 00 00 00 6e 00 23 61 40 ff
			ff 80 fc 00 00 23 00 71 6e 00 23 61 40 ff ff 80
			fc 00 00 27 00 71 6e 00 23 61 40 ff ff 80 fc 00
			00 2b 00 71 6e 00 23 61 40 ff ff 80 fc 00 00 2f
			00 71 41 23 10 08 25 19 cb bd dc 4e 78 08 00 00
			00 00 00 00 67 19 ec 19 c1 00 00 00 00 00 00 00
			00 00 00 00 00 02 03 80 01 10 00 62 04 0e 01 80
			01 10 00 02 04 0e 11 02 01 10 00 02 00 2e 32 03
			02 10 00 02 00 fe 40 04 00 00 00 00 00 0f 00 00
			00 00 00 00 00 0f 00 00 00 00 00 00 00 0f 00 00
			00 00 00 00 00 0f 00 00 00 00 00 00 00 0f 00 00
			00 00 00 00 00 0f 00 00 00 00 00 00 00 0f 00 00
			00 00 00 00 00 0f 00 00 00 00 00 00 00 0f 00 00
			00 00 00 00 00 0f 00 00 00 00 00 00 00 0f 00 00
			00 00 00 00 00 41 06 0f 04 02 0f 06 00 00 10 ff
			03 00 80 ff 03 00 80 ff 03 00 10 ff 03 00 10 ff
			03 00 10 ff 03 00 10 ff 03 00 10 ff 03 00 10 ff
			03 00 10 ff 03 00 00 ff 03 00 00 ff 03 00 00 ff
			03 00 00 ff 03 00 00 40 05 20 04 01 ff 00 00 00
			ff 00 00 00 ff 00 00 00 ff 00 00 00 ff 00 00 00
			ff 00 00 00 ff 00 00 00 ff 00 00 00 ff 00 00 00
			ff 00 00 00 ff 00 00 00 ff 00 00 00 ff 00 00 00
			ff 00 00 00 ff 00 00 00 ff 00 00 00 ff 00 00 00
			ff 00 00 00 ff 00 00 00 ff 00 00 00 ff 00 00 00
			ff 00 00 00 ff 00 00 00 ff 00 00 00 ff 00 00 00
			ff 00 00 00 ff 00 00 00 ff 00 00 00 ff 00 00 00
			ff 00 00 00 ff 00 00 00 ff 00 00 00 40 05 10 04
			00 61 10 00 00 ff 01 00 00 ff 02 00 00 ff 03 00
			00 ff 04 00 00 ff 00 00 00 ff 00 00 00 ff 00 00
			00 ff 00 00 00 ff 00 00 00 ff 00 00 00 ff 00 00
			00 ff 00 00 00 ff 00 00 00 ff 00 00 00 ff 00 00
			00 10 05 40 01 00 00 00 0b 03 00 00 0a 02 00 00
			08 02 00 20 04 02 00 80 00 00 00 80 00 00 00 80
			00 00 00 80 00 00 00 20 00 00 00 20 00 03 00 00
			0c 03 00 00 0a 03 00 80 0b 03 00 80 0b 03 00 80
			0b 03 00 80 0b 03 71 71 6e 14 c0 61 40 ff ff 3f
			fa 00 00 c0 01 74 05 00 6e 14 c0 61 40 f7 ff ff
			ff 08 00 00 00 6e b8 c1 61 40 ff ff 3f 81 00 03
			00 08 6e 00 23 61 40 ff ff 83 fc 00 00 00 00 71
			58 40 c0 61 40 10 00 00 0a 1d 00 00 0a 04 00 00
			08 04 00 20 04 04 00 80 00 00 00 80 00 00 00 80
			00 00 00 80 00 00 00 20 00 00 00 20 00 1d 00 00
			0c 1d 00 00 0a 1d 00 80 0a 1d 00 80 0a 1d 00 80
			0a 1d 00 80 0a 1d 71 6e 00 23 61 40 ff ff fc fc
			00 00 02 03 71 7a 14 c0 61 40 14 00 c2 0d 74 05
			00 6e 14 c0 61 40 ff ff bf ff 00 00 00 00 74 14
			00 71 6e 14 c0 61 40 ff ff ff f2 00 00 00 00 74
			0a 00 6e 00 23 61 40 ff ff fc ff 00 00 01 00 6e
			0c c1 61 60 ff bf ff ff 00 40 00 00 6e 14 c0 61
			40 ff ff 7f ff 00 00 00 00 6e 30 c1 61 60 f0 ff
			ff ff 0f 00 00 00 6e 34 c0 61 40 ff ff ee 7f 00
			00 00 80 56 17 ff 6e 0c c1 61 60 fc ff ff ff 01
			00 00 00 6e 30 c1 61 60 0f ff ff ff f0 00 00 00
			74 0a 00 6e 30 c1 61 60 0f ff ff ff 00 00 00 00
			6e 10 c1 61 40 e0 e0 e0 e0 00 00 00 00 6e 2c c1
			61 40 e0 e0 e0 e0 00 00 00 00 3a 05 15 6e 40 c1
			61 60 fd ff ff ff 02 00 00 00 98 0a 01 00 00 01
			fe 01 71 98 02 01 00 00 01 d0 00 6e 10 c1 61 40
			e0 e0 e0 e0 10 10 10 10 6e 2c c1 61 40 e0 e0 e0
			e0 10 10 10 10 71 5f 0c c1 61 60 00 01 40 ff 40
			00 00 00 00 40 65 61 80 fe bf 00 bf 3a 00 03 5b
			14 1c 72 71 3a 07 01 38 6e 40 c1 61 60 fe ff ff
			ff 01 00 00 00 72 5b 68 1d 52 e8 df 00 71 71 6e
			0c c1 61 60 fe ff 00 ff 00 00 00 00 6e 30 c1 61
			40 f0 ff ff ff 00 00 00 00 6e b0 c1 61 40 f0 ff
			ff ff 00 00 00 00 6e 34 c0 61 40 ff ff ee 7f 00
			00 11 80 56 17 ff 6e 14 c0 61 40 ff ff 7f ff 00
			00 80 00 6e 00 23 61 40 ff ff fc ff 00 00 02 00
			74 05 00 6e 14 c0 61 40 ff ff ff f2 00 00 00 0d
			74 05 00 6e 14 c0 61 40 ff ff bf ff 00 00 40 00
			74 05 00 6e 14 c0 61 40 f7 ff ff ff 08 00 00 00
			6e 0c c0 61 40 ff f0 f0 f0 00 03 05 05 6e b8 c1
			61 40 ff ff ff 81 00 03 00 08 6e 00 23 61 40 ff
			ff 83 fc 00 00 00 00 6e 40 c1 61 60 fe ff ff ff
			00 00 00 00 71 6e 0c c1 61 60 fd ff ff ff 02 00
			00 00 6e 30 c1 61 60 ff ff bf ff 00 00 40 00 71
			10 05 40 01 01 00 00 00 00 0a 10 00 00 00 a0 40
			00 00 80 40 00 00 80 40 00 00 80 40 00 00 80 40
			00 00 80 40 00 00 20 00 00 32 10 80 00 0a 90 80
			00 00 80 80 00 00 80 80 00 00 80 80 00 00 80 80
			00 00 80 80 00 71 71 6e 40 65 61 80 fe ff ff ff
			00 00 00 00 71 71 98 07 01 00 00 01 ef 10 71 98
			07 01 00 00 01 ef 00 71 58 40 c0 61 40 10 00 00
			00 00 32 10 00 00 00 a0 40 00 00 80 40 00 00 80
			40 00 00 80 40 00 00 80 40 00 00 80 40 00 00 20
			00 00 32 10 80 00 96 90 80 00 00 80 80 00 00 80
			80 00 00 80 80 00 00 80 80 00 00 80 80 00 71 42
			15 02 07 13 04 03 0a 04 28 23 28 23 01 04 04 06
			00 1d 00 00 00 00 00 00 00 00 00 00 00 00 00 00
			00 00 14 00 02 19 0a 03 1e 14 04 2b 28 06 1e 00
			03 25 0f 04 2f 21 06 28 00 04 32 14 06 3c 00 06
			14 00 02 19 0a 03 1e 14 04 2b 28 06 1e 00 03 25
			0f 04 2f 21 06 28 00 04 32 14 06 3c 00 06 14 00
			02 19 0a 03 1e 14 04 2b 28 06 1e 00 03 25 0f 04
			2f 21 06 28 00 04 32 14 06 3c 00 06 0f 00 02 16
			09 03 1d 0e 04 27 12 06 17 00 03 21 09 04 27 0e
			06 1f 00 04 27 09 06 27 00 06 62 1e 00 00 f2 1e
			00 00 82 1f 00 00 12 20 00 00 a2 20 00 00 32 21
			00 00 10 08 00 00 00 11 08 00 1e 00 00 00 00 01
			05 05 00 40 00 00 00 00 00 30 00 14 00 00 00 00
			01 05 05 00 40 00 00 00 00 00 30 00 10 00 00 00
			00 01 05 05 00 40 00 00 00 00 00 30 00 0c 00 00
			00 00 01 05 05 00 40 00 00 00 00 00 30 00 0a 00
			00 00 00 01 05 05 00 40 00 00 00 00 00 30 00 09
			00 00 00 00 01 05 05 00 40 00 00 00 00 00 30 00
			08 00 00 00 00 01 05 05 00 40 00 00 00 00 00 30
			00 06 00 00 00 00 01 05 05 00 40 00 00 00 00 00
			30 00 10 08 00 00 00 11 08 00 1e 00 00 00 00 00
			05 05 00 00 00 00 00 00 00 00 00 14 00 00 00 00
			00 05 05 00 00 00 00 00 00 00 00 00 10 00 00 00
			00 03 00 01 00 50 00 00 00 00 00 00 00 0c 00 00
			00 00 03 00 01 00 50 00 00 00 00 00 00 00 0a 00
			00 00 00 00 05 05 00 00 00 00 00 00 00 00 00 09
			00 00 00 00 03 00 01 00 40 00 00 00 00 00 00 00
			08 00 00 00 00 03 00 01 00 40 00 00 00 00 00 00
			00 06 00 00 00 00 00 05 05 00 00 00 00 00 00 00
			00 00 10 08 00 00 00 11 08 00 1e 00 00 00 00 00
			05 05 00 00 00 00 00 00 00 00 00 14 00 00 00 00
			00 05 05 00 00 00 00 00 00 00 00 00 10 00 00 00
			00 03 00 01 00 50 00 00 00 00 00 00 00 0c 00 00
			00 00 03 00 01 00 50 00 00 00 00 00 00 00 0a 00
			00 00 00 00 05 05 00 00 00 00 00 00 00 00 00 09
			00 00 00 00 03 00 01 00 40 00 00 00 00 00 00 00
			08 00 00 00 00 03 00 01 00 40 00 00 00 00 00 00
			00 06 00 00 00 00 00 05 05 00 00 00 00 00 00 00
			00 00 10 08 00 00 00 11 08 00 1e 00 00 00 00 00
			05 05 00 00 00 00 00 00 00 00 00 14 00 00 00 00
			00 05 05 00 00 00 00 00 00 00 00 00 10 00 00 00
			00 03 00 01 00 50 00 00 00 00 00 00 00 0c 00 00
			00 00 03 00 01 00 50 00 00 00 00 00 00 00 0a 00
			00 00 00 00 05 05 00 00 00 00 00 00 00 00 00 09
			00 00 00 00 03 00 01 00 40 00 00 00 00 00 00 00
			08 00 00 00 00 03 00 01 00 40 00 00 00 00 00 00
			00 06 00 00 00 00 00 05 05 00 00 00 00 00 00 00
			00 00 10 08 00 00 00 11 08 00 1e 00 00 00 00 00
			05 05 00 00 00 00 00 00 00 00 00 14 00 00 00 00
			00 05 05 00 00 00 00 00 00 00 00 00 10 00 00 00
			00 03 00 01 00 50 00 00 00 00 00 00 00 0c 00 00
			00 00 03 00 01 00 50 00 00 00 00 00 00 00 0a 00
			00 00 00 00 05 05 00 00 00 00 00 00 00 00 00 09
			00 00 00 00 03 00 01 00 40 00 00 00 00 00 00 00
			08 00 00 00 00 03 00 01 00 40 00 00 00 00 00 00
			00 06 00 00 00 00 00 05 05 00 00 00 00 00 00 00
			00 00 10 08 00 00 00 11 08 00 1e 00 00 00 00 00
			05 05 00 00 00 00 00 00 00 00 00 14 00 00 00 00
			00 05 05 00 00 00 00 00 00 00 00 00 10 00 00 00
			00 03 00 01 00 50 00 00 00 00 00 00 00 0c 00 00
			00 00 03 00 01 00 50 00 00 00 00 00 00 00 0a 00
			00 00 00 00 05 05 00 00 00 00 00 00 00 00 00 09
			00 00 00 00 03 00 01 00 40 00 00 00 00 00 00 00
			08 00 00 00 00 03 00 01 00 40 00 00 00 00 00 00
			00 06 00 00 00 00 00 05 05 00 00 00 00 00 00 00
			00 00 ];
	};
};
