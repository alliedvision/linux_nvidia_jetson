/*
 * Top level DTS file for CVM:P3767-0000 PX1 and CVB:P3768-0000.
 *
 * Copyright (c) 2024, NVIDIA CORPORATION.  All rights reserved.
 *
 * This program is free software; you can redistribute it and/or modify
 * it under the terms of the GNU General Public License as published by
 * the Free Software Foundation; version 2 of the License.
 *
 * This program is distributed in the hope that it will be useful, but WITHOUT
 * ANY WARRANTY; without even the implied warranty of MERCHANTABILITY or
 * FITNESS FOR A PARTICULAR PURPOSE.  See the GNU General Public License for
 * more details.
 */

/dts-v1/;

#include "tegra234-p3767-0000-p3768-0000-a0.dts"

/ {
	nvidia,dtsfilename = __FILE__;
	nvidia,dtbbuildtime = __DATE__, __TIME__;
	compatible = "nvidia,p3768-0000+p3767-0000-px1", "nvidia,p3767-0000", "nvidia,tegra234", "nvidia,tegra23x";
	model = "NVIDIA Orin NX PX1 Developer Kit";

	host1x@13e00000 {
		nvdla1@158c0000 {
			status = "disabled";
		};
	};

	pcie@140a0000 {/* C8 - Ethernet */
		status = "disabled";
	};

};
