// SPDX-License-Identifier: GPL-2.0-only
/*
 * Device-tree overlay for FE-PI Audio V1 and Z V2 with board
 * tegra194-p3668-0001-p3509-0000.
 *
 * Copyright (c) 2019-2020 NVIDIA CORPORATION. All rights reserved.
 *
 */

/dts-v1/;
/plugin/;

#include <dt-common/jetson/tegra194-p3668-all-p3509-0000.h>
#include <overlays/jetson-fe-pi-audio.dts>
