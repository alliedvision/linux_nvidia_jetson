// SPDX-License-Identifier: GPL-2.0-only
/*
 * Device-tree overlay for FE-PI Audio Z V2 with board
 * tegra194-p2888-0001-p2822-0000.
 *
 * Copyright (c) 2019 NVIDIA CORPORATION. All rights reserved.
 *
 */

/dts-v1/;
/plugin/;

#include <dt-common/jetson/tegra194-p2888-0001-p2822-0000.h>
#include <overlays/jetson-fe-pi-audio-z-v2.dts>

/ {
	fragment@2 {
		target = <&tegra_sound>;
		__overlay__ {
			nvidia,audio-routing =
				"y Headphone",		"y HP_OUT",
				"y MIC_IN",		"y Mic",
				"y ADC",		"y Mic Bias";
		};
	};
};
