/*
 * Copyright (c) 2020, NVIDIA CORPORATION.  All rights reserved.
 *
 * This program is free software; you can redistribute it and/or modify it
 * under the terms and conditions of the GNU General Public License,
 * version 2, as published by the Free Software Foundation.
 *
 * This program is distributed in the hope it will be useful, but WITHOUT
 * ANY WARRANTY; without even the implied warranty of MERCHANTABILITY or
 * FITNESS FOR A PARTICULAR PURPOSE.  See the GNU General Public License for
 * more details.
 *
 * You should have received a copy of the GNU General Public License
 * along with this program.  If not, see <http://www.gnu.org/licenses/>.
 */

#include <dt-bindings/clock/tegra194-clock.h>
/{
        spi@c260000 {
                clocks = <&bpmp_clks TEGRA194_CLK_SPI2>,
                        <&bpmp_clks TEGRA194_CLK_OSC>;
        };

        mttcan@c310000 {
		pll_source = "osc";
                clocks = <&bpmp_clks TEGRA194_CLK_CAN1_CORE>,
                        <&bpmp_clks TEGRA194_CLK_CAN1_HOST>,
                        <&bpmp_clks TEGRA194_CLK_CAN1>,
                        <&bpmp_clks TEGRA194_CLK_OSC>;
		 clock-names = "can_core", "can_host","can", "osc";
        };

        mttcan@c320000 {
		pll_source = "osc";
                clocks = <&bpmp_clks TEGRA194_CLK_CAN2_CORE>,
                        <&bpmp_clks TEGRA194_CLK_CAN2_HOST>,
                        <&bpmp_clks TEGRA194_CLK_CAN2>,
                        <&bpmp_clks TEGRA194_CLK_OSC>;
		 clock-names = "can_core", "can_host","can", "osc";
        };
};
