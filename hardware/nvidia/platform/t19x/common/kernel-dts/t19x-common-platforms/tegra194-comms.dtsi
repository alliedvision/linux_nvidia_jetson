/*
 * Copyright (c) 2017-2020, NVIDIA CORPORATION.  All rights reserved.
 *
 * This program is free software; you can redistribute it and/or modify it
 * under the terms and conditions of the GNU General Public License,
 * version 2, as published by the Free Software Foundation.
 *
 * This program is distributed in the hope it will be useful, but WITHOUT
 * ANY WARRANTY; without even the implied warranty of MERCHANTABILITY or
 * FITNESS FOR A PARTICULAR PURPOSE.  See the GNU General Public License for
 * more details.
 *
 * You should have received a copy of the GNU General Public License
 * along with this program.  If not, see <http://www.gnu.org/licenses/>.
 */
#include <dt-bindings/gpio/tegra194-gpio.h>

/ {
	/* Need to enable wifi_en pin during boot for PCIe enumeration */
	gpio@2200000 {
		wifi-enable {
			gpio-hog;
			output-high;
			gpios = <TEGRA194_MAIN_GPIO(G, 3) 0>;
			label = "wifi-enable";
			status = "okay";
		};
	};

	bcmdhd_pcie_wlan {
		compatible = "android,bcmdhd_pcie_wlan";
		wlan-pwr-gpio = <&tegra_main_gpio TEGRA194_MAIN_GPIO(G, 3) 0>;
		fw_path = "/vendor/firmware/fw_bcmdhd_4356.bin";
		nv_path = "/vendor/firmware/nvram_4356.txt";
		status = "okay";
	};
};
