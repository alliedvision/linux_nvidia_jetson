// SPDX-License-Identifier: GPL-2.0-only
/*
 * Device-tree overlay for ReSpeaker 4-Mic Linear Array with board
 * tegra194-p2888-0004-e3900-0000.
 *
 * Copyright (c) 2021 NVIDIA CORPORATION. All rights reserved.
 *
 */

/dts-v1/;
/plugin/;

#include <dt-common/jetson/tegra194-p2888-0004-e3900-0000.h>
#include <overlays/jetson-respeaker-4-mic-lin-array.dts>

/ {
	fragment@1 {
		target = <&tegra_sound>;
		__overlay__ {
			nvidia,audio-routing =
				"y MIC1N",              "y Mic",
				"y MIC1P",              "y Mic",
				"y MIC2N",              "y Mic",
				"y MIC2P",              "y Mic",
				"y MIC3N",              "y Mic",
				"y MIC3P",              "y Mic",
				"y MIC4N",              "y Mic",
				"y MIC4P",              "y Mic",
				"y Capture",            "y Mic";
		};
	};
};
