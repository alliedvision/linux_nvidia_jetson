// SPDX-License-Identifier: GPL-2.0-only
/*
 * Device-tree overlay for ReSpeaker 4 Mic Linear Array with board
 * tegra210-p3448-0000-p3449-0000-a01.
 *
 * Copyright (c) 2021 NVIDIA CORPORATION. All rights reserved.
 *
 */

/dts-v1/;
/plugin/;

#include <dt-common/jetson/tegra210-p3448-0000-p3449-0000-a01.h>
#include <overlays/jetson-respeaker-4-mic-lin-array.dts>
