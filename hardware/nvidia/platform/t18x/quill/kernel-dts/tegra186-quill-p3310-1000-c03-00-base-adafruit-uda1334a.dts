// SPDX-License-Identifier: GPL-2.0-only
/*
 * Device-tree overlay for Adafruit I2S Stereo Decoder Breakout
 * (UDA1334A) with board tegra186-quill-p3310-1000-c03-00-base.
 *
 * Copyright (c) 2021 NVIDIA CORPORATION. All rights reserved.
 *
 */

/dts-v1/;
/plugin/;

#include <dt-common/jetson/tegra186-quill-p3310-1000-c03-00-base.h>
#include <overlays/jetson-adafruit-uda1334a.dts>
