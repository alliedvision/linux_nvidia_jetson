// SPDX-License-Identifier: GPL-2.0-only
/*
 * Device-tree overlay for ReSpeaker 4 Mic Array with board
 * tegra186-p3636-0001-p3509-0000-a01
 *
 * Copyright (c) 2021 NVIDIA CORPORATION. All rights reserved.
 *
 */

/dts-v1/;
/plugin/;

#include <dt-common/jetson/tegra186-p3509-0000-p3636-0001.h>
#include <overlays/jetson-respeaker-4-mic-array.dts>
