// SPDX-License-Identifier: GPL-2.0-only
/*
 * Device-tree overlay for Adafruit I2S Stereo Decoder Breakout
 * (UDA1334A) with tegra186-p3636-0001-p3509-0000-a01
 *
 * Copyright (c) 2021 NVIDIA CORPORATION. All rights reserved.
 *
 */

/dts-v1/;
/plugin/;

#include <dt-common/jetson/tegra186-p3509-0000-p3636-0001.h>
#include <overlays/jetson-adafruit-uda1334a.dts>
