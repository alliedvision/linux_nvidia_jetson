/*
 * Copyright (c) 2017-2022, NVIDIA CORPORATION.  All rights reserved.
 *
 * This program is free software; you can redistribute it and/or modify it
 * under the terms and conditions of the GNU General Public License,
 * version 2, as published by the Free Software Foundation.
 *
 * This program is distributed in the hope it will be useful, but WITHOUT
 * ANY WARRANTY; without even the implied warranty of MERCHANTABILITY or
 * FITNESS FOR A PARTICULAR PURPOSE.  See the GNU General Public License for
 * more details.
 *
 * You should have received a copy of the GNU General Public License
 * along with this program.  If not, see <http://www.gnu.org/licenses/>.
 */

/*
 * tegra234-soc-actmon.dtsi: Tegra234 soc dtsi file for central actmon instances
 */

/ {
	actmon@d230000 {
		status = "disabled";
		#address-cells = <2>;
		#size-cells = <2>;
		/* tegra194 central actmon */
		compatible = "nvidia,tegra234-cactmon";
		reg = <0x0 0x0d230000 0x0 0x1000>; /* ACTMON_BASE */
		interrupts = <0 TEGRA234_IRQ_ACTMON IRQ_TYPE_LEVEL_HIGH>;
		clocks = <&bpmp_clks TEGRA234_CLK_ACTMON>;
		clock-names = "actmon";
		resets = <&bpmp_resets TEGRA234_RESET_ACTMON>;
		reset-names = "actmon_rst";
		nvidia,sample_period = /bits/ 8 <20>;

		mc_all {	/* MC_ALL actmon device */
			#address-cells = <1>;
			#size-cells = <0>;
			nvidia,reg_offs = <0x100>;
			nvidia,irq_mask = <0x2>;
			/* EMC_PLLP_FREQ + 2000 */
			nvidia,suspend_freq = <204000>;
			nvidia,boost_freq_step = <204000>;
			nvidia,boost_up_coef = <200>;
			nvidia,boost_down_coef = <50>;
			nvidia,boost_up_threshold = <30>;
			nvidia,boost_down_threshold = <20>;
			nvidia,up_wmark_window = /bits/ 8 <3>;
			nvidia,down_wmark_window = /bits/ 8 <2>;
			nvidia,avg_window_log2 = /bits/ 8 <6>;
			/*
			 * count_weight(W) = no of dram clks needed to access N atoms
			 * N = atoms per dvfs pulse = (2^7+1) = 256 atoms
			 *
			 * t234 has 256 max dram width (16 channels x 16 bits per channel)
			 * 1 dram clock cycle provides 256*2 bits = 64bytes
			 *
			 * In t234, though 1 dram clock can read/write 64 bytes, row-sorter
			 * will split the 64-bytes request into two 32-bytes requests, which
			 * contributes two atoms in the MSS.
			 *
			 * Therefore we need to divide the N value by 2 to get the
			 * correct count_weight value. (W = 128)
			 */
			nvidia,count_weight = <0x80>;
			nvidia,max_dram_channels = /bits/ 8 <16>;
			nvidia,type = <1>;
			clocks = <&bpmp_clks TEGRA234_CLK_EMC>;
			clock-names = "emc";
			status = "disabled";
		};
       };
};
