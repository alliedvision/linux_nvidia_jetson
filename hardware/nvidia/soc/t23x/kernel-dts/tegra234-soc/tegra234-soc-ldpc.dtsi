/*
 * Copyright (c) 2020, NVIDIA CORPORATION.  All rights reserved.
 *
 * This program is free software; you can redistribute it and/or modify it
 * under the terms and conditions of the GNU General Public License,
 * version 2, as published by the Free Software Foundation.
 *
 * This program is distributed in the hope it will be useful, but WITHOUT
 * ANY WARRANTY; without even the implied warranty of MERCHANTABILITY or
 * FITNESS FOR A PARTICULAR PURPOSE.  See the GNU General Public License for
 * more details.
 *
 * You should have received a copy of the GNU General Public License
 * along with this program.  If not, see <http://www.gnu.org/licenses/>.
 */

/ {
	ldpc-enc@15700000 {
		compatible = "nvidia,tegra-ldpc-enc";
		nvidia,devname = "ldpc-enc";
		reg = <0x0 0x15700000 0x0 0x80000>;
		status = "disabled";
	};

	ldpc-dec@15780000 {
		compatible = "nvidia,tegra-ldpc-dec";
		nvidia,devname = "ldpc-dec";
		reg = <0x0 0x15780000 0x0 0x80000>;
		status = "disabled";
	};
};
