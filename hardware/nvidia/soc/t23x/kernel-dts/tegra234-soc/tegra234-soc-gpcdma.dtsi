/*
 * Copyright (c) 2020-2021, NVIDIA CORPORATION.  All rights reserved.
 *
 * This program is free software; you can redistribute it and/or modify it
 * under the terms and conditions of the GNU General Public License,
 * version 2, as published by the Free Software Foundation.
 *
 * This program is distributed in the hope it will be useful, but WITHOUT
 * ANY WARRANTY; without even the implied warranty of MERCHANTABILITY or
 * FITNESS FOR A PARTICULAR PURPOSE.  See the GNU General Public License for
 * more details.
 *
 * You should have received a copy of the GNU General Public License
 * along with this program.  If not, see <http://www.gnu.org/licenses/>.
 */

/*
 * tegra234-soc-gpcdma.dtsi: Tegra234 soc dtsi file for GPCDMA.
 */

#include <dt-bindings/reset/tegra234-reset.h>
#include <dt-bindings/memory/tegra234-smmu-streamid.h>

/ {
	gpcdma: gpcdma@2600000 {
		compatible = "nvidia,tegra234-gpcdma";
		reg = <0x0 0x2600000 0x0 0x210000>;
		resets = <&bpmp_resets TEGRA234_RESET_GPCDMA>;
		reset-names = "gpcdma";
		interrupts = <0 75 0x04
			0 76 0x04
			0 77 0x04
			0 78 0x04
			0 79 0x04
			0 80 0x04
			0 81 0x04
			0 82 0x04
			0 83 0x04
			0 84 0x04
			0 85 0x04
			0 86 0x04
			0 87 0x04
			0 88 0x04
			0 89 0x04
			0 90 0x04
			0 91 0x04
			0 92 0x04
			0 93 0x04
			0 94 0x04
			0 95 0x04
			0 96 0x04
			0 97 0x04
			0 98 0x04
			0 99 0x04
			0 100 0x04
			0 101 0x04
			0 102 0x04
			0 103 0x04
			0 104 0x04
			0 105 0x04
			0 106 0x04
			0 107 0x04>;
		#dma-cells = <1>;
		iommus = <&smmu_niso0 TEGRA_SID_NISO0_GPCDMA_0>;
		nvidia,stream-id = <TEGRA_SID_NISO0_GPCDMA_0>;
		dma-coherent;
		nvidia,start-dma-channel-index = <1>;
		dma-channels = <31>;

		status = "disabled";
	};
};
